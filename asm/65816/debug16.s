; KEEP DEBUG16

 .p816
 .smart

; ***********************************************
; * *
; * DEBUG16 *
; * A 65816 DEBUGGER *
; * *
; * *
; ***********************************************

 .ORG $8000

MAIN:

; USING MN
; USING ATRIBL


 DPAGE = $300 ; LOCATION OF THIS APPLICATION’S
 ; DIRECT PAGE

 ; DIRECT PAGE STORAGE
 ; TRACE REGISTERS
 ;

 PCREG = $80 ; PROGRAM COUNTER
 PCREGH = PCREG+1
 PCREGB = PCREGH+1 ; INCLUDING BANK

 NCODE = PCREGB+1 ; NEXT CODE TO BE TRACED

 OPCREG = NCODE+1 ; OLD PROGRAM COUNTER VALUE
 OPCREGH = OPCREG+1
 OPCREGB = OPCREGH+1

 CODE = OPCREGB+1 ; CURRENT CODE TO BE TRACED

 OPRNDL = CODE+1 ; OPERANDS OF CURRENT
 OPRNDH = OPRNDL+1 ; INSTRUCTION
 OPRNDB = OPRNDH+1


 XREG = OPRNDB+1 ; X REGISTER
 XREGH = XREG+1

 YREG = XREGH+1 ; Y REGISTER
 YREGH = YREG+1

 AREG = YREGH+1 ; ACCUMULATOR
 AREGH = AREG+1

 STACK = AREGH+1 ; STACK POINTER
 STACKH = STACK+1


 DIRREG = STACKH+1 ; DIRECT PAGE REGISTER
 DIRREGH = DIRREG+1

 DBREG = DIRREGH+1 ; DATA BANK REGISTER

 PREG = DBREG+1 ; P STATUS REGISTER

 EBIT = PREG+1 ; E BIT

 TEMP = EBIT+2 ; TEMPORARY
 TEMPH = TEMP+1
 TEMPB = TEMPH+1


 ADDRMODE = TEMPB+1 ; ADDRESS MODE OF CURRENT OPCODE

 MNX = ADDRMODE+1 ; MNEMONIC INDEX
                  ; FROM ATTRIBUTE TABLE

 OPLEN = MNX+2    ; LENGTH OF OPERATION,
                  ; INCLUDING INSTRUCTION

 CR = $8D ; CARRIAGE RETURN

 M = $20 ; SYBOLIC NAMES FOR
 IX = $10 ; STATUS REGISTER BITS
 C = $01

 ; LLLLLLLLLLLLLLLLLLLLLLLLLLLLLLLL
 ;
 ; LIST
 ; MAIN LOOP OF DISASSEMBLER FUNCTION
 ;
 ; LLLLLLLLLLLLLLLLLLLLLLLLLLLLLLLL
 ;

LIST:
 PHP ; SAVE ORIGINAL FLAGS
 CLC
 XCE ; SET NATIVE MODE
 PHP ; SAVE PREVIOUS MODE

 PHD ; SAVE CURRENT DP
 PEA DPAGE
 PLD ; SET TO NEW DP

TOP: ; ANOP

 REP #M
 SEP #IX
 .A16
 .I8

  STZ MNX ; CLEAR MNEMONIC INDEX
  LDA PCREG ; MOVE PROGRAM COUNTER
  STA OPCREG ; TO ‘OLD PROGRAM COUNTER’
  LDX PCREGB ; INCLUDING BANK
  STX OPCREGB
  LDA [PCREG] ; GET NEXT INSTRUCTION
  TAX
  STX CODE ; SAVE AS ‘CODE’

  JSR UPDATE ; UPDATE ATTRIBUTE VARIABLES

 JSR FLIST ; FORM OBJECT CODE, MNEMONIC
 JSR FRMOPRNND ; FORM OPERAND FIELD
 JSR PAUSE ; CHECK FOR USER PAUSE
 BCC QUIT
 JSR PRINTLN ; PRINT IT

 BRA TOP ; LOOP TIL END

QUIT: PLD ; RESTORE ENVIRONMENT,
 PLP ; RETURN TO CALLER
 XCE
 PLP
 RTS

;
; FLIST – FORM IMAGE OF PROGRAM COUNTER,
; OBJECT CODE, AND MNEMONIC IN ‘LINE’
;
; REQUIRES ATTRIBUTE VARIABLES TO BE PREVIOUSLY INITIALIZED
; LLLLLLLLLLLLLLLLLLLLLLLLLLLLLLLLLLL
;

FLIST:
; USING MN

 JSR CLRLN ; BLANK ‘LINE’ VARIABLE

 SEP #M+IX ; SHORT REGISTERS
 .A8
 .I8

 LDY #0
 LDA OPCREGB ; GET BANK BYTE, FORM AS HEX
 JSR PUTHEX ; STRING
 LDA #':' ; BANK DELIMITER
 STA LINE,Y
 INY
 LDA OPCREGH ; GET BYTES OF PROGRAM COUNTER
 JSR PUTHEX ; FORM AS HEX STRING IN
 LDA OPCREG ; LINE
 JSR PUTHEX

 LDY #10
 LDA CODE ; STORE OPCODE AS HEX STRING
 JSR PUTHEX
 LDX #1

MORE: CPX OPLEN ; LIST OPERANDS, IF ANY
 BEQ DONE
 LDA OPRNDL-1,X
 JSR PUTHEX
 INX
 BRA MORE

DONE: REP #M+IX
 .A16
 .I16

 LDA MNX ; GET MNEMONIC INDEX,
 ASL A ; MULTIPLY BY THREE
 CLC ; (TIMES TWO PLUS SELF)
 ADC MNX
 CLC
 ADC #MN
 TAX ; INDEX INTO MNEMONIC TABLE
 LDY #LINE+20 ; COPY INTO ‘LINE’
 LDA #2
MOVE:
 MVN 0,0

 RTS

 ; LLLLLLLLLLLLLLLLLLLLLLLLLLLLLLLLLLLLL
 ;
 ; FRMOPRND – –
 ; FORMS OPERAND FIELD OF DISASSEMBLED INSTRUCTION
 ;
 ; OPLEN, ADDRMODE, AND OPRND MUST HAVE BEEN
 ; INITIALIZED BY ‘UPDATE’
 ; LLLLLLLLLLLLLLLLLLLLLLLLLLLLLLLLLLLLL
 ;

FRMOPRND:
; USING MODES
 SEP #M+IX
 .A8
 .I8

 LDY #28 ; OFF SET INTO ‘LINE’ FOR OPERAND
 ; TO BEGIN
 LDA ADDRMODE ; GET ADDRESS MODE, MULTIPLY BY
 ASL A ; TWO, JUMP THROUGH ADDRESS
 TAX ; MODE JUMP TABLE TO PROPER
 JMP (MODES,X) ; HANDLER

FIMM: ; IMMEDIATE MODE – –
 LDA #'#' ; OUTPUT POUND SIGN,
 STA LINE,Y ; ONE OR TWO
 INY ; OPERAND BYTES, DEPENDING
 LDA OPLEN ; ON OPLEN
 CMP #2
 BEQ GOSHORT
 JMP PODB
GOSHORT: JMP POB

FABS: ; ABSOLUTE MODE – –
 JMP PODB ; JUST OUTPUT A DOUBLE BYTE

FABSL: ; ABSOLUTEW LONG – –
 JMP POTB ; OUTPUT A TRIPLE BYTE

FDIR: ; DIRECT MODE – –
 JMP POB ; OUTPUT A SINGLE BYTE

FACC: ; ACCUMULATOR – –
 LDA #'A' ; JUST AN A
 STA LINE,Y
 RTS

FIMP: ; IMPLIED – –
 RTS ; NO OPERAND

FINDINX: ; INDIRECT INDEXED – –
 JSR FIND ; CALL ‘INDIRECT’, THEN FALL
 ; THROUGH TO INDEXED BY Y

FINY: ; INDEXED BY Y MODES – –
 LDA #',' ; TACK ON A ‘COMMA,Y'          '
 STA LINE,Y
 INY
 LDA #'Y'
 STA LINE,Y
 RTS

FINDINXL: ; INDIRECT INDEXED LONG – –
 JSR FINDL ; CALL ‘INDIRECT LONG', THEN
 JMP FINY ; EXIT THROUGH INDEXED BY Y

FINXIND: ; INDEX INDIRECT – –
 LDA #'(' ; PARENTHESIS
 STA LINE,Y
 INY
 JSR POB ; A SINGLE BYTE – –
 JSR FINX ; COMMA, X
 LDA #')' ; CLOSE.
 STA LINE,Y
 RTS

FDIRINXX: ; DIRECT INDEXED BY X – –
 JSR POB ; OUTPUT A BYTE,
 JMP FINX ; TACK ON COMMA, X

FDIRINXY: ; DIRECT INDEXED BY Y – –
 JSR POB ; OUTPUT A BYTE,
 JMP FINY ; TACK ON COMMA, Y

FINX: ; INDEXED BY X – –
 LDA #',' ; TACK ON A
 STA LINE,Y ; COMMA, X
 INY ; (USED BY SEVERAL
 LDA #'X' ; MODES)
 STA LINE,Y
 INY
 RTS

FABSX: ; ABSOLUTE INDEXED BY X – –
 JSR PODB ; OUTPUT A DOUBLE BYTE,
 JMP FINX ; TACK ON A COMMA, X

FABSLX: ; ABSOLUTE LONG BY X – –
 JSR POTB ; OUTPUT A TRIPLE BYTE,
 JMP FINX ; TACK ON COMMA, X

FABSY: ; ABSOLUTE Y – –
 JSR PODB ; OUTPUT A DOUBLE BYTE,
 JMP FINY ; TACK ON COMMA,Y

FPCR: ; PROGRAM COUNTER RELATIVE – –
 LDA #$FF ; SIGN EXTEND OPERAND
 XBA
 LDA OPRNDL
 REP #M+C
.A16 ; LONGA ON
 BMI OK
 AND #$7F
OK: ADC OPCREG ; ADD TO PROGRAM COUNTER
 INC A ; ADD TWO, WITHOUT CARRY
 INC A
 STA OPRNDL ; STORE AS NEW ‘OPERAND'

 SEP #M
 .A8 ; LONGA OFF

 JMP PODB ; NOW JUST DISPLAY A DOUBLE BYTE

FCPRL: ; PROGRAM COUNTER RELATIVE LONG

 REP #M+C
 .A16 ; LONGA ON

 LDA OPRNDL ; JUST ADD THE OPERAND
 ADC OPCREG
 CLC ; BUMP BY THREE, PAST INSTRCTION
 ADC #3
 STA OPRNDL ; STORE AS NEW ‘OPERAND'

 SEP #M
 .A8 ; LONGA OFF

 JMP PODB ; PRINT A DOUBLE BYTE

FABSIND: ; ABSOLUTE INDIRECT
 LDA #'(' ; SURROUND A DOUBLE BYTE
 STA LINE,Y ; WITH PARENTHESES
 INY
 JSR PODB
 LDA #')'
 STA LINE,Y
 RTS

FIND: ; INDIRECT – –
 LDA #'(' ; SURROUND A SINGLE BYTE
 STA LINE,Y ; WITH PARENTESES
 INY
 JSR POB
 LDA #')'
 STA LINE,Y
 INY
 RTS

FINDL: ; INDIRECT LONG – –
 LDA #'[' ; SURROUND A SINGLE BYTE'
 STA LINE,Y ; WITH SQUARE BRACKTS
 INY
 JSR POB
 LDA #']'
 STA LINE,Y
 INY
 RTS

FABSINXIND: ; ABSOLUTE INDIRECT INDEXED
 LDA #'('
 STA LINE,Y ; SURROUND A CALL TO ‘ABSOLUTE
 INY ; INDEXED' WITH PARENTHESES
 JSR FABSX
 LDA #')'
 STA LINE,Y
 RTS

FSTACK: ; STACK – – IMPLIED
 RTS

FSTACKREL: ; STACK RELATIVE
 JSR FDIR ; JUST LIKE
 LDA DIRECT ; INDEXED, BUT WITH
 STA AN ; ‘S'
 INY
 LDA #'S'
 STA LINE,Y
 INY
 RTS

FSRINDINX: ; STACK RELATIVE INDIRECT INDEX
 LDA #'('
 STA LINE,Y ; SURROUND STACK RELATIVE WITH
 INY ; PARENTHESES, THEN
 JSR FSTACKREL
 LDA #')'
 STA LINE,Y
 INY
 JMP FINY ; TACK ON A COMMA,Y

FBLOCK: ; BLOCK MOVE

 REP #M
 LDA OPRNDL ; MAKE HUMAN-READABLE:
 XBA ; SWAP SOURCE, DEST
 STA OPRNDL
 SEP #M

 JSR POB ; OUTPUT THE SOURCE
 LDA #',' ; THEN COMMA
 STA LINE,Y
 INY
 XBA ; SWAP DEST INTO OPRNDL
 STA OPRNDL ; THEN PRINT ONE BYTE
 JMP POB

 ;LLLLLLLLLLLLLLLLLLLLLLLLLLLLLLLLLLLLLL
 ;
 ; POB, PODB, POTB
 ; PUT OPERAND (DOUBLE, TRIPLE) BYTE
 ;
 ; PUTS OPRNDL (OPRNDH, OPRNDB) IN LINE AS HEX VALUE
 ; WITH ‘$' PREFIX
 ;
 ; ASSUMES SHORT ACCUMULATOR AND INSEX REGISTERS
 ; (CALLED BY FOPRND)
 ;LLLLLLLLLLLLLLLLLLLLLLLLLLLLLLLLLLLLLL
 ;

POB:
 .A8
 .I8

 ; PRINT:
 LDX #0 ; ONE OPERAND BYTE
 BRA IN ; SKIP
PODB:
 LDX #1 ; TWO OPERAND BYTES
 BRA IN ; SKIP
POTB:
 LDX #2 ; THREE OPERAND BYTES
 ; FALL THROUGH
IN: LDA #'$' ; PRINT LEAD-IN
 STA LINE,Y
 INY

@MORE: LDA OPRNDL,X ; LOOP THROUGH OPERAND
 JSR PUTHEX ; HIGH TO LOW
 DEX
 BPL @MORE
 RTS

 ; LLLLLLLLLLLLLLLLLLLLLLLLLLLLLLLLLL
 ;
 ; STEP CHECKS FOR USER PAUSE SIGNAL
 ; (KEYSTROKE)
 ;
 ; CONTAINS MACHINE-DEPENDENT CODE
 ; FOR APPLE I I
 ; LLLLLLLLLLLLLLLLLLLLLLLLLLLLLLLLLL
 ;

STEP:
 KEYBD = $C000
 KEYYSTB = $C010
 ESC = $9B ; ESCAPE KEY (HIGH BIT SET)
 V = $40 ; MASK FOR OVERFLOW FLAG
 .A8
 .I8

 PHP ; SAVE MODES
 SEP #M+IX
 BRA WAIT

PAUSE: ; FOR ‘PAUSE' CALL
 PHP
 SEP #M+IX
 LDA KEYBD ; CHECK FOR KEYPRESS
 BPL RETNCR ; NONE; DON'T PAUSE
 STA KEYSTB ; CLEAR STROBE
 ; IF KEYSTROKE
WAIT: LDA KEYBD ; LOOP FOR NEXT KEY
 BPL WAIT
 STA KEYSTB ; CLEAR STROBE
 CMP #ESC ; IF ESC RETURN WITH
 BNE RETNESC

RETEQ: PLP ; CARRY CLEAR (QUIT)
 NOP
 CLC
 RTS

RETNESC: CMP #CR
 BNE RETNCR
 PLP
 SEP #C+V
 RTS

RETNCR: STA KEYSTB
 PLP ; ELSE SET
 SEC
 CLV
 RTS ; (CONTINUE)


 ;
 ; LLLLLLLLLLLLLLLLLLLLLLLLLLLLLLLLLL
 ; PUTHEX
 ;
 ; CONVERTS NUMBER IN ACCUMULATOR TO HEX STRING
 ; STORED AT LINE,Y
 ;
 ; SAVE AND RESTORED MODE FLAGS
 ; LLLLLLLLLLLLLLLLLLLLLLLLLLLLLLLLLL
 ;



PUTHEX:
 PHP ; SAVE MODE FLAGS
 JSR MAKEHEX ; GET ASCII CODES A, B
 REP #M
 .A16
 STA LINE,Y ; PUT TWO BYTES AT LINE
 INY ; INCREMENT Y PAST THEM
 INY
 PLP ; RESTORE MODE
 RTS ; RETURN

MAKEHEX: SEP #M+IX ; ALL EIGHT BIT
 .A8
 .I8

 PHA ; SAVE VALUE TO BE CONVERTED
 AND #$0F ; MASK OFF LOW NIBBLE
 JSR FORMNIB ; CONVERT TO HEX
 XBA ; STORE IN B
 PLA ; RESTORE VALUE
 LSR A ; SHIFT HIGH NIBBLE
 LSR A ; TO LOW NIBBLE
 LSR A
 LSR A
 ; FALL THROUGH TO CONVERT

FORMNIB: CMP #$A ; IF GREATER THAN OR EQUAL TO
 BGE HEXDIG ; 10, USE DIGITS A . . F
 CLC ; ELSE SIMPLY ADD ‘0' TO
 ADC #'0' ; CONVERT TO ASCII
 RTS

HEXDIG: ADC #'A'-11 ; SUBTRACT 11, ADD ‘A'
 RTS ; (SORT OF)

 ; LLLLLLLLLLLLLLLLLLLLLLLLLLLLLLL
 ;
 ; CLRLN
 ;
 ; CLEARS ‘LINE' WITH BLANKS
 ;
 ; SAVES AND RESTORES MODE FLAGS
 ;
 ; LLLLLLLLLLLLLLLLLLLLLLLLLLLLLLL
 ;


CLRLN:
 PHP
 REP #M+IX
 .A16
 .I16

 LDA #' '
 LDX #68

LOOP: STA LINE,X
 DEX
 DEX
 BPL LOOP
 PLP
 RTS

LINE:
 .byte "    " ; A0A0A0A0 DC 70C' ‘
 .byte $8D, $00

 ; LLLLLLLLLLLLLLLLLLLLLLLLLLLLLLLLL
 ;
 ; UPDATE
 ;
 ; UPDATES ATTRIBUTE VARIABLES BASED ON OPCODE
 ; PASSED IN ACCUMULATOR BY LOOKING IN ATTRIBUTE
 ; TABLES
 ;
 ; SAVES AND RESTORES MODE FLAGS
 ; LLLLLLLLLLLLLLLLLLLLLLLLLLLLLLLLL
 ;

UPDATE:
; USING ATRIBL

 LDYI = $A0+2 ; OPCODE VALUE TIMES TWO
 LDXI = $A2+2

 PHP ; SAVE STATE
 REP #M+IX
 .A16
 .I16

 AND #$FF ; MASK HIGH BYTE
 ASL A ; TIMES TWO

 TAY
 LDA ATRIBL,Y ; INDEX INTO ATTRIBUTE TABLE
 XBA ; SWAP ORDER OF ENTRIES
 STA ADDRMODE ; SAVE ADDRMODE, MNEMONIC INDEX

 TAX ; ADDRMODE TO X (LOW)
 TYA ; OPCODE * 2 TO ACCUM
 SEP #IX
 .I8

 LDY LENS-1,X ; GET LENGTH OF OPERATION
 STY OPLEN

 LDX EBIT ; EMULATION MODE?
 CPX #1 ; TEST BIT ZERO
 BEQ SHORT ; YES ALL IMMEDIATE ARE
 ; SHORT
 BIT #$20 ; IS MSD+2 EVEN?
 BNE SHORT ; NO, CAN'T BE IMMEDIATE
 CMP #LDXI ; IS IT LDX #?
 BEQ CHKX
 BIT #$F+2 ; IS LSD+2 ZERO?
 BNE CHKA ; CHECK ACCUMULATOR OPCODES
 CMP PREG ; MUST = LDY# OR GREATER
 BLT CHKA ; NO, MAYBE ACCUMULATOR
 LDA PREG ; IF IT IS, WHAT IS FLAG SETTING?
 AND #IX
 BEQ LONG ; CLEAR – 16 BIT MODE
 BNE SHORT ; SET – 8 BIT MODE

CHKA: AND #$0F+2 ; MASK OUT MSD
 CMP #$9+2 ; IS LSD = 9?
 BNE SHORT
 LDA PREG ; WHAT IS FLAG SETTING?
 AND #M
 BNE SHORT ; NO, 8 BIT MODE

 LONG: INC OPLEN ; LONG IMMEDIATE LENGTH IS
 ; ONE MORE THEN FOUND IN TABLE

SHORT: LDY #0
 BRA LOOPIN

@LOOP: LDA [PCREG] ; LOAD 16 BITS 16 BIT MODE
 ; USED TO BUMP PCREG EASILY
 TAX ; TRUNCATE TO EIGHT BITS
 STX OPRNDL-1,Y ; SAVE

LOOPIN: INC PCREG ; MOVE PC PAST NEXT INSTRUCTION
 INY ; BYTE
 CPY OPLEN ; MOVED ALL OPERAND BYTES?
 BNE @LOOP ; NO, CONTINUE

;DONE:
 PLP
 RTS

 ; LLLLLLLLLLLLLLLLLLLLLLLLLLLLLLLLL
 ;
 ; PRINTLN
 ;
 ; MACHINE-DEPENDENT CODE TO OUTPUT
 ; THE STRING STORED AT ‘LINE'
 ;
 ; SAVES AND RESTORED MODE FLAGS
 ; LLLLLLLLLLLLLLLLLLLLLLLLLLLLLLLLL
 ;

PRINTLN:
 COUT = $FDED ; APPLE CHARACTER OUTPUT ROUTINE

 PHP ; SAVE STATUS
 PHD ; SAVE DIRECT PAGE
 PEA 0 ; SWITCH TO PAGE ZERO
 PLD ; FOR EMULATION

 .A8
 .I8
 SEC ; SWITCH TO EMULATION
 XCE

 LDY #0

@LOOP: LDA LINE,Y ; LOOP UNTIL STRING TERMINATOR
 BEQ @DONE ; REACHED
 JSR COUT
 INY
 BRA @LOOP

@DONE: CLC ; RESTORE NATIVE MODE
 XCE
 PLD ; RESTORE DIRECT PAGE
 PLP ; RESTORE MODE FLAGS
 RTS

 ;
 ; TRACE
 ;
 ; ENTRY POINT FOR TRACER
 ; LLLLLLLLLLLLLLLLLLLLLLLLLLLLLLLLLLL


TRACE:
 USRBRKV = $3F0 ; USER BRK VECTOR FOR APPLE //
 BRKN = $FFE6 ; NATIVE MODE BRK VECTOR

 PHP ; SAVE CALLING STATE
 CLC
 XCE
 PHP

 REP #$10
 .I16
 PEA 0 ; OLD STACK BOUNDARY

 TSX
 STX SAVSTACK

 PEA DPAGE ; INITIALIZE DIRECT PAGE
 PLD

 STX STACK

 SEP #$20
 .A8

 LDA #1
 STA EBIT
 STZ DIRREG ; DIRECT PAGE, DATA BANK
 STZ DIRREGH ; TO POWER-UP DEFAULTS
 STZ DBREG
 STZ MNX+1

 STZ STEPCNTRL

 LDX #EBRKN ; PATCH BRK VECTORS
 STX USRBRKV ; TO POINT TO TRACE CODE

 LDX BRKN ; FIND OUT WHERE BRKN POINTS TO
 CPX #$C000 ; MAKE SURE IT'S RAM ON AN APPLE
 BLT @OK
 JMP QUIT ; MIGHT AS WELL GIVE UP NOW . . .
@OK: STX USRBRKN

 LDA [PCREG] ; GET FIRST OPCODE
 JMP TBEGIN ; BEGIN !

SAVSTACK:
 .res 2
USRBRKN:
 .res 2
SAVRAM:
 .res 2

 ; LLLLLLLLLLLLLLLLLLLLLLLLLLLLLLLLLLLLLLL
 ;
 ; EBRKIN, NBRKIN, TBGIN
 ;
 ; ENTRY POINTS FOR TRACER MAIN LOOP
 ; EBKIN AND NBKIN RECOVER CONTROL AFTER
 ; ‘BRK' INSTRUCTION EXECUTED
 ; TBEGIN IS INITIAL ENTRY FROM ‘TRACE'
 ;
 ; LLLLLLLLLLLLLLLLLLLLLLLLLLLLLLLLLLLLLLL
 ;


EBRKIN: ; ENTRY FROM EMULATION MODE
 ; FOR TRACER

 .A8
 .I8

 PEA 0
 PHA
 LDA $48 ; APPLE II MONITOR
 PHA ; LOCATIONS
 LDA $45 ; FOR P, AA
 LDX $46 ; AND X

 ; note that if direct page is relocated
 ; in emulation mode, these locations
 ; will be used by monitor brk handler

 INC EBIT+DPAGE ; MARK AS EMULATION MODE

 CLC ; GO NATIVE
 XCE

NBRKIN: ; ENTRY FROM NATIVE MODE
 ; FOR TRACER

 REP #M+IX
 .A16
 .I16

 PHB ; SAVE DATA BANK
 0B PHD DIRECT PAGE
 F40003 PEA DPAGE SWITCH TO APPLICATION
 2B PLD DIRECT PAGE

 858F STA AREG STASH USER REGISTERS
 868B STX XREG
 848D STY YREG

 A301 LDA 1,S GET DIRECT PAGE VALUE
 8593 STA DIRREG SAVED

 3B TSC CALCULATE TRUE STACK
 18 CLC (BEFORE BRK)
 690700 ADC #7
 8595 STA STACK SAVE AS STACK

 A303 LDA 3,S SAVE DATA BANK, STATUS
 8595 STA DBREG STATUS REGISTER

 A94001 LDA #$140 SET UP SMALL STACK
 1B TCS

 4B PHK MAKE DATA BANK = PROGRAM BANK
 AB PLB
 AE0080 LDX USRBRKN RESTORE BORROWED RAM
 AD0180 LDA SAVRAM+1
 9D0100 STA !1,X
 AD0080 LDA SAVRAM
 9D0100 STA !0,X
 200080 JSR FLIST FORMAT DISASSEMBLY LINE
 200080 JSR FRMOPRND

 200080 JSR PRINTLN PRINT IT

 200080 JSR CLRLN
 200080 JSR DUMPREGS OUPUT REGISTER VALUES
 200080 JSR PRINTLN

 E220 SEP #M
 .A16

 C210 REP STEPCNTRL
 LONGI DOPAUSE

 2CE000 BIT
 300E BMI

 200080 JSR STEP STEP ONE AT A TIME
 9068 BCC QUIT USER WANTS TO QUIT
 5011 BVC RESUME WANTS TO KEEP STEPPING
 A980 LDA #$80 HIT CR; WANTS TO TRACE, NOT
 8DE000 STA STEPCNTRL STEP SET FLAG
 800A BRA RESUME

 200080 DOPAUSE JSR PAUSE TRACING; ONLY WAIT IF USER
 905A BCC QUIT HITS KEY
 5003 BVC RESUME WANTS TO KEEP TRACING
 9CE000 STZ STEPCNTRL HIT CR; WANTS TO STEP, NOT
 ; TRACE CLEAR FLAG

 A583 RESUME LDA NCODE RESTORE ONLD ‘NEXT'; IT'S ABOUT
 8780 STA [PCREG] TO BE EXECUTED

TBEGIN:
 AB TAY SAVE THE CURRENT (ABOUT TO BE
 ; EXECUTED) OPCODE

 A680 LDX PCREG REMEMBER WHERE YOU GOT IT FROM
 8684 STX OPCREG PCREG POINTED TO IT AFTER
 A582 LDA PCREGB PREVIOUS CALL TO UPDATE
 8586 STA OPCREGB

 98 TYA

 8587 STA CODE SAVE CURRENT OPCODE
 200080 JSR UPDATE UPDATE PC TO POINT PAST THIS
 ; INSTRUCTION
 ; UPDATE ATTRIBUTE VARIABLES

 200080 JSR CHKSPCL CHECK TO SEE IF THIS CAUSES A
 ; TRANSFER
 A780 LDA [PCREG] GET NEXT OPCODE TO BE EXECUTED
 ; (ON NEXT LOOP THROUGH)
 8583 STA NCODE SAVE IT
 A900 LDA #0 PUT A BREAK ($00) THERE TO
 ; REGAIN CONTROL
 8780 STA [PCREG]

GO:
 C230 REP #M+X
 .A16
 .I16
 AE0080 LDX USRBRKIN BORROW THIS RAM FOT A SECOND
 BD0000 LDA !0,X
 8D0080 STA SAVRAM
 BD0100 LDA !1,X
 8D0180 STA SAVRAM+1
 A94C00 LDA #$4C
 9D0000 STA !0,X
 A91000 LDA #NBRKIN
 9D0100 STA !1,X
 A561 LDA STACK RESTORE STACK
 1B TCS
 D495 PEI (DBREG) GET THIS STUFF ON STACK
 D496 PEI (EBIT-1)
 D493 PEI (DIRREG)

 6497 STZ EBIT ASSUME NATIVE MODE ON RETURN

 A58F LDA AREG RESTORE USER REGISTERS
 A48D LDY YREG
 A68B LDX XREG

 2B PLD POP IT AWAY!

 28 PLP
 28 PLP
 FB XCE

 AB PLB
 28 PLP

 DC8403 JMP [DPAGE+OPCREG] ON TO THE NEXT!

QUIT:
 E220 SEP #$20
 .A8

 A583 LDA NCODE CLEAN UP OLD PATCH
 8780 STA [PCREG]

 C210 REP #$10
 .I16

 AE0080 LDX SAVSTACK GET ORIGINAL STACK POINTER
 E8 INX
 E8 INX
 9A TXS

 F40000 PEA 0 RESTORE ZERO PAGE
 2B PLD

 28 PLP
 FB XCE
 28 PLP
 60 RTS

STEPCNTRL:
 00 DS 1

 ; LLLLLLLLLLLLLLLLLLLLLLLLLLLLLLLLLLLLL
 ; CHKSPCL
 ;
 ; CHECK CURRENT OPCODE (IN CODE) FOR SPECIAL CASES
 ; INSTRUCTIONS WHICH TRANSFER CONTROL (JMP, BRA, ETC.);
 ;
 ; ASSUMES SHORTA, LONGI CALLED BY EBRKIN
 ; LLLLLLLLLLLLLLLLLLLLLLLLLLLLLLLLLLLLL
 ;


CHKSPCL:
 .A8
 .I16

 A20000 LDX #SCX-SCODES
 A587 LDA CODE

 DD0080 LOOP CMP SCODES,X CHECK TO SEE IF CURRENT OPCODE
 F004 BEQ HIT IS IN EXCEPTION TABLE
 CA DEX
 10F8 BPL LOOP
 60 RTS EXIT IF NOT


 E210 HIT SEP #X
 .I8

 8A TXA IF INDEX WAS LESS THAN 9, IT'S
 C909 CMP #9 A BRANCH
 B00F BGE NOTBR

 4A LSR A SEE IF ‘ODD OR EVEN'
 AA TAX
 BD0080 LDA PHASK,X GET MASK TO SELECT CORRECT
 ; PREG BIT
 2596 AND PREG IS IT SET?

 B003 BCS BBS IF INDEX WAS ODD, BRANCH IF
 ; PREG BIT IS SET
 F00B BEQ DOBRANCH ELSE IF EVEN, BRANCH IF CLEAR
 60 RTS

 D008 BBS BNE DOBRANCH “BRANCH IF BIT SET”
 60 RTS

 0A NOTBR ASL A NOT A BRANCH INSTRUCTION;
 ; MULTIPLY BY TWO
 AA TAX AND INDEX INTO HANDLER JUMP
 TABLE
 C210 REP #X
 7CEE7F JMP (SPJMP-18,X) BIAS JUMP TABLE BY 9

DOBRANCH:
 A9FF LDA #$FF SET ACCUMULATOR BYTE HIGH
 ; (ANTICIPATE NEGATIVE)
 EB XBA AND SIGN EXTEND INTO X

 A588 LDA OPRNDL

 C231 REP #M+X+C MAKE REGS LONG; CLEAR CARRY
 .A16 (ANTICIPATE ADC)
 .I16

 3003 BMI OK NUMBER WAS NEGATIVE; ALL IS OK

 297F00 AND #$7F CLEAR HIGH BYTE OF ACCUM
 ; (POSITIVE NUMBER)
 6580 OK ADC PCREG
 8580 STA PCREG
 E220 SEP #M RETURN WITH ACCUM SHORT
 60 RTS

SBRK: ;THESE ARE NOT IMPLEMENTED!
SRTI: ; (AN EXERCISE FOR READER)
 SCOP ENTRY
 60 RTS

 SJSRABS ENTRY ABSOLUTES
 SJMPABS ENTRY
 A688 LDX OPRNDL MOVE OPERAND TO PC
 8680 STX PCREG
 60 RTS

 SBRL ENTRY LONG BRANCH
 C221 REP #M+C LONG ACCUM AND CLEAR CARRY
 .A16
 A588 LDA OPRNDL ADD DISPLACMENT TO
 6580 ADC PCREG PROGRAM COUNTER
 8580 STA PCREG
 E220 SEP #M
 .A8
 60 RTS

 SJSRABSL ENTRY ABSOLUTE LONGS
 SJMPABSL ENTRY
 A688 LDX OPRNDL MOVE OPERAND, INCLUDING BANK,
 8680 STX PCREG TO PROGRAM COUNTER
 A58A LDA OPRNDB
 8582 STA PCREGB
 60 RTS

 SRTS ENTRY RETURN
 A691 LDX STACK PEEK ON STACK
 EC0080 CPX SAVSTACK IF ORIGINAL STACK . . .
 D003 BNE CONT
 4C0080 JMP QUIT RETURN TO MONITOR
 E8 CONT INX

 C220 REP #M
 BF000000 LDA >0,X ALWAYS IN BANK ZERO
 1A INC A ADD ONE TO GET TRUE RETURN
 8580 STA PCREG VALUE
 E220 SEP #M

 60 RTS


 SRTL ENTRY RETURN LONG
 201A00 JSR SRTS DO NORMAL RETURN,

 E8 INX THEN GET BANK BYTE
 E8 INX
 BF000000 LDA >0,X A IS NOW SHORT FOR BANK BYTE
 8582 STA PCREGB
 60 RTS


 SJMPIND ENTRY INDIRECT
 A688 LDX OPRNDL GET OPERAND

 C220 REP #M
 BF000000 LDA >0,X JMP IND ALWAYS IN BANK ZERO
 8580 STA PCREG
 E220 SEP #M
 60 RTS


 SJMPINDL ENTRY
 203D00 JSR SJMPIND SAME AS JMP INDIRECT,
 E8 INX PLUS BANK BYTE
 E8 IJNX
 BF000000 LDA >0,X ACCUM IS SHORT NOW
 8582 STA PCREGB
 60 RTS


 SJMPINDX ENTRY INDEX JUMPS
 SJSRINDX ENTRY
 A48B LDY XREG LET CPU DO ADDITION
 A688 LDX OPRNDL GET INSIRECT POINTER
 8699 STX TEMP
 A582 LDA RCREGB INDEXED JUMPS ARE IN PROGRAM
 859B STA TEMP+2 BANK

 C220 REP #M
 B799 LDA [TEMP],Y ‘Y IS X'
 8680 STA PCREG
 E220 SEP #M

 60 RTS

 ; LLLLLLLLLLLLLLLLLLLLLLLLLLLLLLLLLLLLLLL
 ;
 ; DUMPREGS
 ;
 ; DISPLAYS CONTENTS OF REGISTER VARIABLES IN ‘LINE'
 ;
 ; SAVES AND RESTORES MODE
 ; LLLLLLLLLLLLLLLLLLLLLLLLLLLLLLLLLLLLLLL
 ;

DUMPREGS:
 08 PHP
 E230 SEP #M+X
 .A8
 .I8

 A000 LDY #0

 A903 LDA #>DPAGE STOE DPAGE HIGH IN TEMP HIGH
 859A STA TEMPH

 A209 LDX #ENDTABLE-TABLE LENGTH OF COMMAND TABLE

 BD4400 LOOP LDA TABLE,X GET ADDRESS OF NEXT REGISTER
 8599 STA TEMP
 CA DEX
 BD4400 LDA TABLE,X GET REGISTER ‘NAME'
 200080 JSR PUTREG16
 CA DEX
 10F1 BPL LOOP

 1995 LDA #DBREG NOW ALL THE 8-BIT REGISTERS
 8599 STA TEMP
 A9C2 LDA #'B'
 200080 JSR PUTREG8
 A996 LDA #PREG
 8599 STA TEMP
 A9D0 LDA #'P'
 200080 JSR PUTREG8
 A9C5 LDA #'E'
 990080 STA LINE,Y
 C8 INY
 A9BA LDA #':'
 990080 STA LINE,Y
 C8 INY

 A9B0 LDA #'0'
 A697 LDX EBIT
 F001 BEQ OK
 1A INC A ‘0' BECOMES ‘1'
 990080 OK STA LINE,Y


 28 PLP
 60 RTS

 C494 TABLE DC C'D',I1'DIRREGH' DIRECT PAGE
 D392 DC C'S',I1'STACKH' ADDRESS OF
 D98E DC C'Y',I1'YREGH' REGISTER
 D88C DC C'X',I1'XREGH' VARIABLES
 C1 DC C'A'
 90 ENDTABLE DC I1'AREGH'

 ; LLLLLLLLLLLLLLLLLLLLLLLLLLLLLLLLLLLLLLL
 ;
 ; PUTREGS
 ;
 ; LLLLLLLLLLLLLLLLLLLLLLLLLLLLLLLLLLLLLLL
 ;



PUTREG8:
 990080 STA LINE,Y A CONTAINS REGISTER ‘NAME'
 C8 INY
 A9BC LDA #'=' EQUALS . .
 990080 STA LINE,Y
 C8 INY
 8012 BRA PRIN USE PUTREG16 CODE

 PUTREG16 ENTRY
 990080 STA LINE,Y A CONTAINS REGISTER ‘NAME'
 C8 INY
 A9BD LDA #'=' EQUALS . .
 990080 STA LINE,Y
 C8 INY
 C8 INY
 B299 LDA (TEMP) TEMP POINTS TO REGISTER
 C699 DEC TEMP VARIABLE HIGH
 200080 JSR PUTHEX

 C8 PRIN INY
 B299 LDA (TEMP) TEMP POINTS TO REGISTER
 20080 JSR PUTHEX VARIABLE LOW (OR 8 BIT)
 C8 INY
 60 RTS

 ; LLLLLLLLLLLLLLLLLLLLLLLLLLLLLLLLLLLLLL
 ;
 ; SP JMP
 ; JUMP TABLE FOR ‘SPECIAL' OPCODE HANDLERS
 ; LLLLLLLLLLLLLLLLLLLLLLLLLLLLLLLLLLLLLL
 ;

SPJMP: ; JUMP TABLE FOR
 0080 DC A'SBRK' NON-BRANCH HANDLERS
 0080 DC A'SJSRABS'
 0080 DC A'SRTI'
 0080 DC A'SRTS'
 0080 DC A'SCOP'
 0080 DC A'SJSRABSL'
 0080 DC A'SBRL'
 0080 DC A'SRTL'
 0080 DC A'SJMPABS'
 0080 DC A'SJMPABSL'
 0080 DC A'SJMPIND'
 0080 DC A'SJMPINDX'
 0080 DC A'SJMPINDL'
 0080 SCT DC A'SJSRINDX'

 ; LLLLLLLLLLLLLLLLLLLLLLLLLLLLLLLLLLLLLL
 ;
 ; PMASK
 ; STATUS REGISTER MASKS FOR BRANCH HANDLING CODE
 ; LLLLLLLLLLLLLLLLLLLLLLLLLLLLLLLLLLLLLL
 ;

PMASK: ; MASKS FOR STATUS REGISTER
 80 DC H'80' N FLAG
 40 DC H'40' V FLAG
 01 DC H'01' C FLAG
 02 DC H'02' Z FLAG
 00 DC H'00' BRA

SCODES: ; SPECIAL OPCODES

 10 DC H'10' BPL
 30 DC H'30' BMI
 50 DC H'50' BVC
 70 DC H'70' BVS
 90 DC H'90' BCC
 B0 DC H'B0' BCS
 D0 DC H'D0' BNE
 F0 DC H'F0' BEQ
 80 DC H'80' BRA
 00 DC H'00' BRK
 20 DC H'20' JSR
 40 DC H'40' RTI
 60 DC H'60' RTS
 02 DC H'02' COP
 22 DC H'22' JSR ABSL
 82 DC H'82' BRL
 6B DC H'6B' RTL
 4C DC H'4C' JMP ABS
 5C DC H'5C' JMP ABSL
 6C DC H'6C' JMP ()
 7C DC H'7C' JMP (,X)
 DC DC H'DC' JMP [ ]
 SCX ENTRY
 FC DC H'FC' JSR (,X)

 MN DATA
 000000 DX 3
 C1C4C3 DC C'ADC' 1
 C1C3C4 DC C'AND' 2
 C1D3CC DC C'ASL' 3
 C2C3C3 DC C'BCC' 4
 C2C3D3 DC C'BCS' 5
 C2C5D1 DC C'BEQ' 6
 C2C9D4 DC C'BIT' 7
 C2CDC9 DC C'BMI' 8
 C2C3C5 DC C'BNE' 9
 C2D0CC DC C'BPL' 10
 C2D2CB DC C'BRK' 11
 C2D6C3 DC C'BVC' 12
 C2D6D3 DC C'BVS' 13
 C3CCC3 DC C'CLC' 14
 C3CCC4 DC C'CLD' 15
 C3CCC9 DC C'CLI' 16
 C3CCD6 DC C'CLV' 17
 C3CDD0 DC C'CMP' 18
 C3D0D8 DC C'CPX' 19
 C3D0D9 DC C'CPY' 20
 C4C5C3 DC C'DEC' 21
 C4C5D8 DC C'DEX' 22
 C4C5D9 DC C'DEY' 23
 C5CFD2 DC C'EOR' 24
 C9CEC3 DC C'INC' 25
 C9C3D8 DC C'INX' 26
 C9C3D9 DC C'INY' 27
 CACDD0 DC C'JMP' 28
 CAD3D2 DC C'JSR' 29
 CCC4C1 DC C'LDA' 30
 CCC4D8 DC C'LDX' 31
 CCC9D9 DC C'LDY' 32
 CDC3D2 DC C'LSR' 33
 CECFD0 DC C'NOP' 34
 CFD2C1 DC C'ORA' 35
 D0C8C1 DC C'PHA' 36
 D0C8D0 DC C'PHP' 37
 D0CCC1 DC C'PLA' 38
 D0CCD0 DC C'PLP' 39
 D2CFCC DC C'ROL' 40
 D2CFD2 DC C'ROR' 41
 D2D4C9 DC C'RIT' 42
 D2D4D3 DC C'RTS' 43
 D3C2C3 DC C'SBC' 44
 D3C5C3 DC C'SEC' 45
 D3C5C4 DC C'SED' 46
 D3C5C9 DC C'SEI' 47
 D3D4C1 DC C'STA' 48
 D3D4D8 DC C'STX' 49
 D3D4D9 DC C'STY' 50
 D4C1D8 DC C'TAX' 51
 D4C1D9 DC C'TAY' 52
 D4D3D8 DC C'TSX' 53
 D4D8C1 DC C'TXA' 54
 D4D8D3 DC C'TXS' 55
 D4D9C1 DC C'TYA' 56
 C2D2C1 DC C'BRA' 57
 D0CCD8 DC C'PLX' 58
 D0CCD9 DC C'PLY' 59
 D0C8D8 DC C'PHX' 60
 D0D8D0 DC C'PHY' 61
 D3D4DA DC C'STZ' 62
 D4D3C2 DC C'TRB' 63
 D4D3C2 DC C'TSB' 64

 D0C5C1 DC C'PEA' 65
 D0C5C9 DC C'PEI' 66
 D0C5D2 DC C'PER' 67
 D0CCC2 DC C'PLB' 68
 D0CCC4 DC C'PLD' 69
 D0C8C2 DC C'PHB' 70
 D0C8C4 DC C'PHD' 71
 D0C8CB DC C'PHK' 72

 D2C5D0 DC C'REP' 73
 D3C5D0 DC C'SEP' 74

 D4C3C4 DC C'TCD' 75
 D4C4C3 DC C'TDC' 76
 D4C3D3 DC C'TCS' 77
 D4D3C3 DC C'TSC' 78
 D4D8D9 DC C'TXY' 79
 D4D9D8 DC C'TYX' 80
 D8C2C1 DC C'XBA' 81
 D8C3C5 DC C'XCE' 82

 C2D2CC DC C'BRL' 83
 CAD3CC DC C'JSL' 84
 D2D4CC DC C'RTL' 85
 CDD6CE DC C'MVN' 86
 CDD6D0 DC C'MVP' 87
 C3CFD0 DC C'COP' 88
 D7C1C9 DC C'WAI' 89
 D3D4D0 DC C'STP' 100
 D7C4CD DC C'WDM' 101

 MODES DATA
 0000 DS 2
 0080 DC A'FIMM' 1
 0080 DC A'FABS' 2
 0080 DC A'FABSL' 3
 0080 DC A'FDIR' 4
 0080 DC A'FACC' 5
 0080 DC A'FIMP' 6
 0080 DC A'FINDINX' 7
 0080 DC A'FINDINXL' 8
 0080 DC A'FINXIND' 9
 0080 DC A'FDIRINXX' 10
 0080 DC A'FDIRINXY' 11
 0080 DC A'FABSX' 12
 0080 DC A'FABSLX' 13
 0080 DC A'FABSY' 14
 0080 DC A'FPCR' 15
 0080 DC A'FPCRL' 16
 0080 DC A'FABSIND' 17
 0080 DC A'FIND' 18
 0080 DC A'FINDL' 19
 0080 DC A'FABSINXIND' 20
 0080 DC A'FSTACK' 21
 0080 DC A'FSTACKREL' 22
 0080 DC A'FSRINDINX' 23
 0080 DC A'FBLOCK' 24

LENS:
 02 DC H'02' IMM
 03 DC H'03' ABS
 04 DC H'04' ABS LONG
 02 DC H'02' DIRECT
 01 DC H'01' ACC
 01 DC H'01' IMPLIED
 02 DC H'02' DIR IND INX
 02 DC H'02' DIR IND INX L
 02 DC H'02' DIR INX IND
 02 DC H'02' DIR INX X
 02 DC H'02' DIR INX Y
 03 DC H'03' ABS X
 04 DC H'04' ABS L X
 03 DC H'03' ABS Y
 02 DC H'02' PCR
 03 DC H'03' PCR L
 03 DC H'03' ABS IND
 02 DC H'02' DIR IND
 02 DC H'02' DIR IND L
 03 DC H'03' ABS INX IND
 01 DC H'01' STACK
 02 DC H'02' SR
 02 DC H'02' SR INX
 03 DC H'03' MOV

 0B06 DC I1'11,6' BRK 00
 2309 DC I1'35,9' ORA D,X 01
 5804 DC I1'88,4' COP (REALLY 2) 02
 2316 DC I1'35,22' ORA-,X 03
 4004 DC I1'64,4' TSB D 04
 2304 DC I1'34,4' ORA D 05
 0304 DC I1'3,4' ASL D 06
 2313 DC I1'35,19' ORA [D] 07
 2515 DC I1'37,21' PHP 08
 2301 DC I1'35,1' ORA IMM 09
 0305 DC I1'3,5' ASL ACC 0A
 4715 DC I1'71,21' PHD 0B
 4002 DC I1'64,2' TSB ABS 0C
 2302 DC I1'35,2' ORA ABS 0D
 0302 DC I1'3,2' ASL ABS 0E
 2303 DC I1'35,3' ORA ABS L 0F
 0A0F DC I1'10,15' BPL 10
 2307 DC I1'35,7' ORA (D),Y 11
 2312 DC I1'35,18' ORA (D) 12
 2317 DC I1'35,23' ORA S,Y 13
 3FO4 DC I1'63,4' TRB D 14
 230A DC I1'35,10' ORA D,X 15
 030A DC I1'3,10' ASL D,X 16
 2308 DC I1'35,8' ORA (DL),Y 17
 0E06 DC I1'14,6' CLC 18
 230E DC I1'35,14' ORA ABS,Y 19
 1905 DC I1'25,5' NC ACC 1A
 4D06 DC I1'77,6' TCS 1B
 3F02 DC I1'63,2' TRB ABS,X 1C
 230C DC I1'35,12' ORA ABS,X 1D
 030C DC I1'3,12' ASL ABS,X 1E
 230D DC I1'35,13' ORA ABSL,X 1F
 1D02 DC I1'29,2' JSR ABS 20
 0207 DC I1'2,7' AND (D, X) 21
 1D03 DC I1'29,3' JSL ABS L 22
 0216 DC I1'2,22' AND SR 23
 0704 DC I1'7,4' BIT D 24
 0204 DC I1'2,4' AND D 25
 2804 DC I1'40,4' ROL D 26
 0213 DC I1'2,19' AND (DL) 27
 2706 DC I1'39,6' PLP 28
 0201 DC I1'2,1' AND IMM 29
 2805 DC I1'40,5' ROL ACC 2A
 4515 DC I1'69,21' PLD 2B
 0705 DC I1'7,2' BIT ABS 2C
 0202 DC I1'2,2' AND ABS 2D
 28005 DC I1'40,5' ROL A 2E
 0203 DC I1'2,3' AND ABS L 2F
 080F DC I1'8,15' BMI 30
 020B DC I1'2,11' AND D,Y 31
 0212 DC I1'2,18' AND (D) 32
 0217 DC I1'2,23' AND (SR),Y 33
 070A DC I1'7,10' BIT D,X 34
 020A DC I1'2,10' AND D,X 35
 280A DC I1'40,10' ROL D,X 36
 0208 DC I1'2,8' AND (DL),Y 37
 2D06 DC I1'45,6' SEC 38
 020E DC I1'25,14' AND ABS,Y 39
 1505 DC I1'21,5' DEC 3A
 4E06 DC I1'78,6' TSC 3B
 070C DC I1'7,12' BIT A,X 3C
 020C DC I1'2,12' AND ABS,X 3D
 280C DC I1'40,12' ROL A,X 3E
 020D DC I1'2,13' AND AL,X 3F
 2A06 DC I1'42,6' RTI 40
 1809 DC I1'24,9' EOR (D,X) 41
 6506 DC I1'101,6' WDM 42
 1816 DC I1'24,22' EOR (D,X) 43
 5718 DC I1'87,24' MVP 44
 1804 DC I1'24,4' EOR D 45
 2104 DC I1'33,4' LSR D 46
 1813 DC I1'24,19' EOR (DL) 47
 2406 DC I1'36,6' PHA 48
 1801 DC I1'24,1' EOR IMM 49
 2105 DC I1'33,5' LSR ABS L 4A
 4806 DC I1'72,6' PHK 4B
 1C02 DC I1'28,2' JMP ABS 4C
 1802 DC I1'24,2' EOR ABS 4D
 2102 DC I1'33,2' LSR ABS 4E
 1805 DC I1'24,5' EOR ABS L 4F
 0C0F DC I1'12,15' BVC 50
 1807 DC I1'24,7' EOR (D),Y 51
 1812 DC I1'24,18' EOR (D) 52
 1817 DC I1'24,23' EOR (SR),Y 53
 56148 DC I1'86,24' MVN 54
 180A DC I1'24,10' EOR D,X 55
 210A DC I1'33,10' LSR D,X 56
 1808 DC I1'24,8' EOR (DL),Y 57
 1006 DC I1'16,6' CLI 58
 180E DC I1'24,14' EOR 59
 3D15 DC I1'61,21' PHY 5A
 4B06 DC I1'75,6' TCD 5B
 1C03 DC I1'28,3' JMP ABSL 5C
 180C DC I1'24,12' EOR ABS,X 5D
 210C DC I1'33,12' LSR ABS,X 5E
 180D DC I1'24,13' EOR ABSL,X 5F
 2B06 DC I1'43,6' RTS 60
 0109 DC I1'1,9' ADC (D, X) 61
 4340 DC I1'67,16' PER 62
 0116 DC I1'1,22' ADC SR 63
 3E04 DC I1'62,4' STZ D 64
 0104 DC I1'1,4' ADC D 65
 2904 DC I1'41,4' ROR D 66
 0113 DC I1'1,19' ADC (DL) 67
 2615 DC I1'38,21' PLA 68
 0101 DC I1'1,1' ADC 69
 2905 DC I1'41,5' ROR ABSL 6A
 5506 DC I1'85,6' RTL 6B
 1C11 DC I1'28,17' JMP (A) 6C
 0102 DC I1'1,2' ADC ABS 6D
 2902 DC I1'41,2' ROR ABS 6E
 0103 DC I1'1,3' ADC ABSL 6F
 0D0F DC I1'13,15' BVS 70
 0108 DC I1'1,8' ADC (D),Y 71
 0112 DC I1'1,18' ADC (D) 72
 0117 DC I1'1,23' ADC (SR),Y 73
 3E0A DC I1'62,10' STZ D,X 74
 010A DC I1'1,10' ADC D,X 75
 290A DC I1'41,10' ROR D,X 76
 0108 DC I1'1,8' ADC (DL),Y 77
 2F06 DC I1'47,6' SEI 78
 010E DC I1'1,14' ADC ABS,Y 79
 3B15 DC I1'59,21' PLY 7A
 4C06 DC I1'76,6' TDC 7B
 1C14 DC I1'28,20' JMP (A, X) 7C
 010C DC I1'1,12' ADC ABS,X 7D
 290C DC I1'41,12' ROR ABS,X 7E
 010D DC I1'1,13' ADC ABSL,X 7F

ATRIBH:
 390F DC I1'57,15' BRA 80
 3009 DC I1'48,9' STA (D, X) 81
 5310 DC I1'83,16' BRL 82
 3016 DC I1'48,22' STA-,S 83
 3204 DC I1'50,4' STY D 84
 3004 DC I1'48,4' STA D 85
 3104 DC I1'49,4' STX D 86
 3013 DC I1'48,19' STA [ D ] 87
 1706 DC I1'23,6' DEY 88
 0701 DC I1'7,1' BIT IMM 89
 3606 DC I1'54,6' TXA 8A
 4615 DC I1'70,21' PHB 8B
 3203 DC I1'50,2' STY ABS 8C
 3002 DC I1'48,2' STA ABS 8D
 3102 DC I1'49,2' STX ABS 8E
 3003 DC I1'48,3' STA ABS L 8F
 040F DC I1'4,15' BC 90
 3007 DC I1'48,7' STA (D),Y 91
 3012 DC I1'48,18' STA (D) 92
 3017 DC I1'48,23' STA (SR),Y 93
 320A DC I1'50,10' STY D,X 94
 300A DC I1'48,10' STA D,X 95
 310B DC I1'49,11' STX D,Y 96
 3008 DC I1'48,8' STA (DL),Y 97
 3806 DC I1'56,6' TYA 98
 300E DC I1'48,14' STA ABS,Y 99
 3706 DC I1'55,6' TXS D 9A
 4F06 DC I1'79,6' TXY 9B
 3E02 DC I1'62,2' STZ ABS 9C
 300C DC I1'48,12' STA ABS,X 9D
 3E0C DC I1'62,12' STZ ABS,X 9E
 300D DC I1'48,13' STA ABSL,X 9F
 2001 DC I1'32,1' LDY IMM A0
 1E09 DC I1'30,9' LDA (D,X) A1
 1F01 DC I1'31,1' LDX IMM A2
 1E16 DC I1'30,22' LDA SR A3
 2004 DC I1'32,4' LDY D A4
 1E04 DC I1'30,4' LDA D A5
 1F04 DC I1'31,4' LDX D A6
 1E13 DC I1'30,19' LDA (DL) A7
 3406 DC I1'52,6' TAY A8
 1E01 DC I1'31,1' LDA IMM A9
 3306 DC I1'51,6' TAX AA
 4415 DC I1'68,21' PLB AB
 2002 DC I1'32,2' LDY ABS AC
 1E02 DC I1'30,2' LDA ABS AD
 1F02 DC I1'31,2' LDX ABS AE
 1E03 DC I1'30,3' LDA ABS L AF
 050F DC I1'5,15' BCS B0
 1E07 DC I1'30,7' LDA (D),Y B1
 1E12 DC I1'30,18' LDA (D) B2
 1E17 DC I1'30,23' LDA (SR),Y B3
 200A DC I1'32,10' LDY D,X B4
 1E0A DC I1'30,10' LDA D,X B5
 1E0B DC I1'30,11' LDX D,Y B6
 1E08 DC I1'30,8' LDA (DL),Y B7
 1106 DC I1'17,6' CLV B8
 1E0E DC I1'30,14' LDA ABS,Y B9
 3506 DC I1'53,6' TSX BA
 5006 DC I1'80,6' TYX BB
 200C DC I1'32,12' LDY ABS,X BC
 1E0C DC I1'30,12' LDA ABS,X BD
 1F0E DC I1'31,14' LDX ABS,Y BE
 1E0D DC I1'30,13' LDA ABSL,X BF
 1401 DC I1'30,13' CPY C0
 1209 DC I1'18,9' CMP (D,X) C1
 4901 DC I1'73,1' REP C2
 1216 DC I1'18,22' CMP C3
 1404 DC I1'20,4' CPY D C4
 1204 DC I1'18,4' CMP D C5
 1504 DC I1'21,4' DEC D C6
 1213 DC I1'18,19' CMP (DL) C7
 1B06 DC I1'27,6' INY C8
 1201 DC I1'18,1' CMP IMM C9
 1606 DC I1'22,6' DEX CA
 5906 DC I1'89,6' WAI CB
 1402 DC I1'20,2' CPY ABS CC
 1202 DC I1'18,2' CMP ABS CD
 1502 DC I1'21,2' DEC ABS CE
 1203 DC I1'18,3' CMP ABSL CF
 090F DC I1'9,15' BNE D0
 1207 DC I1'18,7' CMP (D0,Y D1
 1212 DC I1'18,18' CMP (D) D2
 1217 DC I1'18,23' CMP D3
 4204 DC I1'66,4' PEI D D4
 120A DC I1'18,10' CMP D,X D5
 150A DC I1'21,10' DEC D,X D6
 1208 DC I1'18,8' CMP (DL),Y D7
 0F06 DC I1'15,6' CLD D8
 120E DC I1'18,14' CMP ABS,Y D9
 3C15 DC I1'60,21' PHX DA
 6406 DC I1'100,6' STP DB
 1C11 DC I1'28,17' JMP (A) DC
 120C DC I1'18,12' CMP ABS,X DD
 150C DC I1'21,12' DEC ABS,X DE
 120D DC I1'18,13' CMP ABSL,X DF
 1301 DC I1'19,1' CPX IMM E0
 2C09 DC I1'44,9' SBC (D,X) E1
 4A01 DC I1'74,1' SEP IMM E2
 2C16 DC I1'44,22' SBC SR E3
 1F04 DC I1'31,4' LDX D E4
 2C04 DC I1'44,4' SBC D E5
 1904 DC I1'25,4' INC D E6
 2C13 DC I1'44,19' SBD (DL) E7
 1A06 DC I1'26,6' INX D E8
 2C01 DC I1'44,1' SBC IMM E9
 2206 DC I1'34,6' NOP EA
 5106 DC I1'81,6' XBA EB
 1302 DC I1'19,2' CPX ABS EC
 2C02 DC I1'44,2' SBC ABS ED
 1902 DC I1'25,2' INC ABS EE
 2C03 DC I1'44,3' SBC ABSL EF
 060F DC I1'6,15' BEQ F0
 2C07 DC I1'44,7' SBC (D),Y F1
 2C12 DC I1'44,18' SBC (D) F2
 2C17 DC I1'44,23' SBC (SR),Y F3
 4102 DC I1'65,2' PEA F4
 2C0A DC I1'44,10' SBC D,X F5
 190A DC I1'25,10' INC D,X F6
 2C08 DC I1'44,8' SBC (DL),Y F7
 2E06 DC I1'46,6' SED F8
 2C0E DC I1'44,14' SBC ABS,Y F9
 3A15 DC I1'58,21' PLX FA
 5206 DC I1'82,6' XCE FB
 1D14 DC I1'29,20' JSR (A,X) FC
 2C0C DC I1'44,12' SBC ABS,X FD
 190C DC I1'25,12' INC ABS,X FE
 2C0D DC I1'44,13' SBC ABSL,X FF

