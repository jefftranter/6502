; This came from https://osi.marks-lab.com/reference/files/OS65D-disassembly.zip
;
;	DISASSEMBLY OF
;
;	COPIER UTILITY
;
;	FROM OS-65D V3.3 DISK5 (TRACK XX, SECTOR X)
;
; CONTAINS 2 COMPLETE COPIES OF PROGRAM SO IT RUNS AT
; EITHER $327E OR $3A7E. A BASIC ROUTINE TACKED ON AT
; THE END DETERMINES WHICH ONE TO BOOT.
;
; Z-PAGE USAGE
; 0	SOURCE DRV#
; 1	DEST DRV#
; 2	TRACK#
; 5-7	FIRST 3 BYTES FROM TRK 0
; 9	TEMP
; A	TEMP
; B	STACK POINTER
; 2E79	1-PAGE BUFFER - HOLDS TRK#/SEC# READ

DISK	=	$C000

	*=	$3279

	.WORD	$3D83
	.WORD	$3DCB
	.BYTE	2

L327E	LDA	#>$2E1E
	STA	$E2
	LDA	#<$2E1E
	STA	$E1
	LDA	$2AC6	; DEFAULT I/O DEVICE
	STA	$2321
	STA	$2322
	LDA	#<L35E8
	LDY	#>L35E8
	JSR	$2A7D	; SET ERROR HANDLER
	JSR	$2D73

	.BYTE	$1B,$1C
	.BYTE	$D,$A,$A
	.BYTE	'- Diskette copier -',$D,$A,$A
	.BYTE	'Copy from which drive (A/B/C/D) ? ',0

	JSR	L344A
	STA	0
	JSR	$2D73

	.BYTE	$D,$A
	.BYTE	'Copy to which drive (A/B/C/D) ? ',0

	JSR	L344A
	STA	1	; DEST DRV#
	JSR	$2D73

	.BYTE	$D,$A
	.BYTE	'What is the last track to be copied (Inclusive) <0-39> ? ',0

	JSR	L3485
	STA	$C
	STA	3
	INC	3	; LAST TRACK+1

L334F	JSR	$2D73

	.BYTE	$D,$A
	.BYTE	'Are you ready to start copying (Y/N) ? ',0

	JSR	$2C9B	; INPUT STRING
	LDA	#0
	STA	2
	STA	$2CE5
	JSR	$2CE4	; GET CHARACTER (A)
	CMP	#'Y'
	BEQ	L3390
	JMP	L327E

L3390	JSR	L36D1
	JSR	$2761	; UNLOAD HEAD
	JSR	$2663	; GO TO TRACK 0
	JSR	$2D73

	.BYTE	$D,$A,$A
	.BYTE	'Do you want to copy another diskette (Y/N) ? ',0

	JSR	$2C9B	; INPUT STRING
	LDA	#0
	STA	$2CE5
	JSR	$2CE4	; GET CHARACTER (A)
	CMP	#'Y'
	BNE	L33DF
	JMP	L334F

L33DF	JSR	$2D73

	.BYTE	$D,$A,$A
	.BYTE	'Please, put the tutorial disk in drive A and depress <RETURN>.',0

	JSR	$2C9B	; INPUT STRING
	LDA	#1
	JSR	$29C6	; SELECT DRIVE (A)
	JSR	$2663	; GO TO TRACK 0
	PLA
	PLA
	JSR	$2CF7	; PAGE 0/1 SWAP
	LDA	#>L343F
	STA	$C7+1
	LDA	#<L343F
	STA	$C7
	JMP	$FFEA

L343F	.BYTE	':',$89,'"BEXEC*"',0	; BASIC RUN COMMAND

L344A	JSR	$2C9B	; INPUT STRING
	LDA	#0
	STA	$2CE5
L3452	JSR	$2CE4	; GET CHARACTER (A)
	CMP	#'A'
	BMI	L3460
	CMP	#'D'+1
	BPL	L3460
	AND	#7
	RTS

L3460	JSR	$2D73

	.BYTE	$D,$A
	.BYTE	'** Bad name **',$D,$A
	.BYTE	'Try again ? ',0

	JMP	L344A

;

L3485	JSR	$2C9B	; INPUT STRING
	LDA	#0
	STA	$2CE5
	STA	4
L348F	JSR	$2CE4	; GET CHARACTER (A)
	CMP	#$D
	BNE	L349D
	LDA	4
	CMP	#'9'+1
	BPL	L34B5
	RTS

L349D	CMP	#'0'
	BMI	L34B5
	CMP	#'9'+1
	BPL	L34B5
	AND	#$F
	ASL	A
	ASL	A
	ASL	A
	ASL	A
	LDX	#4
L34AD	ASL	A
	ROL	4
	DEX
	BNE	L34AD
	BEQ	L348F

L34B5	JSR	$2D73

	.BYTE	$D,$A
	.BYTE	'** Bad track number **',$D,$A
	.BYTE	'Try again ? ',0

	JMP	L3485

; WRITE TRACK 0

L34E2	JSR	$2663	; GO TO TRACK 0
	JSR	$2754	; LOAD HEAD
L34E8	LDA	DISK
	BPL	L34E8
L34ED	LDA	DISK
	BMI	L34ED
	LDA	#$FC
	AND	DISK+2
	STA	DISK+2
L34FA	LDA	DISK
	BPL	L34FA
	LDX	#1
	JSR	$267A	; DELAY (X)
	LDX	5
	JSR	$27C2	; OUTPUT DISK CHAR (X)
	LDX	6
	JSR	$27C2	; OUTPUT DISK CHAR (X)
	LDX	7
	JSR	$27C2	; OUTPUT DISK CHAR (X)
	LDY	#0
L3515	LDA	($FE),Y
	TAX
	JSR	$27C2	; OUTPUT DISK CHAR (X)
	INY
	BNE	L3515
	INC	$FF
	DEC	7
	BNE	L3515
L3524	LDA	DISK
	BMI	L3524
	LDA	#$83
	JSR	$2763
L352E	RTS

; READ TRACK 0

L352F	JSR	$2754	; LOAD HEAD
	JSR	$271D	; WAIT FOR END OF INDEX PULSE
	JSR	$272E	; RESET DISK ACIA
	JSR	L3563
	BCC	L352E
	STA	5
	JSR	L3563
	BCC	L352E
	STA	6
	JSR	L3563
	STA	7
	TAX
	LDY	#0
L354E	LDA	#1
L3550	BIT	DISK+$10
	BEQ	L3550
	LDA	DISK+$11
	STA	($FE),Y
	INY
	BNE	L354E
	INC	$FF
	DEX
	BNE	L354E
	RTS

; READ NEXT DISK CHAR (A), CC=EOT

L3563	CLC
L3564	LDA	DISK
	BPL	L3572	; INDEX PULSE
	LDA	DISK+$10
	LSR	A
	BCC	L3564
	LDA	DISK+$11
L3572	RTS

; NEXT BCD TRACK# (A), BCS=NO MORE

L3573	SED
	LDA	2
	CLC
	ADC	#1
	CLD
	CMP	3
L357C	RTS

; READ/COMPARE DOS TRACK

L357D	JSR	$26BC	; GO TO TRACK (A) BCD
	JSR	$271D	; WAIT FOR END OF INDEX PULSE
	JSR	$272E	; RESET DISK ACIA
	LDA	#0
	STA	$A
L358A	INC	$A	; SEC#
L358C	JSR	L3563	; WAIT FOR SECTOR ID
	BCC	L35EE
L3591	CMP	#'v'
	BNE	L358C
	JSR	L3563	; GET SEC#
	CMP	$A
	BNE	L3591	; MATCH?

	JSR	L3563	; #PAGES IN SECTOR
	TAX
	LDY	9	; INDEX

	DEC	$A	; FIRST SECTOR?
	BNE	L35AC	; NO
	LDA	2	; SAVE TRK#
	STA	$2E79,Y
	INY
L35AC	TXA
	STA	$2E79,Y	; SAVE #PAGES IN SECTOR
	INY
	STY	9
	INC	$A	; RESTORE SEC#

	LDY	#0
L35B7	LDA	#1
L35B9	BIT	DISK+$10 ; WAIT FOR CHAR
	BEQ	L35B9
	LDA	DISK+$11 ; CHAR
	BVS	L35D7
	CMP	($FE),Y
	STA	($FE),Y
	BEQ	L35CD
L35C9	LDA	#0	; 0=COMPARE
	BEQ	L35E8	; COMPARE ERROR
L35CD	INY
	BNE	L35B7	; GET 256 BYTES
	INC	$FF	; BUMP PAGE
	DEX
	BNE	L35B7
	BEQ	L358A	; NEXT SECTOR

L35D7	JSR	$2D73

	.BYTE	'** Parity ** ',0

; ERROR HANDLER

L35E8	LDX	$B
	TXS
	JMP	L3776

L35EE	DEC	$A	; SEC#
	BEQ	L357C
	INC	9	; INDEX
	RTS

; WRITE DOS TRACKS

L35F5	JSR	$2754	; LOAD HEAD
	LDX	#$FF
L35FA	JSR	$2D6A	; PRINT CRLF
	INX
	LDA	$2E79,X	; TRACK#
	BEQ	L364D	; DONE
	STX	$A	; INDEX
	PHA
	JSR	$2D73

	.BYTE	'Track ',0

	PLA
	PHA
	JSR	$2D92	; PRINT BCD NUMBER (A)
	PLA
	JSR	$26BC	; GO TO TRACK (A) BCD
	LDX	$A	; INDEX
	LDA	#0
	STA	$265E	; SEC#
L3620	INX
	LDA	$2E79,X	; PAGES
	BEQ	L35FA	; NEXT TRACK
	STX	$A	; INDEX
	STA	$265F
	INC	$265E	; FIRST SEC# = 1
	JSR	$2D73

	.BYTE	' - ',0

	LDA	$265E
	JSR	$2D92	; PRINT BCD NUMBER (A)
	JSR	$2D73

	.BYTE	'/',0

	LDA	$265F	; PAGES
	JSR	$2D92	; PRINT BCD NUMBER (A)
	JSR	$27E1	; WRITE SECTOR TO DISK ($FE)
	LDX	$A	; INDEX
	BNE	L3620
L364D	JMP	$2761	; UNLOAD HEAD

; SELECT DEST DISK, RESET RAM POINTER

L3650	LDA	1	; DEST DRV#
	CMP	0	; SOURCE DRV#
	BNE	L36BD
	PHA
	JSR	$2D6A	; PRINT CRLF
	JSR	$2D73

	.BYTE	$A,$A
	.BYTE	'Insert blank',0

; INSERT DISK MESSAGE

L366C	JSR	$2D73

	.BYTE	' diskette -- press <RETURN> ?',0

L368D	JSR	$2340	; INPUT CHAR (A) FROM KEYBOARD WITH ECHO
	PHA
	JSR	$2D6A	; PRINT CRLF
	PLA
	CMP	#$D
	BNE	L368D
	PLA
	JMP	L36BD

; SELECT SOURCE DISK, RESET RAM POINTER

L369D	LDA	0	; SOURCE DRV#
	CMP	1	; DEST DRV#
	BNE	L36BD
	PHA
	JSR	$2D6A	; PRINT CRLF
	JSR	$2D73

	.BYTE	$A,$A
	.BYTE	'Insert master',0

	JMP	L366C

L36BD	JSR	$29C6	; SELECT DRIVE (A)
	JSR	$2663	; GO TO TRACK 0
	JSR	$2D6A	; PRINT CRLF
	LDA	L37D2+1
	STA	$FE
	LDA	L37D2
	STA	$FF
	RTS

; DO COPY

L36D1	TSX
	STX	$B
	JSR	L369D	; SELECT SOURCE
	STA	L35C9+1	; ALWAYS NZ
	JSR	L352F	; READ TRACK 0
	PHP		; SAVE RESULT
	JSR	L379C	; READ DOS TRACKS
	JSR	L3650	; SELECT DEST
	LDA	$C	; LAST TRACK = 0 ?
	BEQ	L3707	; SKIP FORMAT
	STA	$2779	; PATCH HIGH TRACK
	JSR	$2D73

	.BYTE	'Initializing -- ',0

	JSR	$2768	; FORMAT DISK
	LDA	#$39	; RESTORE HIGH TRACK#
	STA	$2779

L3707	JSR	$2D6A	; PRINT CRLF
	PLP
	BCC	L3710	; TRACK 0 READ FAILED
	JSR	L34E2	; WRITE TRACK 0
L3710	LDA	9
	BNE	L3721

L3714	JSR	L369D	; SELECT SOURCE
	JSR	L379C	; READ DOS TRACKS
	LDA	9
	BEQ	L3727
	JSR	L3650	; SELECT DEST
L3721	JSR	L35F5	; WRITE DOS TRACKS
	JMP	L3714

; COMPARE

L3727	RTS		; DISABLED ???
	.WORD	$2D73
	.BYTE	$A,$A
	.BYTE	'Comparing diskettes -- ',0

	LDA	#0
	STA	2	; TRK#
	JSR	L352F	; READ TRACK 0
	JSR	L37AB	; READ DOS TRACKS (NO MSG)
	LDA	2	; TRK#
	PHA
	LDA	#0
	STA	L35C9+1
	STA	2	; TRK#
	JSR	L3650	; SELECT DEST
	JSR	L352F	; READ TRACK 0
	JSR	L37AB	; READ DOS TRACKS (NO MSG)
	PLA
	CMP	2	; TRK#
	BNE	L3776
	JSR	$2D73

	.BYTE	'Good thru',0

	JMP	L3788

L3776	JSR	$2D73

	.BYTE	'Error found on',0

L3788	JSR	$2D73

	.BYTE	' track ',0

	LDA	2	; TRK#
	JSR	$2D92	; PRINT BCD NUMBER (A)
	JSR	$2D6A	; PRINT CRLF
	RTS

; READ DOS TRACKS

L379C	JSR	$2D73

	.BYTE	'Reading -- ',0

L37AB	LDA	#0
	STA	9
	TAX
L37B0	STA	$2E79,X	; ERASE TEMP BUFFER
	DEX
	BNE	L37B0
	JSR	$2754	; LOAD HEAD
L37B9	JSR	L3573	; NEXT TRK#
	BCS	L37CC
	STA	2
	JSR	L357D	; READ DOS TRACK
	LDA	$FF
	ADC	#$C	; ALLOW 12 PAGES
	CMP	$2300	; TOP OF RAM
	BCC	L37B9
L37CC	JSR	$2761	; UNLOAD HEAD
	JMP	$2D6A	; PRINT CRLF


L37D2	.DBYTE	L37D4	; RAM BUFFER POINTER

L37D4

; END OF PROGRAM 1

	LDA	#$2E
	STA	$E2
	LDA	#$1E
	STA	$E1
	LDA	$2AC6
	STA	$2321
	STA	$2322
	LDA	#$3E
	LDY	#$43
	JSR	$2A7D		; SET ERROR HANDLER
	JSR	$2D73

	.BYTE	$1B,$1C
	.BYTE	$D,$A,$A
	.BYTE	'- Diskette copier -',$D,$A,$A
	.BYTE	'Copy from which drive (A/B/C/D) ? ',0

	JSR	L41A0
	STA	0	; SOURCE DRV#
	JSR	$2D73

	.BYTE	$D,$A
	.BYTE	'Copy to which drive (A/B/C/D) ? ',0

	JSR	L41A0
	STA	1	; DEST DRV#
	JSR	$2D73

	.BYTE	$D,$A
	.BYTE	'What is the last track to be copied (Inclusive) <0-39> ? ',0

	JSR	L41DB
	STA	$C	; LAST TRACK
	STA	3
	INC	3
	JSR	$2D73

	.BYTE	$D,$A
	.BYTE	'Are you ready to start copying (Y/N) ? ',0

	JSR	$2C9B	; INPUT STRING
	LDA	#0
	STA	2	; TRK#
	STA	$2CE5
	JSR	$2CE4	; GET CHARACTER (A)
	CMP	#'Y'
	BEQ	L38E6
	JMP	L3FD4

L38E6	JSR	$4427
	JSR	$2761	; UNLOAD HEAD
	JSR	$2663	; GO TO TRACK 0
	JSR	$2D73

	.BYTE	$D,$A,$A
	.BYTE	'Do you want to copy another diskette (Y/N) ? ',0

	JSR	$2C9B	; INPUT STRING
	LDA	#0
	STA	$2CE5
	JSR	$2CE4	; GET CHARACTER (A)
	CMP	#'Y'
	BNE	L3935
	JMP	L40A5

L3935	JSR	$2D73

	.BYTE	$D,$A,$A
	.BYTE	'Please, put the tutorial disk in drive A and depress <RETURN>.',0

	JSR	$2C9B	; INPUT STRING
	LDA	#1
	JSR	$29C6	; SELECT DRIVE (A)
	JSR	$2663	; GO TO TRACK 0
	PLA
	PLA
	JSR	$2CF7	; PAGE 0/1 SWAP
	LDA	#>L4195
	STA	$C7+1
	LDA	#<L4195
	STA	$C7
	JMP	$FFEA

L3995	.BYTE	':',$89,'"BEXEC*"',0	; BASIC RUN COMMAND

	JSR	$2C9B	; INPUT STRING
	LDA	#0
	STA	$2CE5
	JSR	$2CE4	; GET CHARACTER (A)
	CMP	#'A'
	BMI	L39B6
	CMP	#'D'+1
	BPL	L39B6
	AND	#7
	RTS

L39B6	JSR	$2D73

	.BYTE	$D,$A
	.BYTE	'** Bad name **',$D,$A
	.BYTE	'Try again ? ',0

	JMP	L41A0

	JSR	$2C9B	; INPUT STRING
	LDA	#0
	STA	$2CE5
	STA	4
L39E5	JSR	$2CE4	; GET CHARACTER (A)
	CMP	#$D
	BNE	L39F3
	LDA	4
	CMP	#'9'+1
	BPL	L3A0B
	RTS

L39F3	CMP	#'0'
	BMI	L3A0B
	CMP	#'9'+1
	BPL	L3A0B
	AND	#$F
	ASL	A
	ASL	A
	ASL	A
	ASL	A
	LDX	#4
L3A03	ASL	A
	ROL	4
	DEX
	BNE	L3A03
	BEQ	L39E5

L3A0B	JSR	$2D73

	.BYTE	$D,$A
	.BYTE	'** Bad track number **',$D,$A
	.BYTE	'Try again ? ',0

	JMP	L41DB

	JSR	$2663	; GO TO TRACK 0
	JSR	$2754	; LOAD HEAD
L3A3E	LDA	DISK
	BPL	L3A3E
L3A43	LDA	DISK
	BMI	L3A43
	LDA	#$FC
	AND	DISK+2
	STA	DISK+2
L3A50	LDA	DISK
	BPL	L3A50
	LDX	#1
	JSR	$267A	; DELAY (X)
	LDX	5
	JSR	$27C2	; OUTPUT DISK CHAR (X)
	LDX	6
	JSR	$27C2	; OUTPUT DISK CHAR (X)
	LDX	7
	JSR	$27C2	; OUTPUT DISK CHAR (X)
	LDY	#0
L3A6B	LDA	($FE),Y
	TAX
	JSR	$27C2	; OUTPUT DISK CHAR (X)
	INY
	BNE	L3A6B
	INC	$FF
	DEC	7
	BNE	L3A6B
L3A7A	LDA	DISK
	BMI	L3A7A
	LDA	#$83
	JSR	$2763
L3A84	RTS

	JSR	$2754	; LOAD HEAD
	JSR	$271D	; WAIT FOR END OF INDEX PULSE
	JSR	$272E	; RESET DISK ACIA
	JSR	$42B9
	BCC	L3A84
	STA	5
	JSR	$42B9
	BCC	L3A84
	STA	6
	JSR	$42B9
	STA	7
	TAX
	LDY	#0
L3AA4	LDA	#1
L3AA6	BIT	DISK+$10
	BEQ	L3AA6
	LDA	DISK+$11
	STA	($FE),Y
	INY
	BNE	L3AA4
	INC	$FF
	DEX
	BNE	L3AA4
	RTS

	CLC
L3ABA	LDA	DISK
	BPL	L3AC8
	LDA	DISK+$10
	LSR	A
	BCC	L3ABA
	LDA	DISK+$11
L3AC8	RTS

	SED
	LDA	2	; TRK#
	CLC
	ADC	#1
	CLD
	CMP	3
L3AD2	RTS

	JSR	$26BC	; GO TO TRACK (A) BCD
	JSR	$271D	; WAIT FOR END OF INDEX PULSE
	JSR	$272E	; RESET DISK ACIA
	LDA	#0
	STA	$A
L3AE0	INC	$A	; SEC#
L3AE2	JSR	$42B9
	BCC	L3B44
L3AE7	CMP	#'v'
	BNE	L3AE2
	JSR	$42B9
	CMP	$A
	BNE	L3AE7
	JSR	$42B9
	TAX
	LDY	9
	DEC	$A	; SEC#
	BNE	L3B02
	LDA	2	; TRK#
	STA	$2E79,Y
	INY
L3B02	TXA
	STA	$2E79,Y
	INY
	STY	9
	INC	$A	; SEC#
	LDY	#0
L3B0D	LDA	#1
L3B0F	BIT	$C010
	BEQ	L3B0F
	LDA	$C011
	BVS	L3B2D
	CMP	($FE),Y
	STA	($FE),Y
	BEQ	L3B23
	LDA	#0
	BEQ	L3B3E

L3B23	INY
	BNE	L3B0D
	INC	$FF
	DEX
	BNE	L3B0D
	BEQ	L3AE0
L3B2D	JSR	$2D73

	.BYTE	'** Parity ** ',0

; ERROR HANDLER

L3B3E	LDX	$B
	TXS
	JMP	$44CC

L3B44	DEC	$A	; SEC#
	BEQ	L3AD2
	INC	9
	RTS

	JSR	$2754	; LOAD HEAD
	LDX	#$FF
L3B50	JSR	$2D6A	; PRINT CRLF
	INX
	LDA	$2E79,X
	BEQ	L3BA3
	STX	$A	; SEC#
	PHA
	JSR	$2D73

	.BYTE	'Track ',0

	PLA
	PHA
	JSR	$2D92	; PRINT BCD NUMBER (A)
	PLA
	JSR	$26BC	; GO TO TRACK (A) BCD
	LDX	$A	; SEC#
	LDA	#0
	STA	$265E
L3B76	INX
	LDA	$2E79,X
	BEQ	L3B50
	STX	$A	; SEC#
	STA	$265F
	INC	$265E
	JSR	$2D73

	.BYTE	' - ',0

	LDA	$265E
	JSR	$2D92	; PRINT BCD NUMBER (A)
	JSR	$2D73

	.BYTE	'/',0

	LDA	$265F
	JSR	$2D92	; PRINT BCD NUMBER (A)
	JSR	$27E1	; WRITE SECTOR TO DISK ($FE)
	LDX	$A	; SEC#
	BNE	L3B76
L3BA3	JMP	$2761	; UNLOAD HEAD

	LDA	1	; DEST DRV#
	CMP	0	; SOURCE DRV#
	BNE	L3C13
	PHA
	JSR	$2D6A	; PRINT CRLF
	JSR	$2D73

	.BYTE	$A,$A
	.BYTE	'Insert blank',0

	JSR	$2D73

	.BYTE	$20
	.BYTE	'diskette -- press <RETURN> ?',0

L3BE3	JSR	$2340	; INPUT CHAR (A) FROM KEYBOARD WITH ECHO
	PHA
	JSR	$2D6A	; PRINT CRLF
	PLA
	CMP	#$D
	BNE	L3BE3
	PLA
	JMP	$4413

	LDA	0	; SOURCE DRV#
	CMP	1	; DEST DRV#
	BNE	L3C13
	PHA
	JSR	$2D6A	; PRINT CRLF
	JSR	$2D73

	.BYTE	$A,$A
	.BYTE	'Insert master',0

	JMP	$43C2

L3C13	JSR	$29C6	; SELECT DRIVE (A)
	JSR	$2663	; GO TO TRACK 0
	JSR	$2D6A	; PRINT CRLF
	LDA	$4529
	STA	$FE
	LDA	$4528
	STA	$FF
	RTS

	TSX
	STX	$B
	JSR	$43F3
	STA	$4320
	JSR	$4285
	PHP
	JSR	$44F2
	JSR	$43A6
	LDA	$C	; LAST TRACK
	BEQ	L3C5D
	STA	$2779	; PATCH HIGH TRACK#
	JSR	$2D73

	.BYTE	'Initializing -- ',0

	JSR	$2768	; FORMAT DISK
	LDA	#$39	; RESTORE HIGH TRACK#
	STA	$2779
L3C5D	JSR	$2D6A	; PRINT CRLF
	PLP
	BCC	L3C66
	JSR	$4238
L3C66	LDA	9
	BNE	L3C77
	JSR	$43F3
	JSR	$44F2
	LDA	9
	BEQ	L3C7D
	JSR	$43A6
L3C77	JSR	$434B
	JMP	$446A

L3C7D	RTS
	.WORD	$2D73

	.BYTE	$A,$A
	.BYTE	'Comparing diskettes -- ',0

	LDA	#0
	STA	2	; TRK#
	JSR	$4285
	JSR	$4501
	LDA	2	; TRK#
	PHA
	LDA	#0
	STA	$4320
	STA	2	; TRK#
	JSR	$43A6
	JSR	$4285
	JSR	$4501
	PLA
	CMP	2	; TRK#
	BNE	L3CCC
	JSR	$2D73

	.BYTE	'Good thru',0

	JMP	$44DE

L3CCC	JSR	$2D73

	.BYTE	'Error found on',0

	JSR	$2D73

	.BYTE	' track ',0

	LDA	2	; TRK#
	JSR	$2D92	; PRINT BCD NUMBER (A)
	JSR	$2D6A	; PRINT CRLF
	RTS

	JSR	$2D73

	.BYTE	'Reading -- ',0

	LDA	#0
	STA	9
	TAX
L3D06	STA	$2E79,X
	DEX
	BNE	L3D06
	JSR	$2754	; LOAD HEAD
L3D0F	JSR	$42C9
	BCS	L3D22
	STA	2	; TRK#
	JSR	$42D3
	LDA	$FF
	ADC	#$C
	CMP	$2300
	BCC	L3D0F
L3D22	JSR	$2761	; UNLOAD HEAD
	JMP	$2D6A	; PRINT CRLF

	.BYTE	$45,$2A,$B8,$2A,$28,$60,$28,$92
	.BYTE	$02,$40,$42,$00,$3A,$01,$03,$0A
	.BYTE	$E2,$7E,$E8,$CE,$BA,$00,$90,$CA
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	.BYTE	$00,$00,$00

; BASIC PROGRAM

	.WORD	$3D90
	.WORD	10
	.BYTE	$8E,' COPIER'
	.BYTE	0
	.WORD	$3DAC
	.WORD	20
	.BYTE	$8A,$BB,'(8999)'
	.BYTE	$AB,'50'
	.BYTE	$A0,$94,'!"GO 327E"'
	.BYTE	0
	.WORD	$3DC8
	.WORD	30
	.BYTE	$8A,$BB,'(8999)'
	.BYTE	$AB,'58'
	.BYTE	$A0,$94,'!"GO 3FD4"'
	.BYTE	0
	.WORD	0

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	.BYTE	$20,$20
L3FD4	.BYTE	$3A,$3A,$3A,$3A,$3A,$3A
	.BYTE	$3A,$3A,$3A,$3A,$00,$E5,$3F,$82
	.BYTE	$00,$8E,$00,$EB,$3F,$8C,$00,$8E
	.BYTE	$00,$17,$40,$96,$00,$8E,$20,$20
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	.BYTE	$DC,$00,$81
L40A5	.BYTE	$20,$58,$AB,$31,$20
	.BYTE	$9D,$20,$33,$33,$3A,$20,$97,$3A
	.BYTE	$20,$82,$00,$D7,$40,$E6,$00,$97
	.BYTE	$20,$22,$3A,$3A,$3A,$3A,$3A,$3A
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	.BYTE	$18,$01,$8A
L4195	.BYTE	$20,$C1,$28,$51,$41
	.BYTE	$24,$2C,$31,$29,$AB,$22
L41A0	.BYTE	$45,$22
	.BYTE	$20,$88,$20,$33,$35,$30,$00,$C3
	.BYTE	$41,$22,$01,$8A,$20,$C1,$28,$51
	.BYTE	$41,$24,$2C,$31,$29,$AB,$22,$44
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	.BYTE	$20
L41DB	.BYTE	$32,$33,$30,$00,$E5,$41,$36
	.BYTE	$01,$8E,$00,$EB,$41,$40,$01,$8E
	.BYTE	$00,$0A,$42,$4A,$01,$8E,$20,$46
	.BYTE	$49,$4E,$44,$20,$4F,$55,$54,$20
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	.BYTE	$75,$67,$68,$20,$6D,$65,$6D

	.END
