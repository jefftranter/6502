; This came from https://osi.marks-lab.com/reference/files/BASIC65D-disassembly.zip
;
;	BASIC FROM OS65D 3.3
;

	*=	$200

L0200	.WORD	L082A-1	; END
	.WORD	L0748-1	; FOR
	.WORD	L0C4B-1	; NEXT
	.WORD	L08F9-1	; DATA
	.WORD	L0B2C-1	; INPUT
	.WORD	L0F24-1	; DIM
	.WORD	L0B58-1	; READ
	.WORD	L09A6-1	; LET
	.WORD	L08A6-1	; GOTO
	.WORD	L087E-1	; RUN
	.WORD	L0929-1	; IF
	.WORD	L080A-1	; RESTORE
	.WORD	L0889-1	; GOSUB
	.WORD	L08D3-1	; RETURN
	.WORD	L093C-1	; REM
	.WORD	L0828-1	; STOP
	.WORD	L094C-1	; ON
	.WORD	$3770-1	; EDIT
	.WORD	L169C-1	; TRAP
	.WORD	L223C-1	; EXIT
	.WORD	L2253-1	; DISK
	.WORD	L1235-1	; DEF
	.WORD	L1693-1	; POKE
L022E	.WORD	L2059-1	; PRINT ($21AA-1 WHEN ATN ENABLED)
	.WORD	L0853-1	; CONT
	.WORD	L06B9-1	; LIST
	.WORD	L067C-1	; CLEAR
	.WORD	L0662-1	; NEW

	.WORD	L1B34	; SGN
	.WORD	L1BC7	; INT
	.WORD	L1B53	; ABS
	.WORD	L22F7	; USR
	.WORD	L1204	; FRE
	.WORD	L1225	; POS
	.WORD	L1E45	; SQR
	.WORD	L1F66	; RND
	.WORD	L18B3	; LOG
	.WORD	L1EC1	; EXP
	.WORD	L1FA2	; COS
	.WORD	L1FA9	; SIN
	.WORD	L1FF2	; TAN
	.WORD	L2056	; ATN
	.WORD	L1688	; PEEK
	.WORD	L15F6	; LEN
	.WORD	L12E9	; STR$
	.WORD	L1627	; VAL
	.WORD	L1605	; ASC
	.WORD	L1566	; CHR$
	.WORD	L157A	; LEFT$
	.WORD	L15A6	; RIGHT$
	.WORD	L15B1	; MID$

L0266	.BYTE	$79
	.WORD	L16D9-1	; +
	.BYTE	$79
	.WORD	L16C2-1	; -
	.BYTE	$7B
	.WORD	L18F4-1	; *
	.BYTE	$7B
	.WORD	L1A0D-1	; /
	.BYTE	$7F
	.WORD	L1E4F-1	; ^
	.BYTE	$50
	.WORD	L0E8C-1	; AND
	.BYTE	$46
	.WORD	L0E89-1	; OR
	.BYTE	$7D
	.WORD	L1E88-1	; NEGATE
	.BYTE	$5A
	.WORD	L0DEA-1	; NOT
	.BYTE	$64
	.WORD	L0EB9-1	; < = >

L0284	.BYTE	'EN',$C4	; END
	.BYTE	'FO',$D2	; FOR
	.BYTE	'NEX',$D4	; NEXT
	.BYTE	'DAT',$C1	; DATA
	.BYTE	'INPU',$D4	; INPUT
	.BYTE	'DI',$CD	; DIM
	.BYTE	'REA',$C4	; READ
	.BYTE	'LE',$D4	; LET
	.BYTE	'GOT',$CF	; GOTO
	.BYTE	'RU',$CE	; RUN
	.BYTE	'I',$C6		; IF
	.BYTE	'RESTOR',$C5	; RESTORE
	.BYTE	'GOSU',$C2	; GOSUB
	.BYTE	'RETUR',$CE	; RETURN
	.BYTE	'RE',$CD	; REM
	.BYTE	'STO',$D0	; STOP
	.BYTE	'O',$CE		; ON
	.BYTE	'EDI',$D4	; NULL
	.BYTE	'TRA',$D0	; WAIT
	.BYTE	'EXI',$D4	; LOAD
	.BYTE	'DIS',$CB	; SAVE
	.BYTE	'DE',$C6	; DEF
	.BYTE	'POK',$C5	; POKE
	.BYTE	'PRIN',$D4	; PRINT
	.BYTE	'CON',$D4	; CONT
L02E5	.BYTE	$A,'IS',$D4	; LIST	(DISABLED)
	.BYTE	'CLEA',$D2	; CLEAR
L02EE	.BYTE	$A,'E',$D7	; NEW	(DISABLED)
	.BYTE	'TAB',$A8	; TAB(
	.BYTE	'T',$CF		; TO
	.BYTE	'F',$CE		; FN
	.BYTE	'SPC',$A8	; SPC(
	.BYTE	'THE',$CE	; THEN
	.BYTE	'NO',$D4	; NOT
	.BYTE	'STE',$D0	; STEP
	.BYTE	$AB		; +
	.BYTE	$AD		; -
	.BYTE	$AA		; *
	.BYTE	$AF		; /
	.BYTE	$DE		; ^
	.BYTE	'AN',$C4	; AND
	.BYTE	'O',$D2		; OR
	.BYTE	$BE		; >
	.BYTE	$BD		; =
	.BYTE	$BC		; <
	.BYTE	'SG',$CE	; SGN
	.BYTE	'IN',$D4	; INT
	.BYTE	'AB',$D3	; ABS
	.BYTE	'US',$D2	; USR
	.BYTE	'FR',$C5	; FRE
	.BYTE	'PO',$D3	; POS
	.BYTE	'SQ',$D2	; SQR
	.BYTE	'RN',$C4	; RND
	.BYTE	'LO',$C7	; LOG
	.BYTE	'EX',$D0	; EXP
	.BYTE	'CO',$D3	; COS
	.BYTE	'SI',$CE	; SIN
	.BYTE	'TA',$CE	; TAN
L033C	.BYTE	$10,$10,$90	; ATN	('AT',$CE WHEN ENABLED)
	.BYTE	'PEE',$CB	; PEEK
	.BYTE	'LE',$CE	; LEN
	.BYTE	'STR',$A4	; STR$
	.BYTE	'VA',$CC	; VAL
	.BYTE	'AS',$C3	; ASC
	.BYTE	'CHR',$A4	; CHR$
	.BYTE	'LEFT',$A4	; LEFT$
	.BYTE	'RIGHT',$A4	; RIGHT$
	.BYTE	'MID',$A4	; MID$

	.BYTE	0

L0364	.BYTE	'N',$C6	; 00 NEXT WITHOUT FOR
	.BYTE	'S',$CE	; 02 SYNTAX ERROR
	.BYTE	'R',$C7	; 04 RETURN WITHOUT GOSUB
	.BYTE	'O',$C4	; 06 OUT OF DATA
	.BYTE	'F',$C3	; 08 FUNCTION CALL - ILLEGAL QUANTITY
	.BYTE	'O',$D6	; 0A OVERFLOW
	.BYTE	'O',$CD	; 0C OUT OF MEMORY
	.BYTE	'U',$D3	; 0E UNDEFINED STATEMENT
	.BYTE	'B',$D3	; 10 BAD SUBSCRIPT
	.BYTE	'D',$C4	; 12 DOUBLE DIMENSION
	.BYTE	'/',$B0	; 14 DIVIDE BY ZERO
	.BYTE	'I',$C4	; 16 ILLEGAL DIRECT
	.BYTE	'T',$CD	; 18 TYPE MISMATCH
	.BYTE	'L',$D3	; 1A LONG STRING
	.BYTE	'S',$D4	; 1C STRING TEMPORARIES - EXPR. TOO COMPLEX
	.BYTE	'C',$CE	; 1E CONTINUE ERROR
	.BYTE	'U',$C6	; 20 UNDEFINED FUNCTION

L0386	.BYTE	' ERROR',0
L038D	.BYTE	' IN ',0
L0392	.BYTE	$D,$A
	.BYTE	'Ok',$D,$A,0
L0399	.BYTE	$D,$A
	.BYTE	'BREAK',0

; SEARCH THE STACK FOR FOR OR GOSUB ACTIVITY

L03A1	TSX
	INX
	INX
	INX
	INX
L03A6	LDA	$101,X
	CMP	#$81
	BNE	L03CE
	LDA	$97
	BNE	L03BB
	LDA	$102,X
	STA	$96
	LDA	$103,X
	STA	$97
L03BB	CMP	$103,X
	BNE	L03C7
	LDA	$96
	CMP	$102,X
	BEQ	L03CE
L03C7	TXA
	CLC
	ADC	#$12
	TAX
	BNE	L03A6
L03CE	RTS

; OPEN UP SPACE IN MEMORY

L03CF	JSR	L041F
	STA	$7E
	STY	$7F
L03D6	SEC
	LDA	$A7
	SBC	$AC
	STA	$6F
	TAY
	LDA	$A8
	SBC	$AD
	TAX
	INX
	TYA
	BEQ	L040A
	LDA	$A7
	SEC
	SBC	$6F
	STA	$A7
	BCS	L03F3
	DEC	$A8
	SEC
L03F3	LDA	$A5
	SBC	$6F
	STA	$A5
	BCS	L0403
	DEC	$A6
	BCC	L0403
L03FF	LDA	($A7),Y
	STA	($A5),Y
L0403	DEY
	BNE	L03FF
	LDA	($A7),Y
	STA	($A5),Y
L040A	DEC	$A8
	DEC	$A6
	DEX
	BNE	L0403
	RTS

; TEST: STACK TOO DEEP?

L0412	ASL	A
	ADC	#$36
	BCS	L044C
	STA	$6F
	TSX
	CPX	$6F
	BCC	L044C
	RTS

; CHECK AVAILABLE MEMORY

L041F	CPY	$81
	BCC	L044B
	BNE	L0429
	CMP	$80
	BCC	L044B
L0429	PHA
	LDX	#9
	TYA
L042D	PHA
	LDA	$A4,X
	DEX
	BPL	L042D
	JSR	L13A4
	LDX	#$F7
L0438	PLA
	STA	$AE,X
	INX
	BMI	L0438
	PLA
	TAY
	PLA
	CPY	$81
	BCC	L044B
	BNE	L044C
	CMP	$80
	BCS	L044C
L044B	RTS

L044C	LDX	#$C	; OUT OF MEM

; SEND ERROR MESSAGE

L044E	LSR	$14
	JSR	L0A73
	JSR	L0AEC
	LDA	L0364,X
	JSR	L0AEE
	LDA	L0364+1,X
	JSR	$25A1
L0462	JSR	L0695
	LDA	#<L0386	; ' ERROR'
	LDY	#>L0386
L0469	JSR	L20F1
	LDY	$87
	INY
	BEQ	L0474
	JSR	$36CF

; WARM START; WAIT FOR BASIC COMMAND

L0474	LSR	$14
	LDA	#<L0392	; 'OK'
	LDY	#>L0392
	JSR	3

L047D	JSR	L0558
	STX	$C7
	STY	$C8
	JSR	$C0
	TAX
	BEQ	L047D
	LDX	#$FF
	STX	$87
	BCC	L0496
	JSR	L05A7
	JMP	L07E0

; HANDLE NEW BASIC LINE INPUT

L0496	JSR	L096C
	JSR	L05A7
	STY	$C
	JSR	L0633
	BCC	L04E7
	LDY	#1
	LDA	($AC),Y
	STA	$70
	LDA	$7A
	STA	$6F
	LDA	$AD
	STA	$72
	LDA	$AC
	DEY
	SBC	($AC),Y
	CLC
	ADC	$7A
	STA	$7A
	STA	$71
	LDA	$7B
	ADC	#$FF
	STA	$7B
	SBC	$AD
	TAX
	SEC
	LDA	$AC
	SBC	$7A
	TAY
	BCS	L04D1
	INX
	DEC	$72
L04D1	CLC
	ADC	$6F
	BCC	L04D9
	DEC	$70
	CLC
L04D9	LDA	($6F),Y
	STA	($71),Y
	INY
	BNE	L04D9
	INC	$70
	INC	$72
	DEX
	BNE	L04D9
L04E7	LDA	$1B
	BEQ	L051A
	LDA	$84
	LDY	$85
	STA	$80
	STY	$81
	LDA	$7A
	STA	$A7
	ADC	$C
	STA	$A5
	LDY	$7B
	STY	$A8
	BCC	L0502
	INY
L0502	STY	$A6
	JSR	L03CF
	LDA	$7E
	LDY	$7F
	STA	$7A
	STY	$7B
	LDY	$C
	DEY
L0512	LDA	$17,Y
	STA	($AC),Y
	DEY
	BPL	L0512
L051A	JSR	L0678
	LDA	$78
	LDY	$79
	STA	$6F
	STY	$70
	CLC
L0526	LDY	#1
	LDA	($6F),Y
	BNE	L052F
	JMP	L047D

; REBUILD CHAINING OF BASIC LINES

L052F	LDY	#4
L0531	INY
	LDA	($6F),Y
	BNE	L0531
	INY
	TYA
	ADC	$6F
	TAX
	LDY	#0
	STA	($6F),Y
	LDA	$70
	ADC	#0
	INY
	STA	($6F),Y
	STX	$6F
	STA	$70
	BCC	L0526

; RECEIVE LINE FROM KEYBOARD

L054C	JSR	L0AEE
	DEX
	BPL	L055A
L0552	JSR	L0AEE
	JSR	L0A73

; INPUT CHARS TO BASIC BUFFER

L0558	LDX	#0	; RESET BUFFER

L055A	JSR	$3819
	CMP	#7
	BEQ	L0575	; ^G
	CMP	#$D
	BEQ	L0584	; CR
	CMP	#$20
	BCC	L055A	; OTHER CTRL CHARS
	CMP	#$7D
	BCS	L055A	; 7D-7F
	CMP	#$40
	BEQ	L0552
	CMP	#$5F
	BEQ	L054C	; '_'

L0575	CPX	#$47
	BCS	L057D	; BUFFER FULL
	STA	$1B,X
	INX
	.BYTE	$2C
L057D	LDA	#7
	JSR	L0AEE
	BNE	L055A
L0584	JMP	L0A6D

; INPUT CHAR (A) FROM KEYBOARD

L0587	JSR	$2336
	RTS
	.BYTE	 $5F ; '_'
	BNE	L05A6
	PHA
	LDA	#8
	JSR	$2343
	LDA	#' '
	JSR	$2343
	LDA	#8
	JSR	$2343
	PLA
	RTS

	.BYTE	$14
	.BYTE	$49
	.BYTE	$FF
	.BYTE	$85
	.BYTE	$14
	.BYTE	$68

L05A6	RTS

; CRUNCH KEYWORDS INTO BASIC TOKENS

L05A7	LDX	$C7
	LDY	#4
	STY	$10
L05AD	LDA	0,X
	CMP	#' '
	BEQ	L05ED
	STA	$B
	CMP	#'"'
	BEQ	L0611
	BIT	$10
	BVS	L05ED
	JMP	$3801
	.BYTE	4
	LDA	#$97
	BNE	L05ED
L05C5	CMP	#$30 ; '0'
	BCC	L05CD
	CMP	#$3C ; '<'
	BCC	L05ED
L05CD	STY	$BE
	LDY	#0
	STY	$C
	DEY
	STX	$C7
	DEX
L05D7	INY
L05D8	INX
L05D9	JSR	L17B6
	NOP
	BEQ	L05D8
	SEC
	SBC	L0284,Y
	BEQ	L05D7
	CMP	#$80
	BNE	L0618
	ORA	$C
L05EB	LDY	$BE
L05ED	INX
	INY
	STA	$16,Y
	LDA	$16,Y
	BEQ	L062B
	SEC
	SBC	#$3A ; ':'
	BEQ	L0600
	CMP	#$49 ; 'I'
	BNE	L0602
L0600	STA	$10
L0602	SEC
	SBC	#$54 ; 'T'
	BNE	L05AD
	STA	$B
L0609	LDA	0,X
	BEQ	L05ED
	CMP	$B
	BEQ	L05ED
L0611	INY
	STA	$16,Y
	INX
	BNE	L0609
L0618	LDX	$C7
	INC	$C
L061C	INY
	LDA	L0284-1,Y
	BPL	L061C
	LDA	L0284,Y
	BNE	L05D9
	LDA	0,X
	BPL	L05EB
L062B	STA	$18,Y
	LDA	#$1A
	STA	$C7
	RTS

; SEARCH BASIC FOR GIVEN LINE NUMBER

L0633	LDA	$78
	LDX	$79
L0637	LDY	#1
	STA	$AC
	STX	$AD
	LDA	($AC),Y
	BEQ	L0660
	INY
	INY
	LDA	$1A
	CMP	($AC),Y
	BCC	L0661
	BEQ	L064E
	DEY
	BNE	L0657
L064E	LDA	$19
	DEY
	CMP	($AC),Y
	BCC	L0661
	BEQ	L0661
L0657	DEY
	LDA	($AC),Y
	TAX
	DEY
	LDA	($AC),Y
	BCS	L0637
L0660	CLC
L0661	RTS

; PERFORM NEW

L0662	BNE	L0661
L0664	LDA	#0
	TAY
	STA	($78),Y
	INY
	STA	($78),Y
	LDA	$78
	ADC	#2
	STA	$7A
	LDA	$79
	ADC	#0
	STA	$7B
L0678	JSR	L06AB
	TYA

; PERFORM CLEAR

L067C	TYA
	TYA
L067E	LDA	$84
	LDY	$85
	STA	$80
	STY	$81
	LDA	$7A
	LDY	$7B
	STA	$7C
	STY	$7D
	STA	$7E
	STY	$7F
	JSR	L080A

; RESET STACK AND PROGRAM POINTERS

L0695	LDX	#$66
	STX	$63
	PLA
	TAY
	PLA
	LDX	#$FE
	TXS
	PHA
	TYA
	PHA
	NOP
	NOP
	LDA	#0
	STA	$8B
	STA	$11
L06AA	RTS

; RESET BASIC EXECUTION TO START

L06AB	CLC
	LDA	$78
	ADC	#$FF
	STA	$C7
	LDA	$79
	ADC	#$FF
	STA	$C8
	RTS

; PERFORM LIST

L06B9	JMP	L2186
	NOP
L06BD	CMP	#$A4
	BNE	L06AA
L06C1	JSR	L096C
	JSR	L0633
	JSR	$C6
	BEQ	L06D8
	CMP	#$A4
	BNE	L0661
	JSR	$C0
	JSR	L096C
	BNE	L0661
L06D8	NOP
	NOP
	LDA	$19
	ORA	$1A
	BNE	L06E6
	LDA	#$FF
	STA	$19
	STA	$1A
L06E6	LDY	#1
	LDA	($AC),Y
	BEQ	L0725
	JSR	L0819
	JSR	L0A73
	INY
	LDA	($AC),Y
	TAX
	INY
	LDA	($AC),Y
	CMP	$1A
	BNE	L0701
	CPX	$19
	BEQ	L0703
L0701	BCS	L0725
L0703	STY	$96
	JSR	L1CDC
	LDA	#' '
L070A	LDY	$96
	AND	#$7F
L070E	JSR	L0AEE
	INY
	BEQ	L0725
	LDA	($AC),Y
	BNE	L0728
	TAY
	LDA	($AC),Y
	TAX
	INY
	LDA	($AC),Y
	STX	$AC
	STA	$AD
	BNE	L06E6
L0725	JMP	L21A1

L0728	BPL	L070E
	SEC
	SBC	#$7F
	TAX
	STY	$96
	LDY	#$FF
L0732	DEX
	BEQ	L073D
L0735	INY
	LDA	L0284,Y
	BPL	L0735
	BMI	L0732

L073D	INY
	LDA	L0284,Y
	BMI	L070A
	JSR	L0AEE
	BNE	L073D

; PERFORM FOR

L0748	LDA	#$80
	STA	$11
	JSR	L09A6
	JSR	L03A1
	BNE	L0759
	TXA
	ADC	#$F
	TAX
	TXS
L0759	PLA
	PLA
	LDA	#9
	JSR	L0412
	JSR	L0907
	CLC
	TYA
	ADC	$C7
	PHA
	LDA	$C8
	ADC	#0
	PHA
	LDA	$87
	PHA
	LDA	$86
	PHA
	LDA	#$9D
	JSR	L0E15
	JSR	L0CBC
	JSR	L0CB9
	LDA	$B3
	ORA	#$7F
	AND	$AF
	STA	$AF
	LDA	#<L0791
	LDY	#>L0791
	STA	$6F
	STY	$70
	JMP	L0D72

L0791	LDA	#<L1885
	LDY	#>L1885
	JSR	L1A9D
	JSR	$C6
	CMP	#$A2
	BNE	L07A5
	JSR	$C0
	JSR	L0CB9
L07A5	JSR	L1B26
	JSR	L0D67
	LDA	$97
	PHA
	LDA	$96
	PHA
	LDA	#$81
	PHA

; EXECUTE NEXT STATEMENT

L07B4	JSR	L0819	; TEST CTRL-C
	LDA	$C7
	LDY	$C8
	BEQ	L07C3
	STA	$8A
	STY	$8B
	LDY	#0
L07C3	LDA	($C7),Y
	BNE	L0803
	LDY	#2
	LDA	($C7),Y
	BEQ	L0842
	INY
	LDA	($C7),Y
	STA	$86
	INY
	LDA	($C7),Y
	STA	$87
	TYA
	JSR	L08FD
	CLC
	BCC	L07E0
	INC	$C8
L07E0	JSR	$C0
	JSR	L07E9
	JMP	L07B4

; EXECUTE BASIC STATEMENT

L07E9	BEQ	L0818
L07EB	SBC	#$80
	BCC	L0800
	CMP	#$1C
	BCS	L0807
	ASL	A
	TAY
	LDA	L0200+1,Y
	PHA
	LDA	L0200,Y
	PHA
	JMP	$C0

L0800	JMP	L09A6

L0803	CMP	#$3A ; ':'
	BEQ	L07E0
L0807	JMP	L0E1E

; PERFORM RESTORE

L080A	SEC
	LDA	$78
	SBC	#1
	LDY	$79
	BCS	L0814
	DEY
L0814	STA	$8E
	STY	$8F
L0818	RTS

; TEST CTRL-C

L0819	LDA	$2325
	BNE	L0821
	JSR	L20DD
L0821	LDX	#0
	STX	$2325

; CHECK STOP KEY

	CMP	#3

; PERFORM STOP

L0828	BCS	L082B

; PERFORM END

L082A	CLC
L082B	BNE	L086C
	LDA	$C7
	LDY	$C8
	BEQ	L083F
	STA	$8A
	STY	$8B
	LDA	$86
	LDY	$87
	STA	$88
	STY	$89
L083F	PLA
	PLA
	.BYTE	$24
L0842	CLC
	LDA	#<L0399
	LDY	#>L0399
	LDX	#0
	STX	$14
	BCC	L0850
	JMP	L0469

L0850	JMP	L20CD

; PERFORM CONT

L0853	BNE	L086C
	LDX	#$1E
	LDY	$8B
	BNE	L085E
	JMP	L044E

L085E	LDA	$8A
	STA	$C7
	STY	$C8
	LDA	$88
	LDY	$89
	STA	$86
	STY	$87
L086C	RTS

L086D	PHP
	LDA	#$FF
	STA	$232C
	STA	$2334
	PLP
	JMP	L2224

L087A	RTS

L087B	JMP	L10D0

; PERFORM RUN

L087E	JMP	L086D
	NOP
	NOP

L0883	JSR	L067E
	JMP	L089D

; PERFORM GOSUB

L0889	LDA	#3
	JSR	L0412
	LDA	$C8
	PHA
	LDA	$C7
	PHA
	LDA	$87
	PHA
	LDA	$86
	PHA
	LDA	#$8C
	PHA
L089D	JSR	$C6
	JSR	L08A6
	JMP	L07B4

; PERFORM GOTO

L08A6	JSR	L096C
	JSR	L090A
	LDA	$87
	CMP	$1A
	BCS	L08BD
	TYA
	SEC
	ADC	$C7
	LDX	$C8
	BCC	L08C1
	INX
	BCS	L08C1

L08BD	LDA	$78
	LDX	$79
L08C1	JSR	L0637
	BCC	L08E4
	LDA	$AC
	SBC	#1
	STA	$C7
	LDA	$AD
	SBC	#0
	STA	$C8
L08D2	RTS

; PERFORM RETURN

L08D3	BNE	L08D2
	LDA	#$FF
	STA	$96
	JSR	L03A1
	TXS
	CMP	#$8C
	BEQ	L08EC
	LDX	#4	; RET W/O GOSUB
	.BYTE	$2C
L08E4	LDX	#$E	; UNDEF STATEMENT
	JMP	L044E

L08E9	JMP	L0E1E

; REMOVE GOSUB BLOCK FROM STACK

L08EC	PLA
	PLA
	STA	$86
	PLA
	STA	$87
	PLA
	STA	$C7
	PLA
	STA	$C8

; PERFORM DATA

L08F9	JSR	L0907
L08FC	TYA
L08FD	CLC
	ADC	$C7
	STA	$C7
	BCC	L0906
	INC	$C8
L0906	RTS

; SCAN FOR NEXT BASIC STATEMENT

L0907	LDX	#':'
	.BYTE	$2C

; SCAN FOR NEXT BASIC LINE

L090A	LDX	#0
	STX	$A
	LDY	#0
	STY	$B
L0912	LDA	$B
	LDX	$A
	STA	$A
	STX	$B
L091A	LDA	($C7),Y
	BEQ	L0906
	CMP	$B
	BEQ	L0906
	INY
	CMP	#$22 ; '"'
	BNE	L091A
	BEQ	L0912

; PERFORM IF

L0929	JSR	L0CCD
	JSR	$C6
	CMP	#$88
	BEQ	L0938
	LDA	#$A0
	JSR	L0E15
L0938	LDA	$AE
	BNE	L0941

; PERFORM REM

L093C	JSR	L090A
	BEQ	L08FC
L0941	JSR	$C6
	BCS	L0949
	JMP	L08A6

L0949	JMP	L07E9

; PERFORM ON

L094C	JSR	L1618
	PHA
	CMP	#$8C
	BEQ	L0958
L0954	CMP	#$88
	BNE	L08E9
L0958	DEC	$B2
	BNE	L0960
	PLA
	JMP	L07EB

L0960	JSR	$C0
	JSR	L096C
	CMP	#','
	BEQ	L0958
	PLA
L096B	RTS

; INPUT FIXED-POINT NUMBER

L096C	LDX	#0
	STX	$19
	STX	$1A
L0972	BCS	L096B
	SBC	#$2F
	STA	$A
	LDA	$1A
	STA	$6F
	CMP	#$19
	BCS	L0954
	LDA	$19
	ASL	A
	ROL	$6F
	ASL	A
	ROL	$6F
	ADC	$19
	STA	$19
	LDA	$6F
	ADC	$1A
	STA	$1A
	ASL	$19
	ROL	$1A
	LDA	$19
	ADC	$A
	STA	$19
	BCC	L09A0
	INC	$1A
L09A0	JSR	$C0
	JMP	L0972

; PERFORM LET

L09A6	JSR	L0F2E
	STA	$96
	STY	$97
	LDA	#$AB
	JSR	L0E15
	LDA	$F
	PHA
	LDA	$E
	PHA
	JSR	L0CCD
	PLA
	ROL	A
	JSR	L0CBF
	BNE	L09DA
	PLA
L09C3	BPL	L09D7
	JSR	L1B16
	JSR	L1047
	LDY	#0
	LDA	$B1
	STA	($96),Y
	INY
	LDA	$B2
	STA	($96),Y
	RTS

L09D7	JMP	L1ACB

L09DA	PLA
L09DB	LDY	#2
	LDA	($B1),Y
	CMP	$81
	BCC	L09FA
	BNE	L09EC
	DEY
	LDA	($B1),Y
	CMP	$80
	BCC	L09FA
L09EC	LDY	$B2
	CPY	$7B
	BCC	L09FA
	BNE	L0A01
	LDA	$B1
	CMP	$7A
	BCS	L0A01
L09FA	LDA	$B1
	LDY	$B2
	JMP	L0A17

L0A01	LDY	#0
	LDA	($B1),Y
	JSR	L12F9
	LDA	$9D
	LDY	$9E
	STA	$BC
	STY	$BD
	JSR	L14F4
	LDA	#$AE
	LDY	#0
L0A17	STA	$9D
	STY	$9E
	JSR	L1555
	LDY	#0
	LDA	($9D),Y
	STA	($96),Y
	INY
	LDA	($9D),Y
	STA	($96),Y
	INY
	LDA	($9D),Y
	STA	($96),Y
	RTS

L0A2F	JSR	L0ACF
L0A32	JSR	$C6

; PERFORM PRINT

L0A35	JMP	L21C8
	.BYTE	$58
	CMP	#$9C	; TAB(
L0A3B	BEQ	L0AA9
	CMP	#','
	CLC
	BEQ	L0A92
	EOR	#$9F
	BEQ	L0AA9
	CMP	#$A4
	BEQ	L0AC1
	JMP	L21B0

L0A4D	BIT	$E
	BMI	L0A2F
L0A51	JSR	$2F7F	; ($1CEC WHEN ATN ENABLED)
	JSR	L130B
	LDY	#0
	LDA	($B1),Y
	CLC
	ADC	$16
	CMP	$17
	BCC	L0A65
	JSR	L0A73
L0A65	JSR	L0ACF
	JSR	L0AE9
	BNE	L0A32
L0A6D	LDY	#0
	STY	$1B,X
	LDX	#$1A

; PERFORM CRLF

L0A73	LDA	#$D
	STA	$16
	JSR	L0AEE
	LDA	#$A
	JSR	L0AEE
L0A7F	TXA
	PHA
	LDX	$15	; NULLS
	BEQ	L0A8D
	LDA	#0
L0A87	JSR	L0AEE
	DEX
	BNE	L0A87
L0A8D	STX	$16
	PLA
	TAX
L0A91	RTS

L0A92	LDA	$16
	CMP	$18
	BCC	L0A9E
	JSR	L0A73
	JMP	L0AC1

L0A9E	SEC
L0A9F	SBC	#$E
	BCS	L0A9F
	EOR	#$FF
	ADC	#1
	BNE	L0ABC
L0AA9	PHP
	JSR	L1615
	CMP	#$29 ; ')'
	BEQ	L0AB4
	JMP	L0E1E

L0AB4	PLP
	BCC	L0ABD
	TXA
	SBC	$16
	BCC	L0AC1
L0ABC	TAX
L0ABD	INX
L0ABE	DEX
	BNE	L0AC7
L0AC1	JSR	$C0
	JMP	L21CA

L0AC7	JSR	L0AE9
	BNE	L0ABE

; PRINT STRING FROM MEMORY

L0ACC	JSR	L130B
L0ACF	JSR	L1520
	TAX
	LDY	#0
	INX
L0AD6	DEX
	BEQ	L0A91
	LDA	($6F),Y
	JSR	L0AEE
	INY
	CMP	#$D
	BNE	L0AD6
	JSR	L0A7F
	JMP	L0AD6

; PRINT SINGLE FORMAT CHARACTER

L0AE9	LDA	#' '
	.BYTE	$2C

; PRINT '?'

L0AEC	LDA	#'?'

; PRINT .A

L0AEE	BIT	$14
	BMI	L0B0A	; DON'T DISPLAY
	PHA
	CMP	#$20
	BCC	L0B02
	LDA	$16
	CMP	$17	; TERMINAL WIDTH?
	BNE	L0B00
	JSR	L0A73
L0B00	INC	$16
L0B02	PLA
	CMP	#$5F	; '_'
	BEQ	L0B0A
	JSR	$2343
L0B0A	AND	#$FF
	RTS

; HANDLE BAD INPUT DATA

L0B0D	LDA	$12
	BEQ	L0B1C
	LDA	$8C
	LDY	$8D
	STA	$86
	STY	$87
	JMP	L0E1E

L0B1C	LDA	#<L0C38	; '?REDO FROM START'
	LDY	#>L0C38
	JSR	L0ACC
	LDA	$8A
	LDY	$8B
	STA	$C7
	STY	$C8
	RTS

; PERFORM INPUT

L0B2C	JSR	L21DF
	NOP
	BNE	L0B3D
	JSR	L0DD3
	LDA	#$3B ; ';'
	JSR	L0E15
	JSR	L0ACF
L0B3D	JSR	L122B
	JSR	L21E7
	NOP
	JSR	L220E
	LDA	$1B
	BNE	L0B5D
	CLC
	JMP	L0B1C

; PROMPT AND RECEIVE INPUT

L0B4F	JSR	L0AEC
	JSR	L0AE9
	JMP	L0558

; PERFORM READ

L0B58	LDX	$8E
	LDY	$8F
	.BYTE	$A9	; LDA #$98	READ
L0B5D	TYA
	STA	$12
	STX	$90
	STY	$91
L0B64	JSR	L0F2E
	STA	$96
	STY	$97
	LDA	$C7
	LDY	$C8
	STA	$98
	STY	$99
	LDX	$90
	LDY	$91
	STX	$C7
	STY	$C8
	JSR	$C6
	BNE	L0B8E
	BIT	$12
	BMI	L0BE8
	JSR	L0AEC
	JSR	L0B4F
	STX	$C7
	STY	$C8
L0B8E	JSR	$C0
	BIT	$E
	BPL	L0BB9
	STA	$A
	CMP	#$22 ; '"'
	BEQ	L0BA2
	LDA	#$3A ; ':'
	STA	$A
	LDA	#$2C ; ','
	CLC
L0BA2	STA	$B
	LDA	$C7
	LDY	$C8
	ADC	#0
	BCC	L0BAD
	INY
L0BAD	JSR	L1311
	JSR	L165D
	JSR	L09DB
	JMP	L0BC1

L0BB9	JSR	L1BEE
	LDA	$F
	JSR	L09C3
L0BC1	JSR	$C6
	BEQ	L0BCD
	CMP	#$2C ; ','
	BEQ	L0BCD
	JMP	L0B0D

L0BCD	LDA	$C7
	LDY	$C8
	STA	$90
	STY	$91
	LDA	$98
	LDY	$99
	STA	$C7
	STY	$C8
	JSR	$C6
	BEQ	L0C0E
	JSR	L0E13
	JMP	L0B64

L0BE8	JSR	L0907
	INY
	TAX
	BNE	L0C01
	LDX	#6
	INY
	LDA	($C7),Y
	BEQ	L0C5F
	INY
	LDA	($C7),Y
	STA	$8C
	INY
	LDA	($C7),Y
	INY
	STA	$8D
L0C01	LDA	($C7),Y
	TAX
	JSR	L08FC
	CPX	#$83
	BNE	L0BE8
	JMP	L0B8E

L0C0E	LDA	$90
	LDY	$91
	LDX	$12
	BPL	L0C19
	JMP	L0814

L0C19	JSR	L221C
	NOP
	BEQ	L0C26
	LDA	#<L0C27
	LDY	#>L0C27
	JMP	L0ACC

L0C26	RTS

L0C27	.BYTE	'?EXTRA IGNORED',$D,$A,0
L0C38	.BYTE	'?REDO FROM START',$D,$A,0

; PERFORM NEXT

L0C4B	BNE	L0C51
	LDY	#0
	BEQ	L0C54
L0C51	JSR	L0F2E
L0C54	STA	$96
	STY	$97
	JSR	L03A1
	BEQ	L0C61
	LDX	#0
L0C5F	BEQ	L0CCA

L0C61	TXS
	INX
	INX
	INX
	INX
	TXA
	INX
	INX
	INX
	INX
	INX
	INX
	STX	$71
	LDY	#1
	JSR	L1A9D
	TSX
	LDA	$109,X
	STA	$B3
	LDA	$96
	LDY	$97
	JSR	L16D6
	JSR	L1ACB
	LDY	#1
	JSR	L1B58
	TSX
	SEC
	SBC	$109,X
	BEQ	L0CA7
	LDA	$10F,X
	STA	$86
	LDA	$110,X
	STA	$87
	LDA	$112,X
	STA	$C7
	LDA	$111,X
	STA	$C8
L0CA4	JMP	L07B4

L0CA7	TXA
	ADC	#$11
	TAX
	TXS
	JSR	$C6
	CMP	#$2C ; ','
	BNE	L0CA4
	JSR	$C0
	JSR	L0C51

; CHECK TYPE MISMATCH

L0CB9	JSR	L0CCD
L0CBC	CLC
	.BYTE	$24
L0CBE	SEC
L0CBF	BIT	$E
	BMI	L0CC6
	BCS	L0CC8
L0CC5	RTS

L0CC6	BCS	L0CC5
L0CC8	LDX	#$18	; TYPE MISMATCH
L0CCA	JMP	L044E

; EVALUATE EXPRESSION

L0CCD	LDX	$C7
	BNE	L0CD3
	DEC	$C8
L0CD3	DEC	$C7
	LDX	#0
	.BYTE	$24
L0CD8	PHA
	TXA
	PHA
	LDA	#1
	JSR	L0412
	JSR	L0DB2
	LDA	#0
	STA	$9A
L0CE7	JSR	$C6
L0CEA	SEC
	SBC	#$AA
	BCC	L0D06
	CMP	#3
	BCS	L0D06
	CMP	#1
	ROL	A
	EOR	#1
	EOR	$9A
	CMP	$9A
	BCC	L0D5F
	STA	$9A
	JSR	$C0
	JMP	L0CEA

L0D06	LDX	$9A
	BNE	L0D36
	BCS	L0D87
	ADC	#7
	BCC	L0D87
	ADC	$E
	BNE	L0D17
	JMP	L14B7

L0D17	ADC	#$FF
	STA	$6F
	ASL	A
	ADC	$6F
	TAY
L0D1F	PLA
	CMP	L0266,Y
	BCS	L0D8C
	JSR	L0CBC
L0D28	PHA
L0D29	JSR	L0D4F
	PLA
	LDY	$98
	BPL	L0D48
	TAX
	BEQ	L0D8A
	BNE	L0D95

L0D36	LSR	$E
	TXA
	ROL	A
	LDX	$C7
	BNE	L0D40
	DEC	$C8
L0D40	DEC	$C7
	LDY	#$1B
	STA	$9A
	BNE	L0D1F
L0D48	CMP	L0266,Y
	BCS	L0D95
	BCC	L0D28

L0D4F	LDA	L0266+2,Y
	PHA
	LDA	L0266+1,Y
	PHA
	JSR	L0D62
	LDA	$9A
	JMP	L0CD8

L0D5F	JMP	L0E1E

L0D62	LDA	$B3
	LDX	L0266,Y
L0D67	TAY
	PLA
	STA	$6F
	INC	$6F
	PLA
	STA	$70
	TYA
	PHA
L0D72	JSR	L1B16
	LDA	$B2
	PHA
	LDA	$B1
	PHA
	LDA	$B0
	PHA
	LDA	$AF
	PHA
	LDA	$AE
	PHA
	JMP	($6F)

; APPLY OPERATOR

L0D87	LDY	#$FF
	PLA
L0D8A	BEQ	L0DAF
L0D8C	CMP	#$64
	BEQ	L0D93
	JSR	L0CBC
L0D93	STY	$98
L0D95	PLA
	LSR	A
	STA	$13
	PLA
	STA	$B6
	PLA
	STA	$B7
	PLA
	STA	$B8
	PLA
	STA	$B9
	PLA
	STA	$BA
	PLA
	STA	$BB
	EOR	$B3
	STA	$BC
L0DAF	LDA	$AE
	RTS

L0DB2	LDA	#0
	STA	$E
L0DB6	JSR	$C0
	BCS	L0DBE
L0DBB	JMP	L1BEE

L0DBE	JSR	L0FB8
	BCS	L0E2A
	CMP	#'.'
	BEQ	L0DBB
	CMP	#$A4
	BEQ	L0E23
	CMP	#$A3
	BEQ	L0DB6
	CMP	#'"'
	BNE	L0DE2
L0DD3	LDA	$C7
	LDY	$C8
	ADC	#0
	BCC	L0DDC
	INY
L0DDC	JSR	L130B
	JMP	L165D

L0DE2	CMP	#$A1
	BNE	L0DF9
	LDY	#$18
	BNE	L0E25

; PERFORM NOT

L0DEA	JSR	L1047
	LDA	$B2
	EOR	#$FF
	TAY
	LDA	$B1
	EOR	#$FF
	JMP	L1218

L0DF9	CMP	#$9E	; FN
	BNE	L0E00
	JMP	L1276

L0E00	CMP	#$AD	; SGN
	BCC	L0E07
	JMP	L0E4A

; EVALUATE EXPRESSION WITHIN PARENTHESES

L0E07	JSR	L0E10
	JSR	L0CCD

; CHECK PARENTHESIS, COMMA

L0E0D	LDA	#')'
	.BYTE	$2C
L0E10	LDA	#'('
	.BYTE	$2C
L0E13	LDA	#','
L0E15	LDY	#0
	CMP	($C7),Y
	BNE	L0E1E
	JMP	$C0

; SYNTAX ERROR EXIT

L0E1E	LDX	#2
	JMP	L044E

; SETUP FOR FUNCTIONS

L0E23	LDY	#$15
L0E25	PLA
	PLA
	JMP	L0D29

; VARIABLE NAME SETUP

L0E2A	JSR	L0F2E
	STA	$B1
	STY	$B2
	LDX	$E
	BEQ	L0E36
	RTS

L0E36	LDX	$F
	BPL	L0E47
	LDY	#0
	LDA	($B1),Y
	TAX
	INY
	LDA	($B1),Y
	TAY
	TXA
	JMP	L1218

L0E47	JMP	L1A9D

; SET UP FUNCTION REFERENCES

L0E4A	ASL	A
	PHA
	TAX
	JSR	$C0
	CPX	#$81
	BCC	L0E74
	JSR	L0E10
	JSR	L0CCD
	JSR	L0E13
	JSR	L0CBE
	PLA
	TAX
	LDA	$B2
	PHA
	LDA	$B1
	PHA
	TXA
	PHA
	JSR	L1618
	PLA
	TAY
	TXA
	PHA
	JMP	L0E79

L0E74	JSR	L0E07
	PLA
	TAY
L0E79	LDA	L0200-$22,Y	;$1DE,Y
	STA	$A2
	LDA	L0200-$21,Y	;$1DF,Y
	STA	$A3
	JSR	$A1
	JMP	L0CBC

; PERFORM OR

L0E89	LDY	#$FF
	.BYTE	$2C

; PERFORM AND

L0E8C	LDY	#0
	STY	$C
	JSR	L1047
	LDA	$B1
	EOR	$C
	STA	$A
	LDA	$B2
	EOR	$C
	STA	$B
	JSR	L1AF7
	JSR	L1047
	LDA	$B2
	EOR	$C
	AND	$B
	EOR	$C
	TAY
	LDA	$B1
	EOR	$C
	AND	$A
	EOR	$C
	JMP	L1218

; PERFORM COMPARISONS < = >

L0EB9	JSR	L0CBF
	BCS	L0ED1
	LDA	$BB
	ORA	#$7F
	AND	$B7
	STA	$B7
	LDA	#$B6
	LDY	#0
	JSR	L1B56
	TAX
	JMP	L0F04

L0ED1	LDA	#0
	STA	$E
	DEC	$9A
	JSR	L1520
	STA	$AE
	STX	$AF
	STY	$B0
	LDA	$B9
	LDY	$BA
	JSR	L1524
	STX	$B9
	STY	$BA
	TAX
	SEC
	SBC	$AE
	BEQ	L0EF9
	LDA	#1
	BCC	L0EF9
	LDX	$AE
	LDA	#$FF
L0EF9	STA	$B3
	LDY	#$FF
	INX
L0EFE	INY
	DEX
	BNE	L0F09
	LDX	$B3
L0F04	BMI	L0F15
	CLC
	BCC	L0F15

L0F09	JSR	L17C8
	NOP
	BEQ	L0EFE
	LDX	#$FF
	BCS	L0F15
	LDX	#1
L0F15	INX
	TXA
	ROL	A
	AND	$13
	BEQ	L0F1E
	LDA	#$FF
L0F1E	JMP	L1B37

L0F21	JSR	L0E13

; PERFORM DIM

L0F24	TAX
	JSR	L0F33
	JSR	$C6
	BNE	L0F21
	RTS

L0F2E	LDX	#0
	JSR	$C6
L0F33	STX	$D
L0F35	STA	$92
	JSR	$C6
	JSR	L0FB8
	BCS	L0F42
L0F3F	JMP	L0E1E

L0F42	LDX	#0
	STX	$E
	STX	$F
	JSR	$C0
	BCC	L0F52
	JSR	L0FB8
	BCC	L0F5D
L0F52	TAX
L0F53	JSR	$C0
	BCC	L0F53
	JSR	L0FB8
	BCS	L0F53
L0F5D	CMP	#$24 ; '$'
	BNE	L0F67
	LDA	#$FF
	STA	$E
	BNE	L0F77
L0F67	CMP	#$25 ; '%'
	BNE	L0F7E
	LDA	$11
	BNE	L0F3F
	LDA	#$80
	STA	$F
	ORA	$92
	STA	$92
L0F77	TXA
	ORA	#$80
	TAX
	JSR	$C0
L0F7E	STX	$93
	SEC
	ORA	$11
	SBC	#$28 ; '('
	BNE	L0F8A
	JMP	L1059

L0F8A	LDA	#0
	STA	$11
	LDA	$7A
	LDX	$7B
	LDY	#0
L0F94	STX	$AD
L0F96	STA	$AC
	CPX	$7D
	BNE	L0FA0
	CMP	$7C
	BEQ	L0FC2
L0FA0	LDA	$92
	CMP	($AC),Y
	BNE	L0FAE
	LDA	$93
	INY
	CMP	($AC),Y
	BEQ	L1019
	DEY
L0FAE	CLC
	LDA	$AC
	ADC	#7
	BCC	L0F96
	INX
	BNE	L0F94
L0FB8	CMP	#$41 ; 'A'
	BCC	L0FC1
	SBC	#$5B ; '['
	SEC
	SBC	#$A5
L0FC1	RTS

L0FC2	PLA
	PHA
	CMP	#$2C ; ','
	BNE	L0FD7
	TSX
	LDA	$102,X
	CMP	#$E
	BNE	L0FD7
	LDA	#<L0FD5
	LDY	#>L0FD5
	RTS

L0FD5	.BYTE	0,0

L0FD7	LDA	$7C
	LDY	$7D
	STA	$AC
	STY	$AD
	LDA	$7E
	LDY	$7F
	STA	$A7
	STY	$A8
	CLC
	ADC	#7
	BCC	L0FED
	INY
L0FED	STA	$A5
	STY	$A6
	JSR	L03CF
	LDA	$A5
	LDY	$A6
	INY
	STA	$7C
	STY	$7D
	LDY	#0
	LDA	$92
	STA	($AC),Y
	INY
	LDA	$93
	STA	($AC),Y
	LDA	#0
	INY
	STA	($AC),Y
	INY
	STA	($AC),Y
	INY
	STA	($AC),Y
	INY
	STA	($AC),Y
	INY
	STA	($AC),Y
L1019	LDA	$AC
	CLC
	ADC	#2
	LDY	$AD
	BCC	L1023
	INY
L1023	STA	$94
	STY	$95
	RTS

L1028	LDA	$C
	ASL	A
	ADC	#5
	ADC	$AC
	LDY	$AD
	BCC	L1034
	INY
L1034	STA	$A5
	STY	$A6
	RTS

L1039	.BYTE	$90,$80,0,0

L103D	JSR	$C0
	JSR	L0CB9
L1043	LDA	$B3
	BMI	L1054

; CONVERT FLOAT TO INTEGER

L1047	LDA	$AE
	CMP	#$90
	BCC	L1056
	LDA	#<L1039
	LDY	#>L1039
	JSR	L1B56
L1054	BNE	L10D0
L1056	JMP	L1B96

L1059	LDA	$D
	ORA	$F
	PHA
	LDA	$E
	PHA
	LDY	#0
L1063	TYA
	PHA
	LDA	$93
	PHA
	LDA	$92
	PHA
	JSR	L103D
	PLA
	STA	$92
	PLA
	STA	$93
	PLA
	TAY
	TSX
	LDA	$102,X
	PHA
	LDA	$101,X
	PHA
	LDA	$B1
	STA	$102,X
	LDA	$B2
	STA	$101,X
	INY
	JSR	$C6
	CMP	#$2C ; ','
	BEQ	L1063
	STY	$C
	JSR	L0E0D
	PLA
	STA	$E
	PLA
	STA	$F
	AND	#$7F
	STA	$D
	LDX	$7C
	LDA	$7D
L10A4	STX	$AC
	STA	$AD
	CMP	$7F
	BNE	L10B0
	CPX	$7E
	BEQ	L10E9
L10B0	LDY	#0
	LDA	($AC),Y
	INY
	CMP	$92
	BNE	L10BF
	LDA	$93
	CMP	($AC),Y
	BEQ	L10D5
L10BF	INY
	LDA	($AC),Y
	CLC
	ADC	$AC
	TAX
	INY
	LDA	($AC),Y
	ADC	$AD
	BCC	L10A4

L10CD	LDX	#$10	; BAD SUBSCRIPT
	.BYTE	$2C

L10D0	LDX	#8	; ILLEGAL QUANTITY
L10D2	JMP	L044E

L10D5	LDX	#$12
	LDA	$D
	BNE	L10D2
	JSR	L1028
	LDA	$C
	LDY	#4
	CMP	($AC),Y
	BNE	L10CD
	JMP	L1173

L10E9	JSR	L1028
	JSR	L041F
	LDA	#0
	TAY
	STA	$BF
	LDX	#5
	LDA	$92
	STA	($AC),Y
	BPL	L10FD
	DEX
L10FD	INY
	LDA	$93
	STA	($AC),Y
	BPL	L1106
	DEX
	DEX
L1106	STX	$BE
	LDA	$C
	INY
	INY
	INY
	STA	($AC),Y
L110F	LDX	#$B
	LDA	#0
	BIT	$D
	BVC	L111F
	PLA
	CLC
	ADC	#1
	TAX
	PLA
	ADC	#0
L111F	INY
	STA	($AC),Y
	INY
	TXA
	STA	($AC),Y
	JSR	L11D3
	STX	$BE
	STA	$BF
	LDY	$6F
	DEC	$C
	BNE	L110F
	ADC	$A6
	BCS	L1194
	STA	$A6
	TAY
	TXA
	ADC	$A5
	BCC	L1142
	INY
	BEQ	L1194
L1142	JSR	L041F
	STA	$7E
	STY	$7F
	LDA	#0
	INC	$BF
	LDY	$BE
	BEQ	L1156
L1151	DEY
	STA	($A5),Y
	BNE	L1151
L1156	DEC	$A6
	DEC	$BF
	BNE	L1151
	INC	$A6
	SEC
	LDA	$7E
	SBC	$AC
	LDY	#2
	STA	($AC),Y
	LDA	$7F
	INY
	SBC	$AD
	STA	($AC),Y
	LDA	$D
	BNE	L11D2
	INY
L1173	LDA	($AC),Y
	STA	$C
	LDA	#0
	STA	$BE
L117B	STA	$BF
	INY
	PLA
	TAX
	STA	$B1
	PLA
	STA	$B2
	CMP	($AC),Y
	BCC	L1197
	BNE	L1191
	INY
	TXA
	CMP	($AC),Y
	BCC	L1198
L1191	JMP	L10CD

L1194	JMP	L044C

L1197	INY
L1198	LDA	$BF
	ORA	$BE
	CLC
	BEQ	L11A9
	JSR	L11D3
	TXA
	ADC	$B1
	TAX
	TYA
	LDY	$6F
L11A9	ADC	$B2
	STX	$BE
	DEC	$C
	BNE	L117B
	JSR	L20EA
	NOP
	BPL	L11B8
	DEX
L11B8	LDA	$93
	BPL	L11BE
	DEX
	DEX
L11BE	STX	$75
	LDA	#0
	JSR	L11DC
	TXA
	ADC	$A5
	STA	$94
	TYA
	ADC	$A6
	STA	$95
	TAY
	LDA	$94
L11D2	RTS

L11D3	STY	$6F
	LDA	($AC),Y
	STA	$75
	DEY
	LDA	($AC),Y
L11DC	STA	$76
	LDA	#$10
	STA	$AA
	LDX	#0
	LDY	#0
L11E6	TXA
	ASL	A
	TAX
	TYA
	ROL	A
	TAY
	BCS	L1194
	ASL	$BE
	ROL	$BF
	BCC	L11FF
	CLC
	TXA
	ADC	$75
	TAX
	TYA
	ADC	$76
	TAY
	BCS	L1194
L11FF	DEC	$AA
	BNE	L11E6
	RTS

; PERFORM FRE

L1204	LDA	$E
	BEQ	L120B
	JSR	L1520
L120B	JSR	L13A4
	SEC
	LDA	$80
	SBC	$7E
	TAY
	LDA	$81
	SBC	$7F

; CONVERT FIXED-TO-FLOATING

L1218	LDX	#0
	STX	$E
	STA	$AF
	STY	$B0
	LDX	#$90
	JMP	L1B3F

; PERFORM POS

L1225	LDY	$16
L1227	LDA	#0
	BEQ	L1218

; CHECK NOT DIRECT

L122B	LDX	$87
	INX
	BNE	L11D2
	LDX	#$16	; ILLEGAL DIRECT
L1232	JMP	L044E

; PERFORM DEF

L1235	JSR	L1263
	JSR	L122B
	JSR	L0E10
	LDA	#$80
	STA	$11
	JSR	L0F2E
	JSR	L0CBC
	JSR	L0E0D
	LDA	#$AB
	JSR	L0E15
	PHA
	LDA	$95
	PHA
	LDA	$94
	PHA
	LDA	$C8
	PHA
	LDA	$C7
	PHA
	JSR	L08F9
	JMP	L12D3

L1263	LDA	#$9E
	JSR	L0E15
	ORA	#$80
	STA	$11
	JSR	L0F35
	STA	$9B
	STY	$9C
	JMP	L0CBC

L1276	JSR	L1263
	LDA	$9C
	PHA
	LDA	$9B
	PHA
	JSR	L0E07
	JSR	L0CBC
	PLA
	STA	$9B
	PLA
	STA	$9C
	LDY	#2
	LDX	#$20 ; ' '
	LDA	($9B),Y
	BEQ	L1232
	STA	$94
	TAX
	INY
	LDA	($9B),Y
	STA	$95
	INY
L129C	LDA	($94),Y
	PHA
	DEY
	BPL	L129C
	LDY	$95
	JSR	L1ACF
	LDA	$C8
	PHA
	LDA	$C7
	PHA
	LDA	($9B),Y
	STA	$C7
	INY
	LDA	($9B),Y
	STA	$C8
	LDA	$95
	PHA
	LDA	$94
	PHA
	JSR	L0CB9
	PLA
	STA	$9B
	PLA
	STA	$9C
	JSR	$C6
	BEQ	L12CD
	JMP	L0E1E

L12CD	PLA
	STA	$C7
	PLA
	STA	$C8

L12D3	LDY	#0
	PLA
	STA	($9B),Y
	PLA
	INY
	STA	($9B),Y
	PLA
	INY
	STA	($9B),Y
	PLA
	INY
	STA	($9B),Y
	PLA
	INY
	STA	($9B),Y
	RTS

; PERFORM STR$

L12E9	JSR	L0CBC
	LDY	#0
	JSR	L1CEE
	PLA
	PLA
	LDA	#$FF
	LDY	#0
	BEQ	L130B

; DO STRING VECTOR

L12F9	LDX	$B1
	LDY	$B2
	STX	$9D
	STY	$9E
L1301	JSR	L1372
	STX	$AF
	STY	$B0
	STA	$AE
	RTS

; SCAN, SET UP STRING

L130B	LDX	#$22 ; '"'
	STX	$A
	STX	$B
L1311	STA	$BC
	STY	$BD
	STA	$AF
	STY	$B0
	LDY	#$FF
L131B	INY
	LDA	($BC),Y
	BEQ	L132C
	CMP	$A
	BEQ	L1328
	CMP	$B
	BNE	L131B
L1328	CMP	#$22 ; '"'
	BEQ	L132D
L132C	CLC
L132D	STY	$AE
	TYA
	ADC	$BC
	STA	$BE
	LDX	$BD
	BCC	L1339
	INX
L1339	STX	$BF
	LDA	$BD
	BNE	L134A
	TYA
	JSR	L12F9
	LDX	$BC
	LDY	$BD
	JSR	L1502
L134A	LDX	$63
	CPX	#$6F
	BNE	L1355
	LDX	#$1C	; EXPR TOO LONG
L1352	JMP	L044E

L1355	LDA	$AE
	STA	0,X
	LDA	$AF
	STA	1,X
	LDA	$B0
	STA	2,X
	LDY	#0
	STX	$B1
	STY	$B2
	DEY
	STY	$E
	STX	$64
	INX
	INX
	INX
	STX	$63
	RTS

; BUILD DESCRIPTOR

L1372	LSR	$10
L1374	PHA
	EOR	#$FF
	SEC
	ADC	$80
	LDY	$81
	BCS	L137F
	DEY
L137F	CPY	$7F
	BCC	L1394
	BNE	L1389
	CMP	$7E
	BCC	L1394
L1389	STA	$80
	STY	$81
	STA	$82
	STY	$83
	TAX
	PLA
	RTS

L1394	LDX	#$C	; OUT OF MEM
	LDA	$10
	BMI	L1352
	JSR	L13A4
	LDA	#$80
	STA	$10
	PLA
	BNE	L1374

; GARBAGE COLLECTION

L13A4	LDX	$84
	LDA	$85
L13A8	STX	$80
	STA	$81
	LDY	#0
	STY	$9C
	LDA	$7E
	LDX	$7F
	STA	$AC
	STX	$AD
	LDA	#$66
	LDX	#0
	STA	$6F
	STX	$70
L13C0	CMP	$63
	BEQ	L13C9
	JSR	L1443
	BEQ	L13C0
L13C9	LDA	#7
	STA	$A0
	LDA	$7A
	LDX	$7B
	STA	$6F
	STX	$70
L13D5	CPX	$7D
	BNE	L13DD
	CMP	$7C
	BEQ	L13E2
L13DD	JSR	L1439
	BEQ	L13D5
L13E2	STA	$A5
	STX	$A6
	LDA	#3
	STA	$A0
L13EA	LDA	$A5
	LDX	$A6
L13EE	CPX	$7F
	BNE	L13F9
	CMP	$7E
	BNE	L13F9
	JMP	L1482

L13F9	STA	$6F
	STX	$70
	LDY	#0
	LDA	($6F),Y
	TAX
	INY
	LDA	($6F),Y
	PHP
	INY
	LDA	($6F),Y
	ADC	$A5
	STA	$A5
	INY
	LDA	($6F),Y
	ADC	$A6
	STA	$A6
	PLP
	BPL	L13EA
	TXA
	BMI	L13EA
	INY
	LDA	($6F),Y
	LDY	#0
	ASL	A
	ADC	#5
	ADC	$6F
	STA	$6F
	BCC	L142A
	INC	$70
L142A	LDX	$70
L142C	CPX	$A6
	BNE	L1434
	CMP	$A5
	BEQ	L13EE
L1434	JSR	L1443
	BEQ	L142C
L1439	LDA	($6F),Y
	BMI	L1472
	INY
	LDA	($6F),Y
	BPL	L1472
	INY
L1443	LDA	($6F),Y
	BEQ	L1472
	INY
	LDA	($6F),Y
	TAX
	INY
	LDA	($6F),Y
	CMP	$81
	BCC	L1458
	BNE	L1472
	CPX	$80
	BCS	L1472
L1458	CMP	$AD
	BCC	L1472
	BNE	L1462
	CPX	$AC
	BCC	L1472
L1462	STX	$AC
	STA	$AD
	LDA	$6F
	LDX	$70
	STA	$9B
	STX	$9C
	LDA	$A0
	STA	$A2
L1472	LDA	$A0
	CLC
	ADC	$6F
	STA	$6F
	BCC	L147D
	INC	$70
L147D	LDX	$70
	LDY	#0
	RTS

L1482	LDX	$9C
	BEQ	L147D
	LDA	$A2
	AND	#4
	LSR	A
	TAY
	STA	$A2
	LDA	($9B),Y
	ADC	$AC
	STA	$A7
	LDA	$AD
	ADC	#0
	STA	$A8
	LDA	$80
	LDX	$81
	STA	$A5
	STX	$A6
	JSR	L03D6
	LDY	$A2
	INY
	LDA	$A5
	STA	($9B),Y
	TAX
	INC	$A6
	LDA	$A6
	INY
	STA	($9B),Y
	JMP	L13A8

; CONCATENATE

L14B7	LDA	$B2
	PHA
	LDA	$B1
	PHA
	JSR	L0DB2
	JSR	L0CBE
	PLA
	STA	$BC
	PLA
	STA	$BD
	LDY	#0
	LDA	($BC),Y
	CLC
	ADC	($B1),Y
	BCC	L14D7
	LDX	#$1A	; STRING TOO LONG
	JMP	L044E

L14D7	JSR	L12F9
	JSR	L14F4
	LDA	$9D
	LDY	$9E
	JSR	L1524
	JSR	L1506
	LDA	$BC
	LDY	$BD
	JSR	L1524
	JSR	L134A
	JMP	L0CE7

; STORE STRING

L14F4	LDY	#0
	LDA	($BC),Y
	PHA
	INY
	LDA	($BC),Y
	TAX
	INY
	LDA	($BC),Y
	TAY
	PLA
L1502	STX	$6F
	STY	$70
L1506	TAY
	BEQ	L1513
	PHA
L150A	DEY
	LDA	($6F),Y
	STA	($82),Y
	TYA
	BNE	L150A
	PLA
L1513	CLC
	ADC	$82
	STA	$82
	BCC	L151C
	INC	$83
L151C	RTS

; DISCARD UNWANTED STRING

L151D	JSR	L0CBE
L1520	LDA	$B1
	LDY	$B2
L1524	STA	$6F
	STY	$70
	JSR	L1555
	PHP
	LDY	#0
	LDA	($6F),Y
	PHA
	INY
	LDA	($6F),Y
	TAX
	INY
	LDA	($6F),Y
	TAY
	PLA
	PLP
	BNE	L1550
	CPY	$81
	BNE	L1550
	CPX	$80
	BNE	L1550
	PHA
	CLC
	ADC	$80
	STA	$80
	BCC	L154F
	INC	$81
L154F	PLA
L1550	STX	$6F
	STY	$70
	RTS

; CLEAN DESCRIPTOR STACK

L1555	CPY	$65
	BNE	L1565
	CMP	$64
	BNE	L1565
	STA	$63
	SBC	#3
	STA	$64
	LDY	#0
L1565	RTS

; PERFORM CHR$

L1566	JSR	L161B
	TXA
	PHA
	LDA	#1
	JSR	L1301
	PLA
	LDY	#0
	STA	($AF),Y
	PLA
	PLA
	JMP	L134A

; PERFORM LEFT$

L157A	JSR	L15D9
	CMP	($9D),Y
	TYA
L1580	BCC	L1586
	LDA	($9D),Y
	TAX
	TYA
L1586	PHA
L1587	TXA
L1588	PHA
	JSR	L1301
	LDA	$9D
	LDY	$9E
	JSR	L1524
	PLA
	TAY
	PLA
	CLC
	ADC	$6F
	STA	$6F
	BCC	L159F
	INC	$70
L159F	TYA
	JSR	L1506
	JMP	L134A

; PERFORM RIGHT$

L15A6	JSR	L15D9
	CLC
	SBC	($9D),Y
	EOR	#$FF
	JMP	L1580

; PERFORM MID$

L15B1	LDA	#$FF
	STA	$B2
	JSR	$C6
	CMP	#$29 ; ')'
	BEQ	L15C2
	JSR	L0E13
	JSR	L1618
L15C2	JSR	L15D9
	DEX
	TXA
	PHA
	CLC
	LDX	#0
	SBC	($9D),Y
	BCS	L1587
	EOR	#$FF
	CMP	$B2
	BCC	L1588
	LDA	$B2
	BCS	L1588

; PULL STRING DATA

L15D9	JSR	L0E0D
	PLA
	TAY
	PLA
	STA	$A2
	PLA
	PLA
	PLA
	TAX
	PLA
	STA	$9D
	PLA
	STA	$9E
	LDA	$A2
	PHA
	TYA
	PHA
	LDY	#0
	TXA
	BEQ	L1612
	RTS

; PERFORM LEN

L15F6	JSR	L15FC
	JMP	L1227

; SWITCH STRING TO NUMERIC

L15FC	JSR	L151D
	LDX	#0
	STX	$E
	TAY
	RTS

; PERFORM ASC

L1605	JSR	L15FC
	BEQ	L1612
	LDY	#0
	LDA	($6F),Y
	TAY
	JMP	L1227

L1612	JMP	L10D0

; GET BYTE PARAMETER

L1615	JSR	$C0
L1618	JSR	L0CB9
L161B	JSR	L1043
	LDX	$B1
	BNE	L1612
	LDX	$B2
	JMP	$C6

; PERFORM VAL

L1627	JSR	L15FC
	BNE	L162F
	JMP	L1766

L162F	LDX	$C7
	LDY	$C8
	STX	$BE
	STY	$BF
	LDX	$6F
	STX	$C7
	CLC
	ADC	$6F
	STA	$71
	LDX	$70
	STX	$C8
	BCC	L1647
	INX
L1647	STX	$72
	LDY	#0
	LDA	($71),Y
	PHA
	LDA	#0
	STA	($71),Y
	JSR	$C6
	JSR	L1BEE
	PLA
	LDY	#0
	STA	($71),Y
L165D	LDX	$BE
	LDY	$BF
	STX	$C7
	STY	$C8
	RTS

; GET TWO PARAMETERS FOR POKE OR WAIT

L1666	JSR	L0CB9
	JSR	L1672
L166C	JSR	L0E13
	JMP	L1618

; CONVERT FLOATING-TO-FIXED

L1672	LDA	$B3
	BMI	L1612
	LDA	$AE
	CMP	#$91
	BCS	L1612
	JSR	L1B96
	LDA	$B1
	LDY	$B2
	STY	$19
	STA	$1A
	RTS

; PERFORM PEEK

L1688	JSR	L1672
	LDY	#0
	LDA	($19),Y
	TAY
	JMP	L1227

; PERFORM POKE

L1693	JSR	L1666
	TXA
	LDY	#0
	STA	($19),Y
	RTS

; PERFORM TRAP

L169C	JSR	L096C
	JSR	L090A
	LDA	$19
	BNE	L16A8
	LDA	$1A
L16A8	STA	$36D0
	LDA	$19
	STA	$36DA
	LDA	$1A
	STA	$36DE
	LDA	#0
L16B7	RTS

; ADD 0.5

L16B8	LDA	#<L1E1C
	LDY	#>L1E1C
	JMP	L16D6

L16BF	JSR	L1987

; PERFORM SUBTRACTION

L16C2	LDA	$B3
	EOR	#$FF
	STA	$B3
	EOR	$BB
	STA	$BC
	LDA	$AE
	JMP	L16D9

L16D1	JSR	L183A
	BCC	L1712
L16D6	JSR	L1987

; PERFORM ADDITION

L16D9	BNE	L16DE
	JMP	L1AF7

L16DE	LDX	$BD
	STX	$A3
	LDX	#$B6
	LDA	$B6
L16E6	TAY
	BEQ	L16B7
	SEC
	SBC	$AE
	BEQ	L1712
	BCC	L1702
	STY	$AE
	LDY	$BB
	STY	$B3
	EOR	#$FF
	ADC	#0
	LDY	#0
	STY	$A3
	LDX	#$AE
	BNE	L1706
L1702	LDY	#0
	STY	$BD
L1706	CMP	#$F9
	BMI	L16D1
	TAY
	LDA	$BD
	LSR	1,X
	JSR	L1853
L1712	BIT	$BC
	BPL	L176D
	LDY	#$AE
	CPX	#$B6
	BEQ	L171E
	LDY	#$B6
L171E	SEC
	EOR	#$FF
	ADC	$A3
	STA	$BD
	LDA	4,Y
	SBC	4,X
	STA	$B2
	LDA	3,Y
	SBC	3,X
	STA	$B1
	LDA	2,Y
	SBC	2,X
	STA	$B0
	LDA	1,Y
	SBC	1,X
	STA	$AF
L1741	BCS	L1746
	JSR	L17E8
L1746	LDY	#0
	TYA
	CLC
L174A	LDX	$AF
	BNE	L1798
	LDX	$B0
	STX	$AF
	LDX	$B1
	STX	$B0
	LDX	$B2
	STX	$B1
	LDX	$BD
	STX	$B2
	STY	$BD
	ADC	#8
	CMP	#$20 ; ' '
	BNE	L174A
L1766	LDA	#0
L1768	STA	$AE
L176A	STA	$B3
	RTS

L176D	ADC	$A3
	STA	$BD
	LDA	$B2
	ADC	$BA
	STA	$B2
	LDA	$B1
	ADC	$B9
	STA	$B1
	LDA	$B0
	ADC	$B8
	STA	$B0
	LDA	$AF
	ADC	$B7
	STA	$AF
	JMP	L17A5

L178C	ADC	#1
	ASL	$BD
	ROL	$B2
	ROL	$B1
	ROL	$B0
	ROL	$AF
L1798	BPL	L178C
	SEC
	SBC	$AE
	BCS	L1766
	EOR	#$FF
	ADC	#1
	STA	$AE
L17A5	BCC	L17E7
L17A7	INC	$AE
	BEQ	L181F
	ROR	$AF
	ROR	$B0
	ROR	$B1
	ROR	$B2
	ROR	$BD
	RTS

L17B6	LDA	0,X
	JSR	$3A5F	; UPPERCASE
	CMP	#' '
L17BD	RTS

L17BE	JSR	$3A5F	; UPPERCASE
	CMP	#':'
	BCS	L17BD
	JMP	$D1

L17C8	LDA	($AF),Y
	JSR	$3A5F	; UPPERCASE
	STA	L17D5+1
	LDA	($B9),Y
	JSR	$3A5F	; UPPERCASE
L17D5	CMP	#0
	RTS

; CALLED FROM DOS

L17D8	STA	$232C
	JMP	$26BC

	.BYTE	0,0,0,0,0,0,0,0,0

L17E7	RTS

; COMPLEMENT ACCUM#1

L17E8	LDA	$B3
	EOR	#$FF
	STA	$B3
L17EE	LDA	$AF
	EOR	#$FF
	STA	$AF
	LDA	$B0
	EOR	#$FF
	STA	$B0
	LDA	$B1
	EOR	#$FF
	STA	$B1
	LDA	$B2
	EOR	#$FF
	STA	$B2
	LDA	$BD
	EOR	#$FF
	STA	$BD
	INC	$BD
	BNE	L181E
L1810	INC	$B2
	BNE	L181E
	INC	$B1
	BNE	L181E
	INC	$B0
	BNE	L181E
	INC	$AF
L181E	RTS

; OVERFLOW EXIT

L181F	LDX	#$A	; OVERFLOW
	JMP	L044E

; MULTIPLY-A-BYTE

L1824	LDX	#$72
L1826	LDY	4,X
	STY	$BD
	LDY	3,X
	STY	4,X
	LDY	2,X
	STY	3,X
	LDY	1,X
	STY	2,X
	LDY	$B5
	STY	1,X
L183A	ADC	#8
	BMI	L1826
	BEQ	L1826
	SBC	#8
	TAY
	LDA	$BD
	BCS	L1883
L1847	PHA
	LDA	1,X
	AND	#$80
	LSR	1,X
	ORA	1,X
	STA	1,X
	.BYTE	$24	; BIT ZPAGE
L1853	PHA
	LDA	#0
	BCC	L185A
	LDA	#$80
L185A	LSR	2,X
	ORA	2,X
	STA	2,X
	LDA	#0
	BCC	L1866
	LDA	#$80
L1866	LSR	3,X
	ORA	3,X
	STA	3,X
	LDA	#0
	BCC	L1872
	LDA	#$80
L1872	LSR	4,X
	ORA	4,X
	STA	4,X
	PLA
	PHP
	LSR	A
	PLP
	BCC	L1880
	ORA	#$80
L1880	INY
	BNE	L1847
L1883	CLC
	RTS

; CONSTANTS

L1885	.BYTE	$81,$00,$00,$00,$00

L188A	.BYTE	4-1
	.BYTE	$7F,$5E,$56,$CB,$79
	.BYTE	$80,$13,$9B,$0B,$64
	.BYTE	$80,$76,$38,$93,$16
	.BYTE	$82,$38,$AA,$3B,$20

L189F	.BYTE	$80,$35,$04,$F3,$34
L18A4	.BYTE	$81,$35,$04,$F3,$34
L18A9	.BYTE	$80,$80,$00,$00,$00
L18AE	.BYTE	$80,$31,$72,$17,$F8

; PERFORM LOG

L18B3	JSR	L1B26
	BEQ	L18BA
	BPL	L18BD
L18BA	JMP	L10D0

L18BD	LDA	$AE
	SBC	#$7F
	PHA
	LDA	#$80
	STA	$AE
	LDA	#<L189F
	LDY	#>L189F
	JSR	L16D6
	LDA	#<L18A4
	LDY	#>L18A4
	JSR	L1A0A
	LDA	#<L1885
	LDY	#>L1885
	JSR	L16BF
	LDA	#<L188A
	LDY	#>L188A
	JSR	L1F14
	LDA	#<L18A9
	LDY	#>L18A9
	JSR	L16D6
	PLA
	JSR	L1C8D
	LDA	#<L18AE
	LDY	#>L18AE
L18F1	JSR	L1987

; PERFORM MULTIPLICATION

L18F4	BNE	L18F9
	JMP	L1986

L18F9	JSR	L19B2
	LDA	#0
	STA	$73
	STA	$74
	STA	$75
	STA	$76
	LDA	$BD
	JSR	L1922
	LDA	$B2
	JSR	L1922
	LDA	$B1
	JSR	L1922
	LDA	$B0
	JSR	L1922
	LDA	$AF
	JSR	L1927
	JMP	L1A8A

L1922	BNE	L1927
	JMP	L1824

L1927	LSR	A
	ORA	#$80
L192A	TAY
	BCC	L1946
	CLC
	LDA	$76
	ADC	$BA
	STA	$76
	LDA	$75
	ADC	$B9
	STA	$75
	LDA	$74
	ADC	$B8
	STA	$74
	LDA	$73
	ADC	$B7
	STA	$73
L1946	ROR	$73
	ROR	$74
	ROR	$75
	ROR	$76
	ROR	$BD
	JMP	L1982

L1953	LDA	#0
	STA	$2CE5
L1958	JSR	$2CE4
	CMP	#$D
	BEQ	L1975
	PHA
	JSR	$23A1
	JSR	$3A5F	; UPPERCASE
	STA	$2363
	PLA
	CMP	#$26 ; '&'
	BEQ	L1958
	CMP	$2363
	BEQ	L1958
	BNE	L1953
L1975	JSR	$23A1
	CMP	#$D
	BNE	L1975
	RTS

L197D	.BYTE	0,0,0,0,0

L1982	TYA
	LSR	A
	BNE	L192A
L1986	RTS

; UNPACK MEMORY INTO ACCUM#2

L1987	STA	$6F
	STY	$70
	LDY	#4
	LDA	($6F),Y
	STA	$BA
	DEY
	LDA	($6F),Y
	STA	$B9
	DEY
	LDA	($6F),Y
	STA	$B8
	DEY
	LDA	($6F),Y
	STA	$BB
	EOR	$B3
	STA	$BC
	LDA	$BB
	ORA	#$80
	STA	$B7
	DEY
	LDA	($6F),Y
	STA	$B6
	LDA	$AE
	RTS

L19B2	LDA	$B6
L19B4	BEQ	L19D5
	CLC
	ADC	$AE
	BCC	L19BF
	BMI	L19DA
	CLC
	.BYTE	$2C
L19BF	BPL	L19D5
	ADC	#$80
	STA	$AE
	BNE	L19CA
	JMP	L176A

L19CA	LDA	$BC
	STA	$B3
	RTS

; HANDLE OVERFLOW AND UNDERFLOW

L19CF	LDA	$B3
	EOR	#$FF
	BMI	L19DA
L19D5	PLA
	PLA
	JMP	L1766

L19DA	JMP	L181F

; MULTIPLY BY 10

L19DD	JSR	L1B07
	TAX
	BEQ	L19F3
	CLC
	ADC	#2
	BCS	L19DA
	LDX	#0
	STX	$BC
	JSR	L16E6
	INC	$AE
	BEQ	L19DA
L19F3	RTS

; 10 IN FLOATING BINARY

L19F4	.BYTE	$84,$20,$00,$00,$00

; DIVIDE BY 10

L19F9	JSR	L1B07
	LDA	#<L19F4
	LDY	#>L19F4
	LDX	#0
L1A02	STX	$BC
	JSR	L1A9D
	JMP	L1A0D

L1A0A	JSR	L1987

; PERFORM DIVISION

L1A0D	BEQ	L1A85
	JSR	L1B16
	LDA	#0
	SEC
	SBC	$AE
	STA	$AE
	JSR	L19B2
	INC	$AE
	BEQ	L19DA
	LDX	#$FC
	LDA	#1
L1A24	LDY	$B7
	CPY	$AF
	BNE	L1A3A
	LDY	$B8
	CPY	$B0
	BNE	L1A3A
	LDY	$B9
	CPY	$B1
	BNE	L1A3A
	LDY	$BA
	CPY	$B2
L1A3A	PHP
	ROL	A
	BCC	L1A47
	INX
	STA	$76,X
	BEQ	L1A75
	BPL	L1A79
	LDA	#1
L1A47	PLP
	BCS	L1A58
L1A4A	ASL	$BA
	ROL	$B9
	ROL	$B8
	ROL	$B7
	BCS	L1A3A
	BMI	L1A24
	BPL	L1A3A

L1A58	TAY
	LDA	$BA
	SBC	$B2
	STA	$BA
	LDA	$B9
	SBC	$B1
	STA	$B9
	LDA	$B8
	SBC	$B0
	STA	$B8
	LDA	$B7
	SBC	$AF
	STA	$B7
	TYA
	JMP	L1A4A

L1A75	LDA	#$40
	BNE	L1A47
L1A79	ASL	A
	ASL	A
	ASL	A
	ASL	A
	ASL	A
	ASL	A
	STA	$BD
	PLP
	JMP	L1A8A

L1A85	LDX	#$14	; DIV BY ZERO
	JMP	L044E

L1A8A	LDA	$73
	STA	$AF
	LDA	$74
	STA	$B0
	LDA	$75
	STA	$B1
	LDA	$76
	STA	$B2
	JMP	L1746

; UNPACK MEMORY INTO ACCUM#1

L1A9D	STA	$6F
	STY	$70
	LDY	#4
	LDA	($6F),Y
	STA	$B2
	DEY
	LDA	($6F),Y
	STA	$B1
	DEY
	LDA	($6F),Y
	STA	$B0
	DEY
	LDA	($6F),Y
	STA	$B3
	ORA	#$80
	STA	$AF
	DEY
	LDA	($6F),Y
	STA	$AE
	STY	$BD
	RTS

; PACK ACCUM#1 INTO MEMORY

L1AC2	LDX	#<$A9
	.BYTE	$2C
L1AC5	LDX	#<$A4
	LDY	#0
	BEQ	L1ACF

L1ACB	LDX	$96
	LDY	$97
L1ACF	JSR	L1B16
	STX	$6F
	STY	$70
	LDY	#4
	LDA	$B2
	STA	($6F),Y
	DEY
	LDA	$B1
	STA	($6F),Y
	DEY
	LDA	$B0
	STA	($6F),Y
	DEY
	LDA	$B3
	ORA	#$7F
	AND	$AF
	STA	($6F),Y
	DEY
	LDA	$AE
	STA	($6F),Y
	STY	$BD
	RTS

; MOVE ACCUM#2 TO #1

L1AF7	LDA	$BB
L1AF9	STA	$B3
	LDX	#5
L1AFD	LDA	$B5,X
	STA	$AD,X
	DEX
	BNE	L1AFD
	STX	$BD
	RTS

; ROUND AND MOVE ACCUM#1 TO #2

L1B07	JSR	L1B16

; MOVE ACCUM#1 TO #2

L1B0A	LDX	#6
L1B0C	LDA	$AD,X
	STA	$B5,X
	DEX
	BNE	L1B0C
	STX	$BD
L1B15	RTS

; ROUND ACCUM#1

L1B16	LDA	$AE
	BEQ	L1B15
	ASL	$BD
	BCC	L1B15
L1B1E	JSR	L1810
	BNE	L1B15
	JMP	L17A7

; GET ACCUM#1 SIGN (0=0, 1=POS, FF=NEG)

L1B26	LDA	$AE
	BEQ	L1B33
L1B2A	LDA	$B3
L1B2C	ROL	A
	LDA	#$FF
	BCS	L1B33
	LDA	#1
L1B33	RTS

; PERFORM SGN

L1B34	JSR	L1B26
L1B37	STA	$AF
	LDA	#0
	STA	$B0
	LDX	#$88
L1B3F	LDA	$AF
	EOR	#$FF
	ROL	A
L1B44	LDA	#0
	STA	$B2
	STA	$B1
	STX	$AE
	STA	$BD
	STA	$B3
	JMP	L1741

; PERFORM ABS

L1B53	LSR	$B3
	RTS

; COMPARE ACCUM#1 TO MEMORY

L1B56	STA	$71
L1B58	STY	$72
	LDY	#0
	LDA	($71),Y
	INY
	TAX
	BEQ	L1B26
	LDA	($71),Y
	EOR	$B3
	BMI	L1B2A
	CPX	$AE
	BNE	L1B8D
	LDA	($71),Y
	ORA	#$80
	CMP	$AF
	BNE	L1B8D
	INY
	LDA	($71),Y
	CMP	$B0
	BNE	L1B8D
	INY
	LDA	($71),Y
	CMP	$B1
	BNE	L1B8D
	INY
	LDA	#$7F
	CMP	$BD
	LDA	($71),Y
	SBC	$B2
	BEQ	L1BB5
L1B8D	LDA	$B3
	BCC	L1B93
	EOR	#$FF
L1B93	JMP	L1B2C

; FLOATING-TO-FIXED

L1B96	LDA	$AE
	BEQ	L1BE4
	SEC
	SBC	#$A0
	BIT	$B3
	BPL	L1BAA
	TAX
	LDA	#$FF
	STA	$B5
	JSR	L17EE
	TXA
L1BAA	LDX	#$AE
	CMP	#$F9
	BPL	L1BB6
	JSR	L183A
	STY	$B5
L1BB5	RTS

L1BB6	TAY
	LDA	$B3
	AND	#$80
	LSR	$AF
	ORA	$AF
	STA	$AF
	JSR	L1853
	STY	$B5
	RTS

; PERFORM INT

L1BC7	LDA	$AE
	CMP	#$A0
	BCS	L1BED
	JSR	L1B96
	STY	$BD
	LDA	$B3
	STY	$B3
	EOR	#$80
	ROL	A
	LDA	#$A0
	STA	$AE
	LDA	$B2
	STA	$A
	JMP	L1741

; CLEAR ACCUM#1

L1BE4	STA	$AF
	STA	$B0
	STA	$B1
	STA	$B2
	TAY
L1BED	RTS

; CONVERT STRING TO FLOATING-POINT

L1BEE	LDY	#0
	LDX	#$A
L1BF2	STY	$AA,X
	DEX
	BPL	L1BF2
	BCC	L1C08
	CMP	#'-'
	BNE	L1C01
	STX	$B4
	BEQ	L1C05
L1C01	CMP	#'+'
	BNE	L1C0A
L1C05	JSR	$C0
L1C08	BCC	L1C79
L1C0A	CMP	#'.'
	BEQ	L1C46
	CMP	#'E'
	BNE	L1C56
	JSR	$C0
	BCC	L1C38
	CMP	#$A4	; -
	BEQ	L1C29
	CMP	#'-'
	BEQ	L1C29
	CMP	#$A3	; +
	BEQ	L1C35
	CMP	#'+'
	BEQ	L1C35
	BNE	L1C3A

L1C29	LDA	#0
	BCC	L1C2F
	LDA	#$80
L1C2F	LSR	$AD
	ORA	$AD
	STA	$AD
L1C35	JSR	$C0
L1C38	BCC	L1CA0
L1C3A	BIT	$AD
	BPL	L1C56
	LDA	#0
	SEC
	SBC	$AB
	JMP	L1C58

L1C46	LDA	#0
	BCC	L1C4C
	LDA	#$80
L1C4C	LSR	$AC
	ORA	$AC
	STA	$AC
	BIT	$AC
	BVC	L1C05
L1C56	LDA	$AB
L1C58	SEC
	SBC	$AA
	STA	$AB
	BEQ	L1C71
	BPL	L1C6A
L1C61	JSR	L19F9
	INC	$AB
	BNE	L1C61
	BEQ	L1C71

L1C6A	JSR	L19DD
	DEC	$AB
	BNE	L1C6A
L1C71	LDA	$B4
	BMI	L1C76
	RTS

L1C76	JMP	L1E88

L1C79	PHA
	BIT	$AC
	BPL	L1C80
	INC	$AA
L1C80	JSR	L19DD
	PLA
	SEC
	SBC	#$30 ; '0'
	JSR	L1C8D
	JMP	L1C05

; GET NEW ASCII DIGIT

L1C8D	PHA
	JSR	L1B07
	PLA
	JSR	L1B37
	LDA	$BB
	EOR	$B3
	STA	$BC
	LDX	$AE
	JMP	L16D9

L1CA0	LDA	$AB
	CMP	#$A
	BCC	L1CAF
	LDA	#$64
	BIT	$AD
	BMI	L1CBD
	JMP	L181F

L1CAF	ASL	A
	ASL	A
	CLC
	ADC	$AB
	ASL	A
	CLC
	LDY	#0
	ADC	($C7),Y
	SEC
	SBC	#$30 ; '0'
L1CBD	STA	$AB
	JMP	L1C35

; FLOAT TO STRING CONVERSION CONSTANTS

L1CC2	.BYTE	$9B,$3E,$BC,$1F,$FD
L1CC7	.BYTE	$9E,$6E,$6B,$27,$FD
L1CCC	.BYTE	$9E,$6E,$6B,$28,0

; PRINT BASIC LINE NUMBER

L1CD1	LDA	#<L038D	; ' IN '
	LDY	#>L038D
	JSR	L1CE9
	LDA	$87
	LDX	$86

; PRINT NUMBER A,X

L1CDC	STA	$AF
	STX	$B0
	LDX	#$90
	SEC
	JSR	L1B44
	JSR	L1CEC
L1CE9	JMP	L0ACC

; CONVERT FLOATING-POINT TO ASCII

L1CEC	LDY	#1
L1CEE	LDA	#' '
	BIT	$B3
	BPL	L1CF6
	LDA	#'-'
L1CF6	STA	$FF,Y
	STA	$B3
	STY	$BE
	INY
	LDA	#'0'
	LDX	$AE
	BNE	L1D07
	JMP	L1E0F

L1D07	LDA	#0
	CPX	#$80
	BEQ	L1D0F
	BCS	L1D18
L1D0F	LDA	#<L1CCC
	LDY	#>L1CCC
	JSR	L18F1
	LDA	#$F7
L1D18	STA	$AA
L1D1A	LDA	#<L1CC7
	LDY	#>L1CC7
	JSR	L1B56
	BEQ	L1D41
	BPL	L1D37
L1D25	LDA	#<L1CC2
	LDY	#>L1CC2
	JSR	L1B56
	BEQ	L1D30
	BPL	L1D3E
L1D30	JSR	L19DD
	DEC	$AA
	BNE	L1D25
L1D37	JSR	L19F9
	INC	$AA
	BNE	L1D1A
L1D3E	JSR	L16B8
L1D41	JSR	L1B96
	LDX	#1
	LDA	$AA
	CLC
	ADC	#$A
	BMI	L1D56
	CMP	#$B
	BCS	L1D57
	ADC	#$FF
	TAX
	LDA	#2
L1D56	SEC
L1D57	SBC	#2
	STA	$AB
	STX	$AA
	TXA
	BEQ	L1D62
	BPL	L1D75
L1D62	LDY	$BE
	LDA	#$2E ; '.'
	INY
	STA	$FF,Y
	TXA
	BEQ	L1D73
	LDA	#$30 ; '0'
	INY
	STA	$FF,Y
L1D73	STY	$BE
L1D75	LDY	#0
	LDX	#$80
L1D79	LDA	$B2
	CLC
	ADC	L1E21+3,Y
	STA	$B2
	LDA	$B1
	ADC	L1E21+2,Y
	STA	$B1
	LDA	$B0
	ADC	L1E21+1,Y
	STA	$B0
	LDA	$AF
	ADC	L1E21,Y
	STA	$AF
	INX
	BCS	L1D9D
	BPL	L1D79
	BMI	L1D9F

L1D9D	BMI	L1D79

L1D9F	TXA
	BCC	L1DA6
	EOR	#$FF
	ADC	#$A
L1DA6	ADC	#$2F
	INY
	INY
	INY
	INY
	STY	$94
	LDY	$BE
	INY
	TAX
	AND	#$7F
	STA	$FF,Y
	DEC	$AA
	BNE	L1DC1
	LDA	#$2E ; '.'
	INY
	STA	$FF,Y
L1DC1	STY	$BE
	LDY	$94
	TXA
	EOR	#$FF
	AND	#$80
	TAX
	CPY	#$24 ; '$'
	BNE	L1D79
	LDY	$BE
L1DD1	LDA	$FF,Y
	DEY
	CMP	#$30 ; '0'
	BEQ	L1DD1
	CMP	#$2E ; '.'
	BEQ	L1DDE
	INY
L1DDE	LDA	#$2B ; '+'
	LDX	$AB
	BEQ	L1E12
	BPL	L1DEE
	LDA	#0
	SEC
	SBC	$AB
	TAX
	LDA	#'-'
L1DEE	STA	$101,Y
	LDA	#'E'
	STA	$100,Y
	TXA
	LDX	#$2F
	SEC
L1DFA	INX
	SBC	#$A
	BCS	L1DFA
	ADC	#$3A ; ':'
	STA	$103,Y
	TXA
	STA	$102,Y
	LDA	#0
	STA	$104,Y
	BEQ	L1E17
L1E0F	STA	$FF,Y
L1E12	LDA	#0
	STA	$100,Y
L1E17	LDA	#0
	LDY	#1
	RTS

; CONSTANTS

L1E1C	.BYTE	$80,0,0,0,0	; 0.5

L1E21	.BYTE	$FA,$0A,$1F,$00
	.BYTE	$00,$98,$96,$80
	.BYTE	$FF,$F0,$BD,$C0
	.BYTE	$00,$01,$86,$A0
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	.BYTE	$FF,$FF,$FF,$FF

; PERFORM SQR

L1E45	JSR	L1B07
	LDA	#<L1E1C
	LDY	#>L1E1C
	JSR	L1A9D

; PERFORM POWER

L1E4F	BEQ	L1EC1
	LDA	$B6
	BNE	L1E58
	JMP	L1768

L1E58	LDX	#$9B
	LDY	#0
	JSR	L1ACF
	LDA	$BB
	BPL	L1E72
	JSR	L1BC7
	LDA	#$9B
	LDY	#0
	JSR	L1B56
	BNE	L1E72
	TYA
	LDY	$A
L1E72	JSR	L1AF9
	TYA
	PHA
	JSR	L18B3
	LDA	#$9B
	LDY	#0
	JSR	L18F1
	JSR	L1EC1
	PLA
	LSR	A
	BCC	L1E92

; PERFORM NEGATE

L1E88	LDA	$AE
	BEQ	L1E92
	LDA	$B3
	EOR	#$FF
	STA	$B3
L1E92	RTS

; CONSTANTS

L1E93	.BYTE	$81,$38,$AA,$3B,$29

L1E98	.BYTE	8-1
	.BYTE	$71,$34,$58,$3E,$56
	.BYTE	$74,$16,$7E,$B3,$1B
	.BYTE	$77,$2F,$EE,$E3,$85
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	.BYTE	$81,$00,$00,$00,$00

; PERFORM EXP

L1EC1	LDA	#<L1E93
	LDY	#>L1E93
	JSR	L18F1
	LDA	$BD
	ADC	#$50
	BCC	L1ED1
	JSR	L1B1E
L1ED1	STA	$A3
	JSR	L1B0A
	LDA	$AE
	CMP	#$88
	BCC	L1EDF
L1EDC	JSR	L19CF
L1EDF	JSR	L1BC7
	LDA	$A
	CLC
	ADC	#$81
	BEQ	L1EDC
	SEC
	SBC	#1
	PHA
	LDX	#5
L1EEF	LDA	$B6,X
	LDY	$AE,X
	STA	$AE,X
	STY	$B6,X
	DEX
	BPL	L1EEF
	LDA	$A3
	STA	$BD
	JSR	L16C2
	JSR	L1E88
	LDA	#<L1E98
	LDY	#>L1E98
	JSR	L1F2A
	LDA	#0
	STA	$BC
	PLA
	JSR	L19B4
	RTS

; SERIES EVALUATION

L1F14	STA	$BE
	STY	$BF
	JSR	L1AC5
	LDA	#<$A4
	JSR	L18F1
	JSR	L1F2E
	LDA	#<$A4
	LDY	#0
	JMP	L18F1

L1F2A	STA	$BE
	STY	$BF
L1F2E	JSR	L1AC2
	LDA	($BE),Y
	STA	$B4
	LDY	$BE
	INY
	TYA
	BNE	L1F3D
	INC	$BF
L1F3D	STA	$BE
	LDY	$BF
L1F41	JSR	L18F1
	LDA	$BE
	LDY	$BF
	CLC
	ADC	#5
	BCC	L1F4E
	INY
L1F4E	STA	$BE
	STY	$BF
	JSR	L16D6
	LDA	#$A9
	LDY	#0
	DEC	$B4
	BNE	L1F41
L1F5D	RTS

; RND CONSTANTS

L1F5E	.BYTE	$98,$35,$44,$7A
L1F62	.BYTE	$68,$28,$B1,$46

; PERFORM RND

L1F66	JSR	L1B26
	TAX
	BMI	L1F84
	LDA	#$D8
	LDY	#0
	JSR	L1A9D
	TXA
	BEQ	L1F5D
	LDA	#<L1F5E
	LDY	#>L1F5E
	JSR	L18F1
	LDA	#<L1F62
	LDY	#>L1F62
	JSR	L16D6
L1F84	LDX	$B2
	LDA	$AF
	STA	$B2
	STX	$AF
	LDA	#0
	STA	$B3
	LDA	$AE
	STA	$BD
	LDA	#$80
	STA	$AE
	JSR	L1746
	LDX	#$D8
	LDY	#0
L1F9F	JMP	L1ACF

; PERFORM COS

L1FA2	LDA	#<L201E
	LDY	#>L201E
	JSR	L16D6

; PERFORM SIN

L1FA9	JSR	L1B07
	LDA	#<L2023
	LDY	#>L2023
	LDX	$BB
	JSR	L1A02
	JSR	L1B07
	JSR	L1BC7
	LDA	#0
	STA	$BC
	JSR	L16C2
	LDA	#<L2028
	LDY	#>L2028
	JSR	L16BF
	LDA	$B3
	PHA
	BPL	L1FDB
	JSR	L16B8
	LDA	$B3
	BMI	L1FDE
	LDA	$13
	EOR	#$FF
	STA	$13
L1FDB	JSR	L1E88
L1FDE	LDA	#<L2028
	LDY	#>L2028
	JSR	L16D6
	PLA
	BPL	L1FEB
	JSR	L1E88
L1FEB	LDA	#<L202D
	LDY	#>L202D
	JMP	L1F14

; PERFORM TAN

L1FF2	JSR	L1AC5
	LDA	#0
	STA	$13
	JSR	L1FA9
	LDX	#<$9B
	LDY	#0
	JSR	L1F9F
	LDA	#<$A4
	LDY	#0
	JSR	L1A9D
	LDA	#0
	STA	$B3
	LDA	$13
	JSR	L201A
	LDA	#<$9B
	LDY	#0
	JMP	L1A0A

L201A	PHA
	JMP	L1FDB

; CONSTANTS

L201E	.BYTE	$81,$49,$0F,$DA,$A2	; 0.5 * PI
L2023	.BYTE	$83,$49,$0F,$DA,$A2	; 2 * PI
L2028	.BYTE	$7F,$00,$00,$00,$00	; 0.25

L202D	.BYTE	6-1
	.BYTE	$84,$E6,$1A,$2D,$1B
	.BYTE	$86,$28,$07,$FB,$F8
	.BYTE	$87,$99,$68,$89,$01
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	.BYTE	$CA

; PERFORM ATN (WHEN ENABLED)
;
;L2056	LDA	$B3
;	PHA
;	BPL	L205E
;	JSR	L1E88
;L205E	LDA	$AE
;	PHA
;	CMP	#$81
;	BCC	L206C
;	LDA	#<L1885
;	LDY	#>L1885
;	JSR	L1A0A
;L206C	LDA	#<L2086
;	LDY	#>L2086
;	JSR	L1F14
;	PLA
;	CMP	#$81
;	BCC	L207F
;	LDA	#<L201E
;	LDY	#>L201E
;	JSR	L16BF
;L207F	PLA
;	BPL	L2085
;	JMP	L1E88
;
;L2085	RTS
;
;L2086	.BYTE	12-1
;	.BYTE	$76,$B3,$83,$BD,$D3
;	.BYTE	$79,$1E,$F4,$A6,$F5
;	.BYTE	$7B,$83,$FC,$B0,$10
;	.BYTE	$7C,$0C,$1F,$67,$CA
;	.BYTE	$7C,$DE,$53,$CB,$C1
;	.BYTE	$7D,$14,$64,$70,$4C
;	.BYTE	$7D,$B7,$EA,$51,$7A
;	.BYTE	$7D,$63,$30,$88,$7E
;	.BYTE	$7E,$92,$44,$99,$3A
;	.BYTE	$7E,$4C,$CC,$91,$C7
;	.BYTE	$7F,$AA,$AA,$AA,$13
;	.BYTE	$81,$00,$00,$00,$00
;
;	.BYTE	0

; PERFORM EXTENDED PRINT

L2056	.BYTE	$55 ; 'U'
	.BYTE	$B8
	.BYTE	$47 ; 'G'

L2059	LDY	#0
	STY	$2F83
L205E	LDA	($C7),Y
	JSR	$3A5F	; UPPERCASE
	CMP	L2056,Y
	BNE	L20AF
	INY
	CPY	#3
	BCC	L205E
L206D	JSR	$C0
	DEY
	BNE	L206D
	JSR	L213A
	LDX	#0
L2078	JSR	$2CE4
	CMP	#$D
	BEQ	L208E
	CMP	#$2E ; '.'
	BEQ	L208E
	INX
	CMP	#$23 ; '#'
	BEQ	L2078
L2088	JSR	$2CF7
	JMP	L0E1E

L208E	STX	$81
	LDX	#0
L2092	JSR	$2CE4
	CMP	#$D
	BEQ	L20A0
	INX
	CMP	#$23 ; '#'
L209C	BEQ	L2092
	BNE	L2088

L20A0	STX	$74
	TXA
	ADC	$81
	CMP	#$C
	BCS	L2088
	JSR	$2CF7
	INC	$2F83
L20AF	JMP	L21AA

L20B2	CMP	#$21 ; '!'
	BEQ	L20BD
	CMP	#$26 ; '&'
	BEQ	L20BD
	JMP	L0CCD

L20BD	PHA
	LDA	#$1B
	JMP	$36A1

	.BYTE	0

; $20C4-21C3 OVERWRITTEN BY TRACK 12 SEC 3

L20C4	JSR	$2967	; READ SECTOR ($265E) TO MEMORY ($FE)

; RELOCATED TO $C0

L20C7	INC	$C7
	BNE	L20CD
	INC	$C8
L20CD	LDA	$3A7E
	CMP	#$20 ; ' '
	BEQ	L20C7
	JMP	L17BE
L20D7	NOP
	SEC
	SBC	#$30 ; '0'
	SEC
	SBC	#$D0
L20DE	RTS

	.BYTE	$80,$4F,$C7,$52,$58

; ENTRY TO BASIC

L20E4	JSR	$2D73

	.BYTE	$D,$A,'OSI 9 DIGIT BASIC',$D,$A
	.BYTE	'COPYRIGHT 1977 BY MICROSOFT',$D,$A,0

	LDA	#>L20C4
	STA	$2C0B+2
	LDA	#<L20C4
	STA	$2C0B+1
	LDA	#>$2AC0
	STA	$2C04+2
	STA	$2C12+2
	LDA	#<$2AC0
	STA	$2C04+1
	STA	$2C12+1
	JSR	$2CF7
	LDX	#$FF
	TXS
L213A	LDX	#10-1
L213C	LDA	L21BA,X
	STA	0,X
	DEX
	BPL	L213C
	STA	$A1
	LDA	#$84	; TERMINAL WIDTH
	STA	$17
L214A	LDA	#$70
	STA	$18
	LDY	#$1D
L2150	LDA	L20C4+2,Y
	STA	$C0-1,Y
	DEY
	BNE	L2150
	TYA
	STA	$B5
	STA	$65
	STA	$15
	STA	$14
	PHA
L2163	LDA	#3
	STA	$A0
	LDA	#$66
	STA	$63
	LDA	#$FF
	STA	$84
	LDA	$2300
	STA	$85
	LDA	#<$3A7F
	STA	$78
	LDA	#>$3A7F
	STA	$79
	STY	$3A7E
	JSR	L0664
	LDX	#$81
L2184	LDA	$2300
	SEC
	SBC	#$3A
	JSR	L1CDC
	JSR	$2CF7
	JSR	$2D73

	.BYTE	' BYTES FREE',$D,$A,$A,0

	LDA	#$12
	JSR	$26BC	; GO TO TRACK (A) BCD
	LDA	#3
	STA	$265E	; SECTOR#
	LDA	#>L20C4
	STA	$FF
L21B0	LDA	#<L20C4
	STA	$FE
	JSR	$2754	; LOAD HEAD
	JMP	L20C4

L21BA	JMP	L0474	; WARM START JUMP
	JMP	L0ACC	; PRINT STRING JUMP
	.WORD	L1047	; FLOAT TO INTEGER VECTOR
	.BYTE	$20	; ??? INTEGER TO FLOAT VECTOR
L21C3	.BYTE	$B2,$20	; ($CD,$0C WHEN ATN ENABLED)

L21C5	JMP	L0A4D

L21C8	BEQ	L21D1

L21CA	BEQ	L21D4
	CMP	#$9C
	JMP	L0A3B

L21D1	JSR	L0A73
L21D4	LDA	#0	; MODIFIED
	STA	$2321
L21D9	LDA	#0	; MODIFIED
	STA	$2322
	RTS

L21DF	JSR	L20FF
	LSR	$14
	CMP	#$22 ; '"'
	RTS

L21E7	LDA	#$2C ; ','
	STA	$1A
	JSR	$C6
	CMP	#$23 ; '#'
	BNE	L2223
	JSR	L214B
	CMP	#$2C ; ','
	BEQ	L21FE
	JSR	L21D4
	BNE	L2183
L21FE	LDA	$2322
	STA	$2321
	AND	#7
	BNE	L220B
	STA	$2322
L220B	JMP	$C0

L220E	JSR	L0B4F
	LDA	$1B
	BNE	L2223
	LDA	$2321
	AND	#7
	BEQ	L220E
L221C	JSR	L21D4
	LDY	#0
	LDA	($90),Y
L2223	RTS

; RUN

L2224	BNE	L2229
L2226	JMP	L0678

L2229	BCS	L222E
	JMP	L0883

L222E	JSR	L213A
	JSR	$2BA7	; DOS LOAD
	JSR	$2CF7
	JSR	L2271
	BEQ	L2226

; PERFORM EXIT

L223C	JSR	L211C
	TXA
	JSR	$2D92	; PRINT BCD NUMBER (A)
	JSR	$2CF7
	JSR	$2D73

	.BYTE	' TRACK',0

L2250	JMP	$2A51

; PERFORM DISK

L2253	BEQ	L227C
	CMP	#$21 ; '!'
	BNE	L227F
	JSR	$C0
	JSR	L0CCD
	JSR	L0CBE
	JSR	L2110
	JSR	$2CF7
	JSR	$2A84
L226B	JSR	$2CF7
	LDX	#0
	TXS
L2271	LDX	#5-1
L2273	LDA	$3A79-1,X
	STA	$77,X
	DEX
	BNE	L2273
	RTS

L227C	JMP	L0E1E

L227F	CMP	#$43 ; 'C'
	BNE	L2295
	JSR	L2163
	JSR	$2CF7
L2289	LDX	#0	; MODIFIED
	JSR	$2477
	JSR	$2761
L2291	JSR	$2CF7
	RTS

L2295	CMP	#$4F ; 'O'
	BNE	L22C2
	JSR	L2163
	JSR	L0E13
	JSR	L213A
	JSR	$2DA6
	PHA
	LDA	$2E7A,X
	PHA
	LDA	#4
	STA	$265E
	LDA	#>$2E79
	STA	$FF
	LDA	#<$2E79
	STA	$FE
	LDA	#$12
	JSR	$26BC	; GO TO TRACK (A) BCD
	JSR	$2B1A
	JMP	$2E7C

L22C2	JMP	L0E1E

	.BYTE	0
	.BYTE	0
	.BYTE	0

L22C8	.BYTE	1
	.WORD	$27D7	; WRITE SECTOR
	.BYTE	1
	.WORD	$295D	; READ SECTOR
	.BYTE	2
	.WORD	$27D7	; WRITE SECTOR
	.BYTE	2
	.WORD	$295D	; READ SECTOR

L22D4	LDX	#0	; 0=DRIVE A WRITE
			; 3=DRIVE A READ
			; 6=DRIVE B WRITE
			; 9=DRIVE B READ
	LDA	L22C8+1,X
	STA	L22F1+1
	LDA	L22C8+2,X
	STA	L22F1+2
	LDA	L22C8,X
	JSR	$29C6	; SELECT DRIVE
	JSR	$2663	; GO TO TRACK 0
	JSR	$26A6	; GO TO TRACK
	JSR	$2754	; LOAD HEAD
L22F1	JSR	$295D	; READ SECTOR	MODIFIED
	JMP	$2761	; UNLOAD HEAD

; PERFORM USR

L22F7	JSR	$2CF7
L22FA	JSR	L22D4	; MAY BE USER MODIFIED
	JMP	L2291

; OVERLAY REFERENCES

L20DD	=	$20DD
L20EA	=	$20EA
L20F1	=	$20F1
L20FF	=	$20FF
L2110	=	$2110
L211C	=	$211C
L214B	=	$214B
L2183	=	$2183
L2186	=	$2186
L21A1	=	$21A1
L21AA	=	$21AA

	.END

; DATA FROM TRACK 12 SECTOR 3
;
;L20C4	JMP	L226B
;
;L20C7	JSR	$2761
;	JSR	$2CF7
;	LDA	#<L20D7
;	LDY	#>L20D7
;	JSR	$2A7D
;	JMP	L0474
;
; ERROR HANDLER
;
;L20D7	JSR	$2D50
;	JMP	L0462
;
;L20DD	LDA	#$E1
;L20DF	JSR	$263D
;	BVC	L20E9
;	LSR	A
;	LSR	A
;	LSR	A
;	BCC	L20DF
;L20E9	RTS
;
;L20EA	STA	$BF
;	LDX	#5
;	LDA	$92
;	RTS
;
;L20F1	PHA
;	LDA	$2AC6	; DEFAULT I/O DEVICE
;	STA	$2321
;	STA	$2322
;	PLA
;	JMP	L0ACC
;
;L20FF	PHP
;	PHA
;	LDA	$2321
;	STA	L21D4+1
;	LDA	$2322
;	STA	L21D9+1
;	PLA
;	PLP
;	RTS
;
;L2110	JSR	L1520
;	STA	$2CED
;	STX	$305A
;	STY	$305B
;L211C	TSX
;	INX
;	INX
;	STX	$226F
;	LDX	#4
;L2124	LDA	$77,X
;	STA	$3A78,X
;	DEX
;	BNE	L2124
;	LDA	$7B
;	SEC
;	SBC	#$3A
;L2131	INX
;	SBC	#8
;	BCS	L2131
;	STX	$3A7D
;	RTS
;
;L213A	JSR	L0CCD
;	JSR	L0CBE
;	LDA	#0
;	STA	$2CE5
;	JSR	L2110
;	JMP	$2CF7
;
;L214B	JSR	L1615
;	DEX
;	BMI	L2183
;	CPX	#9
;	BPL	L2183
;	INX
;	LDA	#0
;	SEC
;L2159	ROL	A
;	DEX
;	BNE	L2159
;	STA	$2322
;	JMP	$C6
;
;L2163	JSR	$C0
;	BEQ	L2183
;	BCC	L2183
;	CMP	#$2C ; ','
;	BNE	L2163
;	JSR	L1615
;	CPX	#6
;	BNE	L2179
;	LDX	#0
;	BEQ	L217F
;
;L2179	CPX	#7
;	BNE	L2183
;	LDX	#8
;L217F	STX	L2289+1
;	RTS
;
;L2183	JMP	L0E1E
;
; LIST ADD-ON
;
;L2186	JSR	L20FF
;L2189	BEQ	L219B
;	BCC	L219B
;	CMP	#$23 ; '#'
;	BNE	L219E
;	JSR	L214B
;	BEQ	L219B
;	JSR	L0E13
;	BNE	L2189
;L219B	JMP	L06C1
;
;L219E	JMP	L06BD
;
;L21A1	JSR	L0A73
;	JSR	L21D4
;	RTS
;	.WORD	L0474
;
;L21AA	JSR	L20FF
;	JMP	L0A35
;
;L21B0	JSR	$C6
;	CMP	#$23 ; '#'
;	BNE	L21C2
;	JSR	L214B
;	BEQ	L21D1
;	JSR	L0E13
;	JMP	L0A35
;
;L21C2	.BYTE	$20,$B2

