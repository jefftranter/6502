; This came from https://osi.marks-lab.com/reference/files/OS65D-disassembly.zip
;
;	DISASSEMBLY OF
;
;	COMPAR/TRACK ZERO UTILITY
;
;	FROM OS-65D V3.3 DISK# 5
;

DISK	=	$C000

	*=	$200

	LDA	#>$2E1E
	STA	$E2
	LDA	#<$2E1E
	STA	$E1
	JSR	$2D73

	.BYTE	$D,$A,$A
	.BYTE	'- DISKETTE UTILITIES -',$D,$A,$A
	.BYTE	'SELECT ONE:',$D,$A
	.BYTE	'1) COMPAR',$D,$A
	.BYTE	'2) TRACK 0 READ/WRITE',$D,$A
	.BYTE	'? ',0

	JSR	$2C9B
	LDA	#0
	STA	$2CE5
	JSR	$2CE4
	CMP	#'1'
	BEQ	L0272
	CMP	#'2'
	BNE	L026F
	JMP	L04FB

L026F	JMP	$2A51

; COMPAR

L0272	JSR	$2D73

	.BYTE	$D,$A,$A
	.BYTE	'- DISKETTE COMPAR -',$D,$A,$A
	.BYTE	'FROM DRIVE (A/B/C/D)? ',0

	JSR	L0465
	STA	0
	JSR	$2D73

	.BYTE	$D,$A
	.BYTE	'TO DRIVE (A/B/C/D)? ',0

	JSR	L0465
	STA	1

L02C9	JSR	$2D73

	.BYTE	$D,$A,$A
	.BYTE	'STARTING TRACK? ',0

	JSR	L049F
	STA	2
	JSR	$2D73

	.BYTE	$D,$A
	.BYTE	'ENDING TRACK (INCLUSIVE)? ',0

	JSR	L049F
	STA	3
	CMP	2
	BPL	L032E
	JSR	$2D73

	.BYTE	$D,$A
	.BYTE	'** START > END TRACK **',0

	JMP	L02C9

L032E	JMP	L0353

	.BYTE	$D,$A
	.BYTE	'READY (Y/N)? ',0

	JSR	$2C9B
	LDA	#0
	STA	$2CE5
	JSR	$2CE4
	CMP	#'Y'
	BEQ	L0353
	JMP	L0272

L0353	LDA	1
	JSR	$29C6
	JSR	$2663
	LDA	2
	JSR	$26BC
	LDA	0
	JSR	$29C6
	JSR	$2663
	LDA	2
	JSR	$26BC
	LDA	2
	BNE	L03E3
	PHA
	JSR	$2D6A
	PLA
	JSR	$2D92
	INC	2
	LDA	#>L069C
	STA	$FF
	LDA	#<L069C
	STA	$FE
	JSR	L0669
	LDA	7
	STA	$265F
	JSR	$268A
	LDA	1
	JSR	$29C6
	LDA	#>L139C
	STA	$FF
	LDA	#<L139C
	STA	$FE
	JSR	L0669
	JSR	$268A
	INC	$265D
L03A4	JSR	$209C	;
	NOP
	BPL	L03E3

L03AA	JSR	$2761
	JSR	$2663
	JSR	$2D73

	.BYTE	$D,$A,$A
	.BYTE	'ANOTHER (Y/N)? ',0

	JSR	$2C9B
	LDA	#0
	STA	$2CE5
	JSR	$2CE4
	CMP	#'Y'
	BNE	L03D8
	JMP	L0272

L03D8	LDA	0
	JSR	$29C6
	JSR	$2663
	JMP	$2A51	; RETURN TO DOS

L03E3	LDA	0
	JSR	$29C6
	JSR	$2D6A
	LDA	2
	JSR	$2D92
	JSR	$2754
	LDA	#1
	STA	$265E
	LDA	#$FF
	STA	8
	JSR	$28C4

L03FF	INC	8
	JSR	$2998
	BCS	L03FF
	LDA	8
	BEQ	L043A
	LDA	#>L069C
	STA	$FF
	LDA	#<L069C
	STA	$FE
	JSR	$2967
	LDA	1
	JSR	$29C6
	JSR	$2754
	LDA	#<L139C
	STA	$FE
	LDA	#>L139C
	STA	$FF
	JSR	$2967
	LDA	0
	JSR	$29C6
	INC	$265E
	DEC	8
	BEQ	L043A
	JSR	$2754
	JMP	$20FF	; RETURN TO BASIC

L043A	LDA	$265D
	CMP	#$76	; MAX TRACK
	BNE	L0444
	JMP	L03AA

L0444	JSR	$268A
	LDA	1
	JSR	$29C6
	LDA	1
	EOR	0
	LSR	A
	BCC	L0456
	JSR	$268A

L0456	CLC		; INC TRACK
	SED
	LDA	2
	ADC	#1
	STA	2
	CLD
	STA	$265D
	JMP	L03A4

;

L0465	JSR	$2C9B
	LDA	#0
	STA	$2CE5
	JSR	$2CE4
	CMP	#'A'
	BMI	L047B
	CMP	#'D'+1
	BPL	L047B
	AND	#7
	RTS

L047B	JSR	$2D73

	.BYTE	$D,$A
	.BYTE	'** BAD NAME **',$D,$A
	.BYTE	'TRY AGAIN? ',0

	JMP	L0465

L049F	JSR	$2C9B
	LDA	#0
	STA	$2CE5
	STA	4
L04A9	JSR	$2CE4
	CMP	#$D
	BNE	L04B7
	LDA	4
	CMP	#$40
	BPL	L04CF
	RTS

L04B7	CMP	#'0'
	BMI	L04CF
	CMP	#'9'+1
	BPL	L04CF
	AND	#$F
	ASL	A
	ASL	A
	ASL	A
	ASL	A
	LDX	#4
L04C7	ASL	A
	ROL	4
	DEX
	BNE	L04C7
	BEQ	L04A9

L04CF	JSR	$2D73

	.BYTE	$D,$A
	.BYTE	'** BAD TRACK NUMBER **',$D,$A
	.BYTE	'TRY AGAIN? ',0

	JMP	L049F

; TRACK 0 READ/WRITE

L04FB	JSR	$2D73

	.BYTE	$D,$A,$A
	.BYTE	'- TRACK ZERO READ/WRITE UTILITY -',$D,$A,$A
	.BYTE	'COMMANDS:',$D,$A
	.BYTE	'Rnnnn - READ INTO LOCATION nnnn.',$D,$A
	.BYTE	'Wnnnn/gggg,p - WRITE FROM nnnn FOR p PAGES',$D,$A
	.BYTE	'               WITH gggg AS THE LOAD VECTOR',$D,$A
	.BYTE	'E - EXIT TO OS-65D',$D,$A,$A
	.BYTE	'COMMAND? ',0

	JSR	$2C9B
	JSR	$2D6A
	LDA	#>$2E1E
	STA	$E2
	LDA	#<$2E1E
	STA	$E1
	LDA	#0
	STA	$2CE5
	JSR	$2CE4
	CMP	#'E'
	BNE	L05E7
	JMP	$2A51

L05E7	CMP	#'R'
	BNE	L05F4

; READ

	JSR	$2D23
	JSR	L0669
	JMP	L04FB

L05F4	CMP	#'W'
	BEQ	L05FB
	JMP	L04FB

; WRITE

L05FB	JSR	$2D23
	JSR	$2D5E
	JSR	$2D2E
	STA	5
	JSR	$2D2E
	STA	6
	JSR	$2D5B
	JSR	$2D3D
	STA	$265F
	JSR	L061A
	JMP	L04FB

L061A	JSR	$2663
	JSR	$2754

L0620	LDA	DISK	; WAIT INDEX PULSE END
	BPL	L0620
L0625	LDA	DISK	; WAIT INDEX PULSE START
	BMI	L0625

	LDA	#$FC	; SET 'WRITE' 'ERASE' LOW
	AND	DISK+2
	STA	DISK+2
L0632	LDA	DISK	; WAIT INDEX PULSE END
	BPL	L0632

	LDX	#1	; 1 MS
	JSR	$267A
	LDX	5
	JSR	$27C2
	LDX	6
	JSR	$27C2
	LDX	$265F
	JSR	$27C2
	LDY	#0
L064E	LDA	($FE),Y
	TAX
	JSR	$27C2
	INY
	BNE	L064E
	INC	$FF
	DEC	$265F
	BNE	L064E

L065E	LDA	DISK	; WAIT INDEX PULSE START
	BMI	L065E
	LDA	#$83	; SET HEADLOAD 'WRITE' 'ERASE' HIGH
	JSR	$2763
	RTS

L0669	JSR	$2663
	JSR	$2754
	JSR	$271D
	JSR	$272E
	JSR	$27CD
	STA	5
	JSR	$27CD
	STA	6
	JSR	$27CD
	STA	$265F
	STA	7
	LDY	#0
L0689	JSR	$27CD
	STA	($FE),Y
	INY
	BNE	L0689
	INC	$FF
	DEC	7
	NOP
	BNE	L0689
	JSR	$2761
	RTS

L069C	=	*
L139C	=	*+$0D00

	.BYTE	$7F,$31,$C1,$39,$01,$00,$B7,$31
	.BYTE	$0A,$00,$8E,$20,$43,$48,$41,$4E
	.BYTE	$47,$45,$20,$50,$41,$52,$41,$4D
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	.BYTE	$55,$54,$49,$4C

	.END
